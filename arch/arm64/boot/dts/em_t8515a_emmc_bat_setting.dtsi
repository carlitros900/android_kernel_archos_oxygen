/*************************
 * Customized Battery Setting dtsi file
*************************/
&bat_comm {
	gpio22_dc_det = <&pio 22 0>;
	gpio85_set_chr_set = <&pio 85 0>;
	gpio28_spec_cur_select = <&pio 28 0>;
	/* cust_charging.h */
	/* stop charging while in talking mode */
	stop_charging_in_takling = <1>;
	talking_recharge_voltage = <3800>;
	talking_sync_time = <60>;

	/* Battery Temperature Protection */
	mtk_temperature_recharge_support = <1>;
	max_charge_temperature = <50>;
	max_charge_temperature_minus_x_degree = <47>;
	min_charge_temperature = <0>;
	min_charge_temperature_plus_x_degree = <6>;
	err_charge_temperature = <0xff>;

	/* Linear Charging Threshold */
	v_pre2cc_thres = <3400>;	/* unit: mV */
	v_cc2topoff_thres = <4050>;
	recharging_voltage = <4110>;
	charging_full_current = <80>;	/* unit: mA */

	/* Charging Current Setting */
	config_usb_if = <0>;
	usb_charger_current_suspend = <0>;	/* Unit: 0.01 mA */
	usb_charger_current_unconfigured = <7000>;	/* Unit: 0.01 mA */
	usb_charger_current_configured = <50000>;	/* Unit: 0.01 mA */
	usb_charger_current = <120000>;	/* Unit: 0.01 mA */
	ac_charger_current = <120000>;	/* Unit: 0.01 mA */
	non_std_ac_charger_current = <50000>;	/* Unit: 0.01 mA */
	charging_host_charger_current = <65000>;	/* Unit: 0.01 mA */
	apple_0_5a_charger_current = <50000>;	/* Unit: 0.01 mA */
	apple_1_0a_charger_current = <65000>;	/* Unit: 0.01 mA */
	apple_2_1a_charger_current = <80000>;	/* Unit: 0.01 mA */

	/* charger error check */
	bat_low_temp_protect_enable = <0>;
	v_charger_enable = <0>;	/* 1:on , 0:off */
	v_charger_max = <6500>;	/* unit: mV */
	v_charger_min = <4400>;

	/*  Tracking TIME */
	onehundred_percent_tracking_time = <1800>;	/* Unit: second */
	npercent_tracking_time = <200>;	/* Unit: second */
	sync_to_real_tracking_time = <300>;	/* Unit: second */
	v_0percent_tracking = <3440>;	/* Unit: mV */

	/* High battery support */
	high_battery_voltage_support = <0>;
};

&bat_meter {
	/* cust_battery_meter.h */
	/* ADC resistor  */
	r_bat_sense = <4>;
	r_i_sense = <4>;
	r_charger_1 = <330>;
	r_charger_2 = <39>;
	temperature_t0 = <110>;
	temperature_t1 = <0>;
	temperature_t2 = <25>;
	temperature_t3 = <50>;
	temperature_t = <255>;	/* this should be fixed, never change the value */
	fg_meter_resistance = <0>;

	/* Qmax for 0mA */
	q_max_pos_50 = <2424>;
	q_max_pos_25 = <2424>;
	q_max_pos_0 = <2424>;
	q_max_neg_10 = <2424>;
	/* Qmax for 600mA, said high current */
	q_max_pos_50_h_current = <2041>;
	q_max_pos_25_h_current = <2041>;
	q_max_pos_0_h_current = <2041>;
	q_max_neg_10_h_current = <2041>;
	/* Discharge percentage, 1: D5, 0: D2 */
	oam_d5 = <0>;

	change_tracking_point = <1>;
	/* SW OCV tracking setting */
	cust_tracking_point = <14>;
	cust_r_sense = <200>;
	cust_hw_cc = <0>;
	aging_tuning_value = <100>;
	cust_r_fg_offset = <0>;
	ocv_board_compesate = <0>;
	r_fg_board_base = <1000>;
	r_fg_board_slope = <1000>;
	car_tune_value = <89>;

	/* HW Fuel gague  */
	current_detect_r_fg = <10>;	/* Unit: mA */
	minerroroffset = <1000>;
	fg_vbat_average_size = <18>;
	r_fg_value = <10>;	/* Unit: mOhm */

	cust_poweron_delta_capacity_tolrance = <80>;
	cust_poweron_low_capacity_tolrance = <0>;
	cust_poweron_max_vbat_tolrance = <70>;
	cust_poweron_delta_vbat_tolrance = <60>;
	cust_poweron_delta_hw_sw_ocv_capacity_tolrance = <10>;

	/* Fixed battery temperature */
	fixed_tbat_25 = <1>;
	/* Dynamic change wake up period of battery thread when suspend */
	vbat_normal_wakeup = <3600>;	/* Unit: mV */
	vbat_low_power_wakeup = <3500>;	/* Unit: mV */
	normal_wakeup_period = <5400>;	/* Unit: second */
	low_power_wakeup_period = <300>;	/* Unit: second */
	close_poweroff_wakeup_period = <30>;	/* Unit: second */

	rbat_pull_up_r = <16900>;
	rbat_pull_up_volt = <1800>;

	batt_temperature_table_num = <17>;
	batt_temperature_table = <
			    (-20) 75022
			    (-15) 57926
			    (-10) 45168
			    (-5) 35548
			    0 28224
			    5 22595
			    10 18231
			    15 14820
			    20 12133
			    25 10000 30 8295 35 6922 40 5810 45 4903 50 4160 55 3547 60 3039>;

	battery_profile_t0_num = <70>;
	battery_profile_t0 = <0 4193
				1   4176 	
				3   4161 
                                4   4147 
                                6   4134 
                                7   4121 
                                9   4108 
                                10  4095 
                                12  4083 
                                13  4072 
                                15  4060 
                                16  4048 
                                18  4036 
                                19  4024 
                                21  4013 
                                22  4002 
                                24  3992 
                                25  3983 
                                27  3973 
                                28  3964 
                                30  3954 
                                31  3945 
                                33  3934 
                                34  3924 
                                36  3913 
                                37  3901 
                                39  3889 
                                40  3878 
                                42  3869 
                                43  3861 
                                44  3854 
                                46  3847 
                                47  3840 
                                49  3834 
                                50  3829 
                                52  3824 
                                53  3819 
                                55  3814 
                                56  3810 
                                58  3805 
                                59  3801 
                                61  3797 
                                62  3794 
                                64  3790 
                                65  3786 
                                67  3783 
                                68  3779 
                                70  3775 
                                71  3772 
                                73  3767 
                                74  3762 
                                76  3756 
                                77  3751 
                                79  3746 
                                80  3742 
                                82  3737 
                                83  3732 
                                85  3727 
                                86  3720 
                                87  3714 
                                89  3707 
                                90  3698 
                                92  3690 
                                93  3687 
                                95  3685 
                                96  3681 
                                98  3667 
                                99  3626 
                                101 3566 
                                101 3484>;

	battery_profile_t1_num = <70>;
	battery_profile_t1 = <0 4193
				1   4176
                                3   4161
                                4   4147
                                6   4134
                                7   4121
                                9   4108
                                10  4095
                                12  4083
                                13  4072
                                15  4060
                                16  4048
                                18  4036
                                19  4024
                                21  4013
                                22  4002
                                24  3992
                                25  3983
                                27  3973
                                28  3964
                                30  3954
                                31  3945
                                33  3934
                                34  3924
                                36  3913
                                37  3901
                                39  3889
                                40  3878
                                42  3869
                                43  3861
                                44  3854
                                46  3847
                                47  3840
                                49  3834
                                50  3829
                                52  3824
                                53  3819
                                55  3814
                                56  3810
                                58  3805
                                59  3801
                                61  3797
                                62  3794
                                64  3790
                                65  3786
                                67  3783
                                68  3779
                                70  3775
                                71  3772
                                73  3767
                                74  3762
                                76  3756
                                77  3751
                                79  3746
                                80  3742
                                82  3737
                                83  3732
                                85  3727
                                86  3720
                                87  3714
                                89  3707
                                90  3698
                                92  3690
                                93  3687
                                95  3685
                                96  3681
                                98  3667
                                99  3626
                                101 3566
                                101 3484>;

	battery_profile_t2_num = <70>;
	battery_profile_t2 = <0 4193
				1   4176	
				3   4161
                                4   4147
                                6   4134
                                7   4121
                                9   4108
                                10  4095
                                12  4083
                                13  4072
                                15  4060
                                16  4048
                                18  4036
                                19  4024
                                21  4013
                                22  4002
                                24  3992
                                25  3983
                                27  3973
                                28  3964
                                30  3954
                                31  3945
                                33  3934
                                34  3924
                                36  3913
                                37  3901
                                39  3889
                                40  3878
                                42  3869
                                43  3861
                                44  3854
                                46  3847
                                47  3840
                                49  3834
                                50  3829
                                52  3824
                                53  3819
                                55  3814
                                56  3810
                                58  3805
                                59  3801
                                61  3797
                                62  3794
                                64  3790
                                65  3786
                                67  3783
                                68  3779
                                70  3775
                                71  3772
                                73  3767
                                74  3762
                                76  3756
                                77  3751
                                79  3746
                                80  3742
                                82  3737
                                83  3732
                                85  3727
                                86  3720
                                87  3714
                                89  3707
                                90  3698
                                92  3690
                                93  3687
                                95  3685
                                96  3681
                                98  3667
                                99  3626
                                101 3566
                                101 3484>;

	battery_profile_t3_num = <70>;
	battery_profile_t3 = <0 4193
				1   4176	
				3   4161
                                4   4147
                                6   4134
                                7   4121
                                9   4108
                                10  4095
                                12  4083
                                13  4072
                                15  4060
                                16  4048
                                18  4036
                                19  4024
                                21  4013
                                22  4002
                                24  3992
                                25  3983
                                27  3973
                                28  3964
                                30  3954
                                31  3945
                                33  3934
                                34  3924
                                36  3913
                                37  3901
                                39  3889
                                40  3878
                                42  3869
                                43  3861
                                44  3854
                                46  3847
                                47  3840
                                49  3834
                                50  3829
                                52  3824
                                53  3819
                                55  3814
                                56  3810
                                58  3805
                                59  3801
                                61  3797
                                62  3794
                                64  3790
                                65  3786
                                67  3783
                                68  3779
                                70  3775
                                71  3772
                                73  3767
                                74  3762
                                76  3756
                                77  3751
                                79  3746
                                80  3742
                                82  3737
                                83  3732
                                85  3727
                                86  3720
                                87  3714
                                89  3707
                                90  3698
                                92  3690
                                93  3687
                                95  3685
                                96  3681
                                98  3667
                                99  3626
                                101 3566
                                101 3484>;

	r_profile_t0_num = <70>;
	r_profile_t0 = <111 4193
				118  4176
                                119  4161
                                120  4147
                                122  4134
                                121  4121
                                123  4108
                                122  4095
                                125  4083
                                125  4072
                                127  4060
                                127  4048
                                130  4036
                                130  4024
                                132  4013
                                131  4002
                                134  3992
                                135  3983
                                135  3973
                                137  3964
                                137  3954
                                138  3945
                                137  3934
                                137  3924
                                135  3913
                                132  3901
                                129  3889
                                126  3878
                                125  3869
                                125  3861
                                124  3854
                                125  3847
                                122  3840
                                124  3834
                                123  3829
                                124  3824
                                124  3819
                                124  3814
                                124  3810
                                125  3805
                                125  3801
                                126  3797
				127  3794
				127  3790
				126  3786
				128  3783
				127  3779
				127  3775
				127  3772
				127  3767
				125  3762
				125  3756
				125  3751
				125  3746
				127  3742
				127  3737
				128  3732
				128  3727
				127  3720
				128  3714
				128  3707
				126  3698
				124  3690
				126  3687
				132  3685
				138  3681
				141  3667
				137  3626
				141  3566
				149  3484>;

	r_profile_t1_num = <70>;
	r_profile_t1 = <111 4193
				118  4176
                                119  4161
                                120  4147
                                122  4134
                                121  4121
                                123  4108
                                122  4095
                                125  4083
                                125  4072
                                127  4060
                                127  4048
                                130  4036
                                130  4024
                                132  4013
                                131  4002
                                134  3992
                                135  3983
                                135  3973
                                137  3964
                                137  3954
                                138  3945
                                137  3934
                                137  3924
                                135  3913
                                132  3901
                                129  3889
                                126  3878
                                125  3869
                                125  3861
                                124  3854
                                125  3847
                                122  3840
                                124  3834
                                123  3829
                                124  3824
                                124  3819
                                124  3814
                                124  3810
                                125  3805
                                125  3801
                                126  3797
				127  3794
				127  3790
				126  3786
				128  3783
				127  3779
				127  3775
				127  3772
				127  3767
				125  3762
				125  3756
				125  3751
				125  3746
				127  3742
				127  3737
				128  3732
				128  3727
				127  3720
				128  3714
				128  3707
				126  3698
				124  3690
				126  3687
				132  3685
				138  3681
				141  3667
				137  3626
				141  3566
				149  3484>;

	r_profile_t2_num = <70>;
	r_profile_t2 = <111 4193
				118  4176
                                119  4161
                                120  4147
                                122  4134
                                121  4121
                                123  4108
                                122  4095
                                125  4083
                                125  4072
                                127  4060
                                127  4048
                                130  4036
                                130  4024
                                132  4013
                                131  4002
                                134  3992
                                135  3983
                                135  3973
                                137  3964
                                137  3954
                                138  3945
                                137  3934
                                137  3924
                                135  3913
                                132  3901
                                129  3889
                                126  3878
                                125  3869
                                125  3861
                                124  3854
                                125  3847
                                122  3840
                                124  3834
                                123  3829
                                124  3824
                                124  3819
                                124  3814
                                124  3810
                                125  3805
                                125  3801
                                126  3797
				127  3794
				127  3790
				126  3786
				128  3783
				127  3779
				127  3775
				127  3772
				127  3767
				125  3762
				125  3756
				125  3751
				125  3746
				127  3742
				127  3737
				128  3732
				128  3727
				127  3720
				128  3714
				128  3707
				126  3698
				124  3690
				126  3687
				132  3685
				138  3681
				141  3667
				137  3626
				141  3566
				149  3484>;

	r_profile_t3_num = <70>;
	r_profile_t3 = <111 4193
				118  4176
                                119  4161
                                120  4147
                                122  4134
                                121  4121
                                123  4108
                                122  4095
                                125  4083
                                125  4072
                                127  4060
                                127  4048
                                130  4036
                                130  4024
                                132  4013
                                131  4002
                                134  3992
                                135  3983
                                135  3973
                                137  3964
                                137  3954
                                138  3945
                                137  3934
                                137  3924
                                135  3913
                                132  3901
                                129  3889
                                126  3878
                                125  3869
                                125  3861
                                124  3854
                                125  3847
                                122  3840
                                124  3834
                                123  3829
                                124  3824
                                124  3819
                                124  3814
                                124  3810
                                125  3805
                                125  3801
                                126  3797
				127  3794
				127  3790
				126  3786
				128  3783
				127  3779
				127  3775
				127  3772
				127  3767
				125  3762
				125  3756
				125  3751
				125  3746
				127  3742
				127  3737
				128  3732
				128  3727
				127  3720
				128  3714
				128  3707
				126  3698
				124  3690
				126  3687
				132  3685
				138  3681
				141  3667
				137  3626
				141  3566
				149  3484>;
};
