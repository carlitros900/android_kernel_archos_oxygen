/*************************
 * Customized Battery Setting dtsi file
*************************/
&bat_comm {
	gpio22_dc_det = <&pio 22 0>;
	gpio85_set_chr_set = <&pio 85 0>;
	gpio28_spec_cur_select = <&pio 28 0>;
	/* cust_charging.h */
	/* stop charging while in talking mode */
	stop_charging_in_takling = <1>;
	talking_recharge_voltage = <3800>;
	talking_sync_time = <60>;

	/* Battery Temperature Protection */
	mtk_temperature_recharge_support = <1>;
	max_charge_temperature = <50>;
	max_charge_temperature_minus_x_degree = <47>;
	min_charge_temperature = <0>;
	min_charge_temperature_plus_x_degree = <6>;
	err_charge_temperature = <0xff>;

	/* Linear Charging Threshold */
	v_pre2cc_thres = <3400>;	/* unit: mV */
	v_cc2topoff_thres = <4050>;
	recharging_voltage = <4110>;
	charging_full_current = <80>;	/* unit: mA */

	/* Charging Current Setting */
	config_usb_if = <0>;
	usb_charger_current_suspend = <0>;	/* Unit: 0.01 mA */
	usb_charger_current_unconfigured = <7000>;	/* Unit: 0.01 mA */
	usb_charger_current_configured = <50000>;	/* Unit: 0.01 mA */
	usb_charger_current = <50000>;	/* Unit: 0.01 mA */
	ac_charger_current = <120000>;	/* Unit: 0.01 mA */
	non_std_ac_charger_current = <50000>;	/* Unit: 0.01 mA */
	charging_host_charger_current = <65000>;	/* Unit: 0.01 mA */
	apple_0_5a_charger_current = <50000>;	/* Unit: 0.01 mA */
	apple_1_0a_charger_current = <65000>;	/* Unit: 0.01 mA */
	apple_2_1a_charger_current = <80000>;	/* Unit: 0.01 mA */

	/* charger error check */
	bat_low_temp_protect_enable = <0>;
	v_charger_enable = <0>;	/* 1:on , 0:off */
	v_charger_max = <6500>;	/* unit: mV */
	v_charger_min = <4400>;

	/*  Tracking TIME */
	onehundred_percent_tracking_time = <10>;	/* Unit: second */
	npercent_tracking_time = <20>;	/* Unit: second */
	sync_to_real_tracking_time = <60>;	/* Unit: second */
	v_0percent_tracking = <3450>;	/* Unit: mV */

	/* High battery support */
	high_battery_voltage_support = <0>;
};

&bat_meter {
	/* cust_battery_meter.h */
	/* ADC resistor  */
	r_bat_sense = <4>;
	r_i_sense = <4>;
	r_charger_1 = <330>;
	r_charger_2 = <39>;
	temperature_t0 = <110>;
	temperature_t1 = <0>;
	temperature_t2 = <25>;
	temperature_t3 = <50>;
	temperature_t = <255>;	/* this should be fixed, never change the value */
	fg_meter_resistance = <0>;

	/* Qmax for 0mA */
	q_max_pos_50 = <2887>;
	q_max_pos_25 = <2887>;
	q_max_pos_0 = <2887>;
	q_max_neg_10 = <2887>;
	/* Qmax for 600mA, said high current */
	q_max_pos_50_h_current = <2840>;
	q_max_pos_25_h_current = <2840>;
	q_max_pos_0_h_current = <2840>;
	q_max_neg_10_h_current = <2840>;
	/* Discharge percentage, 1: D5, 0: D2 */
	oam_d5 = <1>;

	change_tracking_point = <1>;
	/* SW OCV tracking setting */
	cust_tracking_point = <14>;
	cust_r_sense = <200>;
	cust_hw_cc = <0>;
	aging_tuning_value = <100>;
	cust_r_fg_offset = <0>;
	ocv_board_compesate = <0>;
	r_fg_board_base = <1000>;
	r_fg_board_slope = <1000>;
	car_tune_value = <89>;

	/* HW Fuel gague  */
	current_detect_r_fg = <10>;	/* Unit: mA */
	minerroroffset = <1000>;
	fg_vbat_average_size = <18>;
	r_fg_value = <10>;	/* Unit: mOhm */

	cust_poweron_delta_capacity_tolrance = <80>;
	cust_poweron_low_capacity_tolrance = <5>;
	cust_poweron_max_vbat_tolrance = <70>;
	cust_poweron_delta_vbat_tolrance = <60>;
	cust_poweron_delta_hw_sw_ocv_capacity_tolrance = <10>;

	/* Fixed battery temperature */
	fixed_tbat_25 = <1>;
	/* Dynamic change wake up period of battery thread when suspend */
	vbat_normal_wakeup = <3600>;	/* Unit: mV */
	vbat_low_power_wakeup = <3500>;	/* Unit: mV */
	normal_wakeup_period = <5400>;	/* Unit: second */
	low_power_wakeup_period = <300>;	/* Unit: second */
	close_poweroff_wakeup_period = <30>;	/* Unit: second */

	rbat_pull_up_r = <16900>;
	rbat_pull_up_volt = <1800>;

	batt_temperature_table_num = <17>;
	batt_temperature_table = <
			    (-20) 75022
			    (-15) 57926
			    (-10) 45168
			    (-5) 35548
			    0 28224
			    5 22595
			    10 18231
			    15 14820
			    20 12133
			    25 10000 30 8295 35 6922 40 5810 45 4903 50 4160 55 3547 60 3039>;

	battery_profile_t0_num = <93>;
	battery_profile_t0 = <
			0	4191	
			1	4171	
			2	4153	
			3	4138	
			4	4124	
			6	4110	
			7	4099	
			8	4089	
			9	4080	
			10	4073	
			11	4067	
			12	4061	
			13	4056	
			14	4051	
			16	4048	
			17	4044	
			18	4042	
			19	4040	
			20	4039	
			21	4037	
			22	4036	
			23	4035	
			24	4034	
			25	4033	
			27	4031	
			28	4028	
			29	4024	
			30	4019	
			31	4012	
			32	4004	
			33	3996	
			34	3988	
			35	3982	
			37	3974	
			38	3969	
			39	3962	
			40	3955	
			41	3947	
			42	3939	
			43	3929	
			44	3919	
			45	3908	
			47	3898	
			48	3891	
			49	3888	
			50	3881	
			51	3877	
			52	3874	
			53	3872	
			54	3869	
			55	3866	
			57	3862	
			58	3858	
			59	3855	
			60	3851	
			61	3847	
			62	3843	
			63	3840	
			64	3836	
			65	3832	
			67	3828	
			68	3824	
			69	3820	
			70	3816	
			71	3812	
			72	3807	
			73	3803	
			74	3798	
			75	3792	
			76	3787	
			78	3781	
			79	3775	
			80	3768	
			81	3761	
            82	3755
			83	3748	
			84	3742	
			85	3734	
			86	3725	
			88	3717	
			89	3707	
			90	3696	
			91	3692	
			92	3691	
			93	3690	
			94	3689	
			95	3688	
			96	3685	
			98	3681	
			99	3659	
			100	3613	
			101	3549	
			102	3462	
				>;

	battery_profile_t1_num = <93>;
	battery_profile_t1 = <
			0	4191	
			1	4171	
			2	4153	
			3	4138	
			4	4124	
			6	4110	
			7	4099	
			8	4089	
			9	4080	
			10	4073	
			11	4067	
			12	4061	
			13	4056	
			14	4051	
			16	4048	
			17	4044	
			18	4042	
			19	4040	
			20	4039	
			21	4037	
			22	4036	
			23	4035	
			24	4034	
			25	4033	
			27	4031	
			28	4028	
			29	4024	
			30	4019	
			31	4012	
			32	4004	
			33	3996	
			34	3988	
			35	3982	
			37	3974	
			38	3969	
			39	3962	
			40	3955	
			41	3947	
			42	3939	
			43	3929	
			44	3919	
			45	3908	
			47	3898	
			48	3891	
			49	3888	
			50	3881	
			51	3877	
			52	3874	
			53	3872	
			54	3869	
			55	3866	
			57	3862	
			58	3858	
			59	3855	
			60	3851	
			61	3847	
			62	3843	
			63	3840	
			64	3836	
			65	3832	
			67	3828	
			68	3824	
			69	3820	
			70	3816	
			71	3812	
			72	3807	
			73	3803	
			74	3798	
			75	3792	
			76	3787	
			78	3781	
			79	3775	
			80	3768	
			81	3761	
            82	3755
			83	3748	
			84	3742	
			85	3734	
			86	3725	
			88	3717	
			89	3707	
			90	3696	
			91	3692	
			92	3691	
			93	3690	
			94	3689	
			95	3688	
			96	3685	
			98	3681	
			99	3659	
			100	3613	
			101	3549	
			102	3462
			>;

	battery_profile_t2_num = <93>;
	battery_profile_t2 = <
			0	4191	
			1	4171	
			2	4153	
			3	4138	
			4	4124	
			6	4110	
			7	4099	
			8	4089	
			9	4080	
			10	4073	
			11	4067	
			12	4061	
			13	4056	
			14	4051	
			16	4048	
			17	4044	
			18	4042	
			19	4040	
			20	4039	
			21	4037	
			22	4036	
			23	4035	
			24	4034	
			25	4033	
			27	4031	
			28	4028	
			29	4024	
			30	4019	
			31	4012	
			32	4004	
			33	3996	
			34	3988	
			35	3982	
			37	3974	
			38	3969	
			39	3962	
			40	3955	
			41	3947	
			42	3939	
			43	3929	
			44	3919	
			45	3908	
			47	3898	
			48	3891	
			49	3888	
			50	3881	
			51	3877	
			52	3874	
			53	3872	
			54	3869	
			55	3866	
			57	3862	
			58	3858	
			59	3855	
			60	3851	
			61	3847	
			62	3843	
			63	3840	
			64	3836	
			65	3832	
			67	3828	
			68	3824	
			69	3820	
			70	3816	
			71	3812	
			72	3807	
			73	3803	
			74	3798	
			75	3792	
			76	3787	
			78	3781	
			79	3775	
			80	3768	
			81	3761	
            82	3755
			83	3748	
			84	3742	
			85	3734	
			86	3725	
			88	3717	
			89	3707	
			90	3696	
			91	3692	
			92	3691	
			93	3690	
			94	3689	
			95	3688	
			96	3685	
			98	3681	
			99	3659	
			100	3613	
			101	3549	
			102	3462
				>;


	battery_profile_t3_num = <93>;
	battery_profile_t3 = <
			0	4191	
			1	4171	
			2	4153	
			3	4138	
			4	4124	
			6	4110	
			7	4099	
			8	4089	
			9	4080	
			10	4073	
			11	4067	
			12	4061	
			13	4056	
			14	4051	
			16	4048	
			17	4044	
			18	4042	
			19	4040	
			20	4039	
			21	4037	
			22	4036	
			23	4035	
			24	4034	
			25	4033	
			27	4031	
			28	4028	
			29	4024	
			30	4019	
			31	4012	
			32	4004	
			33	3996	
			34	3988	
			35	3982	
			37	3974	
			38	3969	
			39	3962	
			40	3955	
			41	3947	
			42	3939	
			43	3929	
			44	3919	
			45	3908	
			47	3898	
			48	3891	
			49	3888	
			50	3881	
			51	3877	
			52	3874	
			53	3872	
			54	3869	
			55	3866	
			57	3862	
			58	3858	
			59	3855	
			60	3851	
			61	3847	
			62	3843	
			63	3840	
			64	3836	
			65	3832	
			67	3828	
			68	3824	
			69	3820	
			70	3816	
			71	3812	
			72	3807	
			73	3803	
			74	3798	
			75	3792	
			76	3787	
			78	3781	
			79	3775	
			80	3768	
			81	3761	
            82	3755
			83	3748	
			84	3742	
			85	3734	
			86	3725	
			88	3717	
			89	3707	
			90	3696	
			91	3692	
			92	3691	
			93	3690	
			94	3689	
			95	3688	
			96	3685	
			98	3681	
			99	3659	
			100	3613	
			101	3549	
			102	3462
	>;

	r_profile_t0_num = <93>;
	r_profile_t0 = <
	        74  4191
	        74  4171
	        74  4153
	        74  4138
	        74  4124
	        74  4110
	        74  4099
	        74  4089
	        74  4080
	        74  4073
	        74  4067
	        74  4061
	        74  4056
	        74  4051
	        74  4048
	        74  4044
	        74  4042
	        74  4040
	        74  4039
	        74  4037
	        74  4036
	        74  4035
	        74  4034
	        74  4033
	        74  4031
	        74  4028
	        74  4024
	        74  4019
	        74  4012
	        74  4004
	        74  3996
	        74  3988
	        74  3982
	        74  3974
	        74  3969
	        74  3962
	        74  3955
	        74  3947
	        74  3939
	        74  3929
	        74  3919
	        74  3908
	        74  3898
	        74  3891
	        74  3888
	        74  3881
	        74  3877
	        74  3874
	        74  3872
	        74  3869
	        74  3866
	        74  3862
	        74  3858
	        74  3855
	        74  3851
	        74  3847
	        74  3843
	        74  3840
	        74  3836
	        74  3832
	        74  3828
	        74  3824
	        74  3820
	        74  3816
	        74  3812
	        74  3807
	        74  3803
	        74  3798
	        74  3792
	        74  3787
	        74  3781
	        74  3775
	        74  3768
	        74  3761
	        74  3755
	        74  3748
	        74  3742
	        74  3734
	        74  3725
	        74  3717
	        74  3707
	        74  3696
	        74  3692
	        74  3691
	        74  3690
	        74  3689
	        74  3688
	        74  3685
	        74  3681
	        74  3659
	        74  3613
	        74  3549
	        74  3462
	>;

	r_profile_t1_num = <93>;
	r_profile_t1 = <
			74  4191
	        74  4171
	        74  4153
	        74  4138
	        74  4124
	        74  4110
	        74  4099
	        74  4089
	        74  4080
	        74  4073
	        74  4067
	        74  4061
	        74  4056
	        74  4051
	        74  4048
	        74  4044
	        74  4042
	        74  4040
	        74  4039
	        74  4037
	        74  4036
	        74  4035
	        74  4034
	        74  4033
	        74  4031
	        74  4028
	        74  4024
	        74  4019
	        74  4012
	        74  4004
	        74  3996
	        74  3988
	        74  3982
	        74  3974
	        74  3969
	        74  3962
	        74  3955
	        74  3947
	        74  3939
	        74  3929
	        74  3919
	        74  3908
	        74  3898
	        74  3891
	        74  3888
	        74  3881
	        74  3877
	        74  3874
	        74  3872
	        74  3869
	        74  3866
	        74  3862
	        74  3858
	        74  3855
	        74  3851
	        74  3847
	        74  3843
	        74  3840
	        74  3836
	        74  3832
	        74  3828
	        74  3824
	        74  3820
	        74  3816
	        74  3812
	        74  3807
	        74  3803
	        74  3798
	        74  3792
	        74  3787
	        74  3781
	        74  3775
	        74  3768
	        74  3761
	        74  3755
	        74  3748
	        74  3742
	        74  3734
	        74  3725
	        74  3717
	        74  3707
	        74  3696
	        74  3692
	        74  3691
	        74  3690
	        74  3689
	        74  3688
	        74  3685
	        74  3681
	        74  3659
	        74  3613
	        74  3549
	        74  3462>;

	r_profile_t2_num = <93>;
	r_profile_t2 = <	        
			74  4191
	        74  4171
	        74  4153
	        74  4138
	        74  4124
	        74  4110
	        74  4099
	        74  4089
	        74  4080
	        74  4073
	        74  4067
	        74  4061
	        74  4056
	        74  4051
	        74  4048
	        74  4044
	        74  4042
	        74  4040
	        74  4039
	        74  4037
	        74  4036
	        74  4035
	        74  4034
	        74  4033
	        74  4031
	        74  4028
	        74  4024
	        74  4019
	        74  4012
	        74  4004
	        74  3996
	        74  3988
	        74  3982
	        74  3974
	        74  3969
	        74  3962
	        74  3955
	        74  3947
	        74  3939
	        74  3929
	        74  3919
	        74  3908
	        74  3898
	        74  3891
	        74  3888
	        74  3881
	        74  3877
	        74  3874
	        74  3872
	        74  3869
	        74  3866
	        74  3862
	        74  3858
	        74  3855
	        74  3851
	        74  3847
	        74  3843
	        74  3840
	        74  3836
	        74  3832
	        74  3828
	        74  3824
	        74  3820
	        74  3816
	        74  3812
	        74  3807
	        74  3803
	        74  3798
	        74  3792
	        74  3787
	        74  3781
	        74  3775
	        74  3768
	        74  3761
	        74  3755
	        74  3748
	        74  3742
	        74  3734
	        74  3725
	        74  3717
	        74  3707
	        74  3696
	        74  3692
	        74  3691
	        74  3690
	        74  3689
	        74  3688
	        74  3685
	        74  3681
	        74  3659
	        74  3613
	        74  3549
	        74  3462>;
	r_profile_t3_num = <93>;
	r_profile_t3 = <	        
			74  4191
	        74  4171
	        74  4153
	        74  4138
	        74  4124
	        74  4110
	        74  4099
	        74  4089
	        74  4080
	        74  4073
	        74  4067
	        74  4061
	        74  4056
	        74  4051
	        74  4048
	        74  4044
	        74  4042
	        74  4040
	        74  4039
	        74  4037
	        74  4036
	        74  4035
	        74  4034
	        74  4033
	        74  4031
	        74  4028
	        74  4024
	        74  4019
	        74  4012
	        74  4004
	        74  3996
	        74  3988
	        74  3982
	        74  3974
	        74  3969
	        74  3962
	        74  3955
	        74  3947
	        74  3939
	        74  3929
	        74  3919
	        74  3908
	        74  3898
	        74  3891
	        74  3888
	        74  3881
	        74  3877
	        74  3874
	        74  3872
	        74  3869
	        74  3866
	        74  3862
	        74  3858
	        74  3855
	        74  3851
	        74  3847
	        74  3843
	        74  3840
	        74  3836
	        74  3832
	        74  3828
	        74  3824
	        74  3820
	        74  3816
	        74  3812
	        74  3807
	        74  3803
	        74  3798
	        74  3792
	        74  3787
	        74  3781
	        74  3775
	        74  3768
	        74  3761
	        74  3755
	        74  3748
	        74  3742
	        74  3734
	        74  3725
	        74  3717
	        74  3707
	        74  3696
	        74  3692
	        74  3691
	        74  3690
	        74  3689
	        74  3688
	        74  3685
	        74  3681
	        74  3659
	        74  3613
	        74  3549
	        74  3462>;
};
