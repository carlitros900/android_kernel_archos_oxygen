/*************************
 * Customized Battery Setting dtsi file
*************************/
&bat_comm {
	gpio22_dc_det = <&pio 22 0>;
	gpio85_set_chr_set = <&pio 85 0>;
	gpio28_spec_cur_select = <&pio 28 0>;
	/* cust_charging.h */
	/* stop charging while in talking mode */
	stop_charging_in_takling = <1>;
	talking_recharge_voltage = <3800>;
	talking_sync_time = <60>;

	/* Battery Temperature Protection */
	mtk_temperature_recharge_support = <1>;
	max_charge_temperature = <50>;
	max_charge_temperature_minus_x_degree = <47>;
	min_charge_temperature = <0>;
	min_charge_temperature_plus_x_degree = <6>;
	err_charge_temperature = <0xff>;

	/* Linear Charging Threshold */
	v_pre2cc_thres = <3400>;	/* unit: mV */
	v_cc2topoff_thres = <4050>;
	recharging_voltage = <4110>;
	charging_full_current = <80>;	/* unit: mA */

	/* Charging Current Setting */
	config_usb_if = <0>;
	usb_charger_current_suspend = <0>;	/* Unit: 0.01 mA */
	usb_charger_current_unconfigured = <7000>;	/* Unit: 0.01 mA */
	usb_charger_current_configured = <50000>;	/* Unit: 0.01 mA */
	usb_charger_current = <140000>;	/* Unit: 0.01 mA */
	ac_charger_current = <140000>;	/* Unit: 0.01 mA */
	non_std_ac_charger_current = <140000>;	/* Unit: 0.01 mA */
	charging_host_charger_current = <65000>;	/* Unit: 0.01 mA */
	apple_0_5a_charger_current = <50000>;	/* Unit: 0.01 mA */
	apple_1_0a_charger_current = <65000>;	/* Unit: 0.01 mA */
	apple_2_1a_charger_current = <50000>;	/* Unit: 0.01 mA */

	/* charger error check */
	bat_low_temp_protect_enable = <0>;
	v_charger_enable = <0>;	/* 1:on , 0:off */
	v_charger_max = <6500>;	/* unit: mV */
	v_charger_min = <4400>;

	/*  Tracking TIME */
	onehundred_percent_tracking_time = <1800>;	/* Unit: second */
	npercent_tracking_time = <200>;	/* Unit: second */
	sync_to_real_tracking_time = <300>;	/* Unit: second */
	v_0percent_tracking = <3470>;	/* Unit: mV */

	/* High battery support */
	high_battery_voltage_support = <0>;
};

&bat_meter {
	/* cust_battery_meter.h */
	/* ADC resistor  */
	r_bat_sense = <4>;
	r_i_sense = <4>;
	r_charger_1 = <330>;
	r_charger_2 = <39>;
	temperature_t0 = <110>;
	temperature_t1 = <0>;
	temperature_t2 = <25>;
	temperature_t3 = <50>;
	temperature_t = <255>;	/* this should be fixed, never change the value */
	fg_meter_resistance = <0>;

	/* Qmax for 0mA */
	q_max_pos_50 = <4185>;
	q_max_pos_25 = <4185>;
	q_max_pos_0 = <4185>;
	q_max_neg_10 = <4185>;
	/* Qmax for 600mA, said high current */
	q_max_pos_50_h_current = <4099>;
	q_max_pos_25_h_current = <4099>;
	q_max_pos_0_h_current = <4099>;
	q_max_neg_10_h_current = <4099>;
	/* Discharge percentage, 1: D5, 0: D2 */
	oam_d5 = <1>;

	change_tracking_point = <1>;
	/* SW OCV tracking setting */
	cust_tracking_point = <14>;
	cust_r_sense = <200>;
	cust_hw_cc = <0>;
	aging_tuning_value = <100>;
	cust_r_fg_offset = <0>;
	ocv_board_compesate = <0>;
	r_fg_board_base = <1000>;
	r_fg_board_slope = <1000>;
	car_tune_value = <89>;

	/* HW Fuel gague  */
	current_detect_r_fg = <10>;	/* Unit: mA */
	minerroroffset = <1000>;
	fg_vbat_average_size = <18>;
	r_fg_value = <20>;	/* Unit: mOhm */

	cust_poweron_delta_capacity_tolrance = <80>;
	cust_poweron_low_capacity_tolrance = <0>;
	cust_poweron_max_vbat_tolrance = <70>;
	cust_poweron_delta_vbat_tolrance = <60>;
	cust_poweron_delta_hw_sw_ocv_capacity_tolrance = <10>;

	/* Fixed battery temperature */
	fixed_tbat_25 = <1>;
	/* Dynamic change wake up period of battery thread when suspend */
	vbat_normal_wakeup = <3600>;	/* Unit: mV */
	vbat_low_power_wakeup = <3500>;	/* Unit: mV */
	normal_wakeup_period = <5400>;	/* Unit: second */
	low_power_wakeup_period = <300>;	/* Unit: second */
	close_poweroff_wakeup_period = <30>;	/* Unit: second */

	rbat_pull_up_r = <16900>;
	rbat_pull_up_volt = <1800>;

	batt_temperature_table_num = <17>;
	batt_temperature_table = <
			    (-20) 75022
			    (-15) 57926
			    (-10) 45168
			    (-5) 35548
			    0 28224
			    5 22595
			    10 18231
			    15 14820
			    20 12133
			    25 10000 30 8295 35 6922 40 5810 45 4903 50 4160 55 3547 60 3039>;

	battery_profile_t0_num = <97>;
	battery_profile_t0 = <0  	   4193		
				1	   4180
				2	   4168
				3	   4157
				4	   4146
				5	   4135
				6	   4125
				8	   4115
				9	   4105
				10	   4095
				11	   4086
				12	   4078
				13	   4070
				14	   4063
				15	   4054
				16	   4046
				17	   4039
				18	   4034
				19	   4027
				20	   4019
				22	   4011
				23	   4003
				24	   3995
				25	   3988
				26	   3981
				27	   3974
				28	   3969
				29	   3962
				30	   3955
				31	   3949
				32	   3943
				33	   3936
				34	   3929
				35	   3924
				37	   3918
				38	   3912
				39	   3906
				40	   3900
				41	   3893
				42	   3886
				43	   3878
				44	   3868
				45	   3859
				46	   3851
				47	   3846
				48	   3838
				49	   3833
				51	   3828
				52	   3823
				53	   3819
				54	   3815
				55	   3812
				56	   3808
                57	   3805
                58	   3802
                59	   3798
                60	   3796
                61	   3793
                62	   3790
                63	   3788
                65	   3786
                66	   3784
                67	   3781
                68	   3780
                69	   3777
                70	   3776
                71	   3775
                72	   3774
                73	   3772
                74	   3771
                75	   3769
                76	   3766
                77	   3764
                78	   3760
                80	   3756
                81	   3752
                82	   3747
                83	   3744
                84	   3740
                85	   3734
                86	   3727
                87	   3718
                88	   3712
                89	   3702
				90	   3693
				91	   3690
				92	   3688
				94	   3687
				95	   3686
				96	   3684
				97	   3681
				98	   3676
				99	   3664
				100    3630
				101    3578
				102    3511
				103    3418 >;

	battery_profile_t1_num = <97>;
	battery_profile_t1 = <0  	   4193		
				1	   4180
				2	   4168
				3	   4157
				4	   4146
				5	   4135
				6	   4125
				8	   4115
				9	   4105
				10	   4095
				11	   4086
				12	   4078
				13	   4070
				14	   4063
				15	   4054
				16	   4046
				17	   4039
				18	   4034
				19	   4027
				20	   4019
				22	   4011
				23	   4003
				24	   3995
				25	   3988
				26	   3981
				27	   3974
				28	   3969
				29	   3962
				30	   3955
				31	   3949
				32	   3943
				33	   3936
				34	   3929
				35	   3924
				37	   3918
				38	   3912
				39	   3906
				40	   3900
				41	   3893
				42	   3886
				43	   3878
				44	   3868
				45	   3859
				46	   3851
				47	   3846
				48	   3838
				49	   3833
				51	   3828
				52	   3823
				53	   3819
				54	   3815
				55	   3812
				56	   3808
                57	   3805
                58	   3802
                59	   3798
                60	   3796
                61	   3793
                62	   3790
                63	   3788
                65	   3786
                66	   3784
                67	   3781
                68	   3780
                69	   3777
                70	   3776
                71	   3775
                72	   3774
                73	   3772
                74	   3771
                75	   3769
                76	   3766
                77	   3764
                78	   3760
                80	   3756
                81	   3752
                82	   3747
                83	   3744
                84	   3740
                85	   3734
                86	   3727
                87	   3718
                88	   3712
                89	   3702
				90	   3693
				91	   3690
				92	   3688
				94	   3687
				95	   3686
				96	   3684
				97	   3681
				98	   3676
				99	   3664
				100    3630
				101    3578
				102    3511
				103    3418 >;

	battery_profile_t2_num = <97>;
	battery_profile_t2 = <0  	   4193		
				1	   4180
				2	   4168
				3	   4157
				4	   4146
				5	   4135
				6	   4125
				8	   4115
				9	   4105
				10	   4095
				11	   4086
				12	   4078
				13	   4070
				14	   4063
				15	   4054
				16	   4046
				17	   4039
				18	   4034
				19	   4027
				20	   4019
				22	   4011
				23	   4003
				24	   3995
				25	   3988
				26	   3981
				27	   3974
				28	   3969
				29	   3962
				30	   3955
				31	   3949
				32	   3943
				33	   3936
				34	   3929
				35	   3924
				37	   3918
				38	   3912
				39	   3906
				40	   3900
				41	   3893
				42	   3886
				43	   3878
				44	   3868
				45	   3859
				46	   3851
				47	   3846
				48	   3838
				49	   3833
				51	   3828
				52	   3823
				53	   3819
				54	   3815
				55	   3812
				56	   3808
                57	   3805
                58	   3802
                59	   3798
                60	   3796
                61	   3793
                62	   3790
                63	   3788
                65	   3786
                66	   3784
                67	   3781
                68	   3780
                69	   3777
                70	   3776
                71	   3775
                72	   3774
                73	   3772
                74	   3771
                75	   3769
                76	   3766
                77	   3764
                78	   3760
                80	   3756
                81	   3752
                82	   3747
                83	   3744
                84	   3740
                85	   3734
                86	   3727
                87	   3718
                88	   3712
                89	   3702
				90	   3693
				91	   3690
				92	   3688
				94	   3687
				95	   3686
				96	   3684
				97	   3681
				98	   3676
				99	   3664
				100    3630
				101    3578
				102    3511
				103    3418 >;
  
   
	battery_profile_t3_num = <97>;
	battery_profile_t3 = <0  	   4193		
				1	   4180
				2	   4168
				3	   4157
				4	   4146
				5	   4135
				6	   4125
				8	   4115
				9	   4105
				10	   4095
				11	   4086
				12	   4078
				13	   4070
				14	   4063
				15	   4054
				16	   4046
				17	   4039
				18	   4034
				19	   4027
				20	   4019
				22	   4011
				23	   4003
				24	   3995
				25	   3988
				26	   3981
				27	   3974
				28	   3969
				29	   3962
				30	   3955
				31	   3949
				32	   3943
				33	   3936
				34	   3929
				35	   3924
				37	   3918
				38	   3912
				39	   3906
				40	   3900
				41	   3893
				42	   3886
				43	   3878
				44	   3868
				45	   3859
				46	   3851
				47	   3846
				48	   3838
				49	   3833
				51	   3828
				52	   3823
				53	   3819
				54	   3815
				55	   3812
				56	   3808
                57	   3805
                58	   3802
                59	   3798
                60	   3796
                61	   3793
                62	   3790
                63	   3788
                65	   3786
                66	   3784
                67	   3781
                68	   3780
                69	   3777
                70	   3776
                71	   3775
                72	   3774
                73	   3772
                74	   3771
                75	   3769
                76	   3766
                77	   3764
                78	   3760
                80	   3756
                81	   3752
                82	   3747
                83	   3744
                84	   3740
                85	   3734
                86	   3727
                87	   3718
                88	   3712
                89	   3702
				90	   3693
				91	   3690
				92	   3688
				94	   3687
				95	   3686
				96	   3684
				97	   3681
				98	   3676
				99	   3664
				100    3630
				101    3578
				102    3511
				103    3418 >;



	r_profile_t0_num = <97>;
	r_profile_t0 = <				
				99	  4193
				99	  4180
				99	  4168
				101	  4157
				101	  4146
				101	  4135
				101	  4125
				101	  4115
				102	  4105
				102	  4095
				102	  4086
				103	  4078
				103	  4070
				106	  4063
				104	  4054
				106	  4046
				107	  4039
				110	  4034
				109	  4027
				108	  4019
				108	  4011
				108	  4003
				108	  3995
				110	  3988
				109	  3981
				109	  3974
				110	  3969
				110	  3962
				112	  3955
				112	  3949
				114	  3943
				114	  3936
				114	  3929
				117	  3924
				118	  3918
				118	  3912
				118	  3906
				118	  3900
				118	  3893
				117	  3886
				114	  3878
				110	  3868
				107	  3859
				106	  3851
				106	  3846
				100	  3838
				101	  3833
				102	  3828
				101	  3823
				100	  3819
				99	  3815
                100	  3812
                100	  3808
                100	  3805
                101	  3802
                100	  3798
                101	  3796
                102	  3793
                102	  3790
                102	  3788
                103	  3786
                103	  3784
                103	  3781
                104	  3780
                103	  3777
                104	  3776
                104	  3775
                104	  3774
                104	  3772
                104	  3771
                104	  3769
                103	  3766
                104	  3764
                102	  3760
                102	  3756
                101	  3752
                101	  3747
                102	  3744
                103	  3740
                103	  3734
                103	  3727
                101	  3718
				104   3712
				102   3702
				101   3693
				101   3690
				101   3688
				103   3687
				106   3686
				108   3684
				110   3681
				113   3676
				116   3664
				112   3630
				113   3578
				120   3511
				129   3418 >;
        
	r_profile_t1_num = <97>;
	r_profile_t1 = <				
				99	  4193
				99	  4180
				99	  4168
				101	  4157
				101	  4146
				101	  4135
				101	  4125
				101	  4115
				102	  4105
				102	  4095
				102	  4086
				103	  4078
				103	  4070
				106	  4063
				104	  4054
				106	  4046
				107	  4039
				110	  4034
				109	  4027
				108	  4019
				108	  4011
				108	  4003
				108	  3995
				110	  3988
				109	  3981
				109	  3974
				110	  3969
				110	  3962
				112	  3955
				112	  3949
				114	  3943
				114	  3936
				114	  3929
				117	  3924
				118	  3918
				118	  3912
				118	  3906
				118	  3900
				118	  3893
				117	  3886
				114	  3878
				110	  3868
				107	  3859
				106	  3851
				106	  3846
				100	  3838
				101	  3833
				102	  3828
				101	  3823
				100	  3819
				99	  3815
                100	  3812
                100	  3808
                100	  3805
                101	  3802
                100	  3798
                101	  3796
                102	  3793
                102	  3790
                102	  3788
                103	  3786
                103	  3784
                103	  3781
                104	  3780
                103	  3777
                104	  3776
                104	  3775
                104	  3774
                104	  3772
                104	  3771
                104	  3769
                103	  3766
                104	  3764
                102	  3760
                102	  3756
                101	  3752
                101	  3747
                102	  3744
                103	  3740
                103	  3734
                103	  3727
                101	  3718
				104   3712
				102   3702
				101   3693
				101   3690
				101   3688
				103   3687
				106   3686
				108   3684
				110   3681
				113   3676
				116   3664
				112   3630
				113   3578
				120   3511
				129   3418 >;
 
 
 
	r_profile_t2_num = <97>;
	r_profile_t2 = <				
				99	  4193
				99	  4180
				99	  4168
				101	  4157
				101	  4146
				101	  4135
				101	  4125
				101	  4115
				102	  4105
				102	  4095
				102	  4086
				103	  4078
				103	  4070
				106	  4063
				104	  4054
				106	  4046
				107	  4039
				110	  4034
				109	  4027
				108	  4019
				108	  4011
				108	  4003
				108	  3995
				110	  3988
				109	  3981
				109	  3974
				110	  3969
				110	  3962
				112	  3955
				112	  3949
				114	  3943
				114	  3936
				114	  3929
				117	  3924
				118	  3918
				118	  3912
				118	  3906
				118	  3900
				118	  3893
				117	  3886
				114	  3878
				110	  3868
				107	  3859
				106	  3851
				106	  3846
				100	  3838
				101	  3833
				102	  3828
				101	  3823
				100	  3819
				99	  3815
                100	  3812
                100	  3808
                100	  3805
                101	  3802
                100	  3798
                101	  3796
                102	  3793
                102	  3790
                102	  3788
                103	  3786
                103	  3784
                103	  3781
                104	  3780
                103	  3777
                104	  3776
                104	  3775
                104	  3774
                104	  3772
                104	  3771
                104	  3769
                103	  3766
                104	  3764
                102	  3760
                102	  3756
                101	  3752
                101	  3747
                102	  3744
                103	  3740
                103	  3734
                103	  3727
                101	  3718
				104   3712
				102   3702
				101   3693
				101   3690
				101   3688
				103   3687
				106   3686
				108   3684
				110   3681
				113   3676
				116   3664
				112   3630
				113   3578
				120   3511
				129   3418 >;
  
  
  
  
	r_profile_t3_num = <97>;
	r_profile_t3 = <				
				99	  4193
				99	  4180
				99	  4168
				101	  4157
				101	  4146
				101	  4135
				101	  4125
				101	  4115
				102	  4105
				102	  4095
				102	  4086
				103	  4078
				103	  4070
				106	  4063
				104	  4054
				106	  4046
				107	  4039
				110	  4034
				109	  4027
				108	  4019
				108	  4011
				108	  4003
				108	  3995
				110	  3988
				109	  3981
				109	  3974
				110	  3969
				110	  3962
				112	  3955
				112	  3949
				114	  3943
				114	  3936
				114	  3929
				117	  3924
				118	  3918
				118	  3912
				118	  3906
				118	  3900
				118	  3893
				117	  3886
				114	  3878
				110	  3868
				107	  3859
				106	  3851
				106	  3846
				100	  3838
				101	  3833
				102	  3828
				101	  3823
				100	  3819
				99	  3815
                100	  3812
                100	  3808
                100	  3805
                101	  3802
                100	  3798
                101	  3796
                102	  3793
                102	  3790
                102	  3788
                103	  3786
                103	  3784
                103	  3781
                104	  3780
                103	  3777
                104	  3776
                104	  3775
                104	  3774
                104	  3772
                104	  3771
                104	  3769
                103	  3766
                104	  3764
                102	  3760
                102	  3756
                101	  3752
                101	  3747
                102	  3744
                103	  3740
                103	  3734
                103	  3727
                101	  3718
				104   3712
				102   3702
				101   3693
				101   3690
				101   3688
				103   3687
				106   3686
				108   3684
				110   3681
				113   3676
				116   3664
				112   3630
				113   3578
				120   3511
				129   3418 >;			
};
