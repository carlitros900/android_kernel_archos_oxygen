/*************************
 * Customized Battery Setting dtsi file
*************************/
&bat_comm {
	gpio22_dc_det = <&pio 22 0>;
	gpio85_set_chr_set = <&pio 85 0>;
	gpio28_spec_cur_select = <&pio 28 0>;
	/* cust_charging.h */
	/* stop charging while in talking mode */
	stop_charging_in_takling = <1>;
	talking_recharge_voltage = <3800>;
	talking_sync_time = <60>;

	/* Battery Temperature Protection */
	mtk_temperature_recharge_support = <1>;
	max_charge_temperature = <50>;
	max_charge_temperature_minus_x_degree = <47>;
	min_charge_temperature = <0>;
	min_charge_temperature_plus_x_degree = <6>;
	err_charge_temperature = <0xff>;

	/* Linear Charging Threshold */
	v_pre2cc_thres = <3400>;	/* unit: mV */
	v_cc2topoff_thres = <4050>;
	recharging_voltage = <4110>;
	charging_full_current = <80>;	/* unit: mA */

	/* Charging Current Setting */
	config_usb_if = <0>;
	usb_charger_current_suspend = <0>;	/* Unit: 0.01 mA */
	usb_charger_current_unconfigured = <7000>;	/* Unit: 0.01 mA */
	usb_charger_current_configured = <50000>;	/* Unit: 0.01 mA */
	usb_charger_current = <120000>;	/* Unit: 0.01 mA */
	ac_charger_current = <120000>;	/* Unit: 0.01 mA */
	non_std_ac_charger_current = <50000>;	/* Unit: 0.01 mA */
	charging_host_charger_current = <65000>;	/* Unit: 0.01 mA */
	apple_0_5a_charger_current = <50000>;	/* Unit: 0.01 mA */
	apple_1_0a_charger_current = <65000>;	/* Unit: 0.01 mA */
	apple_2_1a_charger_current = <80000>;	/* Unit: 0.01 mA */

	/* charger error check */
	bat_low_temp_protect_enable = <0>;
	v_charger_enable = <0>;	/* 1:on , 0:off */
	v_charger_max = <6500>;	/* unit: mV */
	v_charger_min = <4400>;

	/*  Tracking TIME */
	onehundred_percent_tracking_time = <1800>;	/* Unit: second */
	npercent_tracking_time = <200>;	/* Unit: second */
	sync_to_real_tracking_time = <300>;	/* Unit: second */
	v_0percent_tracking = <3470>;	/* Unit: mV */

	/* High battery support */
	high_battery_voltage_support = <0>;
};

&bat_meter {
	/* cust_battery_meter.h */
	/* ADC resistor  */
	r_bat_sense = <4>;
	r_i_sense = <4>;
	r_charger_1 = <330>;
	r_charger_2 = <39>;
	temperature_t0 = <110>;
	temperature_t1 = <0>;
	temperature_t2 = <25>;
	temperature_t3 = <50>;
	temperature_t = <255>;	/* this should be fixed, never change the value */
	fg_meter_resistance = <0>;

	/* Qmax for 0mA */
	q_max_pos_50 = <8079>;
	q_max_pos_25 = <8079>;
	q_max_pos_0 = <8079>;
	q_max_neg_10 = <8079>;
	/* Qmax for 600mA, said high current */
	q_max_pos_50_h_current = <7871>;
	q_max_pos_25_h_current = <7871>;
	q_max_pos_0_h_current = <7871>;
	q_max_neg_10_h_current = <7871>;
	/* Discharge percentage, 1: D5, 0: D2 */
	oam_d5 = <1>;

	change_tracking_point = <1>;
	/* SW OCV tracking setting */
	cust_tracking_point = <14>;
	cust_r_sense = <200>;
	cust_hw_cc = <0>;
	aging_tuning_value = <100>;
	cust_r_fg_offset = <0>;
	ocv_board_compesate = <0>;
	r_fg_board_base = <1000>;
	r_fg_board_slope = <1000>;
	car_tune_value = <89>;

	/* HW Fuel gague  */
	current_detect_r_fg = <10>;	/* Unit: mA */
	minerroroffset = <1000>;
	fg_vbat_average_size = <18>;
	r_fg_value = <20>;	/* Unit: mOhm */

	cust_poweron_delta_capacity_tolrance = <80>;
	cust_poweron_low_capacity_tolrance = <0>;
	cust_poweron_max_vbat_tolrance = <70>;
	cust_poweron_delta_vbat_tolrance = <60>;
	cust_poweron_delta_hw_sw_ocv_capacity_tolrance = <10>;

	/* Fixed battery temperature */
	fixed_tbat_25 = <1>;
	/* Dynamic change wake up period of battery thread when suspend */
	vbat_normal_wakeup = <3600>;	/* Unit: mV */
	vbat_low_power_wakeup = <3500>;	/* Unit: mV */
	normal_wakeup_period = <5400>;	/* Unit: second */
	low_power_wakeup_period = <300>;	/* Unit: second */
	close_poweroff_wakeup_period = <30>;	/* Unit: second */

	rbat_pull_up_r = <16900>;
	rbat_pull_up_volt = <1800>;

	batt_temperature_table_num = <17>;
	batt_temperature_table = <
			    (-20) 75022
			    (-15) 57926
			    (-10) 45168
			    (-5) 35548
			    0 28224
			    5 22595
			    10 18231
			    15 14820
			    20 12133
			    25 10000 30 8295 35 6922 40 5810 45 4903 50 4160 55 3547 60 3039>;

	battery_profile_t0_num = <95>;
	battery_profile_t0 = <
				0		4186
				1		4161
				2		4143
				3		4128
				4		4115
				5		4103
				7		4093
				8		4084
				9		4077
				10		4070
				11		4061
				12		4050
				13		4037
				14		4025
				15		4014
				16		4005
				18		3997
				19		3991
				20		3985
				21		3979
				22		3974
				23		3968
				24		3962
				25		3955
				26		3949
				27		3943
				29		3937
				30		3930
				31		3924
				32		3919
				33		3913
				34		3907
				35		3902
				36		3896
				37		3891
				38		3885
				40		3879
				41		3873
				42		3866
				43		3858
				44		3851
				45		3843
				46		3835
				47		3829
				48		3824
				49		3819
				51		3814
				52		3811
				53		3807
				54		3804
				55		3801
				56		3798
				57		3796
				58		3793
				59		3791
				60		3789
				62		3787
				63		3785
				64		3783
				65		3782
				66		3780
				67		3779
				68		3778
				69		3777
				70		3776
				71		3775
				73		3773
				74		3772
				75		3769
				76		3767
				77		3763
				78		3760
				79		3756
				80		3753
				81		3749
				82		3746
				84		3742
				85		3739
				86		3734
				87		3728
				88		3722
				89		3716
				90		3711
				91		3704
				92		3695
				93		3692
				95		3690
				96		3689
				97		3687
				98		3684
				99		3675
				100		3641
				101		3590
				102		3523
				103		3429
		>;

	battery_profile_t1_num = <95>;
	battery_profile_t1 = <
				0		4186
				1		4161
				2		4143
				3		4128
				4		4115
				5		4103
				7		4093
				8		4084
				9		4077
				10		4070
				11		4061
				12		4050
				13		4037
				14		4025
				15		4014
				16		4005
				18		3997
				19		3991
				20		3985
				21		3979
				22		3974
				23		3968
				24		3962
				25		3955
				26		3949
				27		3943
				29		3937
				30		3930
				31		3924
				32		3919
				33		3913
				34		3907
				35		3902
				36		3896
				37		3891
				38		3885
				40		3879
				41		3873
				42		3866
				43		3858
				44		3851
				45		3843
				46		3835
				47		3829
				48		3824
				49		3819
				51		3814
				52		3811
				53		3807
				54		3804
				55		3801
				56		3798
				57		3796
				58		3793
				59		3791
				60		3789
				62		3787
				63		3785
				64		3783
				65		3782
				66		3780
				67		3779
				68		3778
				69		3777
				70		3776
				71		3775
				73		3773
				74		3772
				75		3769
				76		3767
				77		3763
				78		3760
				79		3756
				80		3753
				81		3749
				82		3746
				84		3742
				85		3739
				86		3734
				87		3728
				88		3722
				89		3716
				90		3711
				91		3704
				92		3695
				93		3692
				95		3690
				96		3689
				97		3687
				98		3684
				99		3675
				100		3641
				101		3590
				102		3523
				103		3429
		>;

	battery_profile_t2_num = <95>;
	battery_profile_t2 = <
				0		4186
				1		4161
				2		4143
				3		4128
				4		4115
				5		4103
				7		4093
				8		4084
				9		4077
				10		4070
				11		4061
				12		4050
				13		4037
				14		4025
				15		4014
				16		4005
				18		3997
				19		3991
				20		3985
				21		3979
				22		3974
				23		3968
				24		3962
				25		3955
				26		3949
				27		3943
				29		3937
				30		3930
				31		3924
				32		3919
				33		3913
				34		3907
				35		3902
				36		3896
				37		3891
				38		3885
				40		3879
				41		3873
				42		3866
				43		3858
				44		3851
				45		3843
				46		3835
				47		3829
				48		3824
				49		3819
				51		3814
				52		3811
				53		3807
				54		3804
				55		3801
				56		3798
				57		3796
				58		3793
				59		3791
				60		3789
				62		3787
				63		3785
				64		3783
				65		3782
				66		3780
				67		3779
				68		3778
				69		3777
				70		3776
				71		3775
				73		3773
				74		3772
				75		3769
				76		3767
				77		3763
				78		3760
				79		3756
				80		3753
				81		3749
				82		3746
				84		3742
				85		3739
				86		3734
				87		3728
				88		3722
				89		3716
				90		3711
				91		3704
				92		3695
				93		3692
				95		3690
				96		3689
				97		3687
				98		3684
				99		3675
				100		3641
				101		3590
				102		3523
				103		3429
		>;
  
   
	battery_profile_t3_num = <95>;
	battery_profile_t3 = <
				0		4186
				1		4161
				2		4143
				3		4128
				4		4115
				5		4103
				7		4093
				8		4084
				9		4077
				10		4070
				11		4061
				12		4050
				13		4037
				14		4025
				15		4014
				16		4005
				18		3997
				19		3991
				20		3985
				21		3979
				22		3974
				23		3968
				24		3962
				25		3955
				26		3949
				27		3943
				29		3937
				30		3930
				31		3924
				32		3919
				33		3913
				34		3907
				35		3902
				36		3896
				37		3891
				38		3885
				40		3879
				41		3873
				42		3866
				43		3858
				44		3851
				45		3843
				46		3835
				47		3829
				48		3824
				49		3819
				51		3814
				52		3811
				53		3807
				54		3804
				55		3801
				56		3798
				57		3796
				58		3793
				59		3791
				60		3789
				62		3787
				63		3785
				64		3783
				65		3782
				66		3780
				67		3779
				68		3778
				69		3777
				70		3776
				71		3775
				73		3773
				74		3772
				75		3769
				76		3767
				77		3763
				78		3760
				79		3756
				80		3753
				81		3749
				82		3746
				84		3742
				85		3739
				86		3734
				87		3728
				88		3722
				89		3716
				90		3711
				91		3704
				92		3695
				93		3692
				95		3690
				96		3689
				97		3687
				98		3684
				99		3675
				100		3641
				101		3590
				102		3523
				103		3429
	>;



	r_profile_t0_num = <95>;
	r_profile_t0 = <				
				97		4186
				97		4161
				97		4143
				97		4128
				97		4115
				97		4103
				97		4093
				97		4084
				97		4077
				97		4070
				97		4061
				97		4050
				97		4037
				97		4025
				97		4014
				97		4005
				97		3997
				97		3991
				97		3985
				97		3979
				97		3974
				97		3968
				97		3962
				97		3955
				97		3949
				97		3943
				97		3937
				97		3930
				97		3924
				97		3919
				97		3913
				97		3907
				97		3902
				97		3896
				97		3891
				97		3885
				97		3879
				97		3873
				97		3866
				97		3858
				97		3851
				97		3843
				97		3835
				97		3829
				97		3824
				97		3819
				97		3814
				97		3811
				97		3807
				97		3804
				97		3801
				97		3798
				97		3796
				97		3793
				97		3791
				97		3789
				97		3787
				97		3785
				97		3783
				97		3782
				97		3780
				97		3779
				97		3778
				97		3777
				97		3776
				97		3775
				97		3773
				97		3772
				97		3769
				97		3767
				97		3763
				97		3760
				97		3756
				97		3753
				97		3749
				97		3746
				97		3742
				97		3739
				97		3734
				97		3728
				97		3722
				97		3716
				97		3711
				97		3704
				97		3695
				97		3692
				97		3690
				97		3689
				97		3687
				97		3684
				97		3675
				97		3641
				97		3590
				97		3523
				97		3429

	>;
        
	r_profile_t1_num = <95>;
	r_profile_t1 = <
				97		4186
				97		4161
				97		4143
				97		4128
				97		4115
				97		4103
				97		4093
				97		4084
				97		4077
				97		4070
				97		4061
				97		4050
				97		4037
				97		4025
				97		4014
				97		4005
				97		3997
				97		3991
				97		3985
				97		3979
				97		3974
				97		3968
				97		3962
				97		3955
				97		3949
				97		3943
				97		3937
				97		3930
				97		3924
				97		3919
				97		3913
				97		3907
				97		3902
				97		3896
				97		3891
				97		3885
				97		3879
				97		3873
				97		3866
				97		3858
				97		3851
				97		3843
				97		3835
				97		3829
				97		3824
				97		3819
				97		3814
				97		3811
				97		3807
				97		3804
				97		3801
				97		3798
				97		3796
				97		3793
				97		3791
				97		3789
				97		3787
				97		3785
				97		3783
				97		3782
				97		3780
				97		3779
				97		3778
				97		3777
				97		3776
				97		3775
				97		3773
				97		3772
				97		3769
				97		3767
				97		3763
				97		3760
				97		3756
				97		3753
				97		3749
				97		3746
				97		3742
				97		3739
				97		3734
				97		3728
				97		3722
				97		3716
				97		3711
				97		3704
				97		3695
				97		3692
				97		3690
				97		3689
				97		3687
				97		3684
				97		3675
				97		3641
				97		3590
				97		3523
				97		3429
	>;
 
 
 
	r_profile_t2_num = <95>;
	r_profile_t2 = <
				97		4186
				97		4161
				97		4143
				97		4128
				97		4115
				97		4103
				97		4093
				97		4084
				97		4077
				97		4070
				97		4061
				97		4050
				97		4037
				97		4025
				97		4014
				97		4005
				97		3997
				97		3991
				97		3985
				97		3979
				97		3974
				97		3968
				97		3962
				97		3955
				97		3949
				97		3943
				97		3937
				97		3930
				97		3924
				97		3919
				97		3913
				97		3907
				97		3902
				97		3896
				97		3891
				97		3885
				97		3879
				97		3873
				97		3866
				97		3858
				97		3851
				97		3843
				97		3835
				97		3829
				97		3824
				97		3819
				97		3814
				97		3811
				97		3807
				97		3804
				97		3801
				97		3798
				97		3796
				97		3793
				97		3791
				97		3789
				97		3787
				97		3785
				97		3783
				97		3782
				97		3780
				97		3779
				97		3778
				97		3777
				97		3776
				97		3775
				97		3773
				97		3772
				97		3769
				97		3767
				97		3763
				97		3760
				97		3756
				97		3753
				97		3749
				97		3746
				97		3742
				97		3739
				97		3734
				97		3728
				97		3722
				97		3716
				97		3711
				97		3704
				97		3695
				97		3692
				97		3690
				97		3689
				97		3687
				97		3684
				97		3675
				97		3641
				97		3590
				97		3523
				97		3429

	>;
  
  
  
  
	r_profile_t3_num = <95>;
	r_profile_t3 = <
				97		4186
				97		4161
				97		4143
				97		4128
				97		4115
				97		4103
				97		4093
				97		4084
				97		4077
				97		4070
				97		4061
				97		4050
				97		4037
				97		4025
				97		4014
				97		4005
				97		3997
				97		3991
				97		3985
				97		3979
				97		3974
				97		3968
				97		3962
				97		3955
				97		3949
				97		3943
				97		3937
				97		3930
				97		3924
				97		3919
				97		3913
				97		3907
				97		3902
				97		3896
				97		3891
				97		3885
				97		3879
				97		3873
				97		3866
				97		3858
				97		3851
				97		3843
				97		3835
				97		3829
				97		3824
				97		3819
				97		3814
				97		3811
				97		3807
				97		3804
				97		3801
				97		3798
				97		3796
				97		3793
				97		3791
				97		3789
				97		3787
				97		3785
				97		3783
				97		3782
				97		3780
				97		3779
				97		3778
				97		3777
				97		3776
				97		3775
				97		3773
				97		3772
				97		3769
				97		3767
				97		3763
				97		3760
				97		3756
				97		3753
				97		3749
				97		3746
				97		3742
				97		3739
				97		3734
				97		3728
				97		3722
				97		3716
				97		3711
				97		3704
				97		3695
				97		3692
				97		3690
				97		3689
				97		3687
				97		3684
				97		3675
				97		3641
				97		3590
				97		3523
				97		3429

	>;				
};
