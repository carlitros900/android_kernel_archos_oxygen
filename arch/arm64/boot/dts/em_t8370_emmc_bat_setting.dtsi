/*************************
 * Customized Battery Setting dtsi file
*************************/
&bat_comm {
	gpio22_dc_det = <&pio 22 0>;
	gpio85_set_chr_set = <&pio 85 0>;
	gpio28_spec_cur_select = <&pio 28 0>;
	/* cust_charging.h */
	/* stop charging while in talking mode */
	stop_charging_in_takling = <1>;
	talking_recharge_voltage = <3800>;
	talking_sync_time = <60>;

	/* Battery Temperature Protection */
	mtk_temperature_recharge_support = <1>;
	max_charge_temperature = <50>;
	max_charge_temperature_minus_x_degree = <47>;
	min_charge_temperature = <0>;
	min_charge_temperature_plus_x_degree = <6>;
	err_charge_temperature = <0xff>;

	/* Linear Charging Threshold */
	v_pre2cc_thres = <3400>;	/* unit: mV */
	v_cc2topoff_thres = <4050>;
	recharging_voltage = <4110>;
	charging_full_current = <80>;	/* unit: mA */

	/* Charging Current Setting */
	config_usb_if = <0>;
	usb_charger_current_suspend = <0>;	/* Unit: 0.01 mA */
	usb_charger_current_unconfigured = <7000>;	/* Unit: 0.01 mA */
	usb_charger_current_configured = <50000>;	/* Unit: 0.01 mA */
	usb_charger_current = <50000>;	/* Unit: 0.01 mA */
	ac_charger_current = <120000>;	/* Unit: 0.01 mA */
	non_std_ac_charger_current = <50000>;	/* Unit: 0.01 mA */
	charging_host_charger_current = <65000>;	/* Unit: 0.01 mA */
	apple_0_5a_charger_current = <50000>;	/* Unit: 0.01 mA */
	apple_1_0a_charger_current = <65000>;	/* Unit: 0.01 mA */
	apple_2_1a_charger_current = <80000>;	/* Unit: 0.01 mA */

	/* charger error check */
	bat_low_temp_protect_enable = <0>;
	v_charger_enable = <0>;	/* 1:on , 0:off */
	v_charger_max = <6500>;	/* unit: mV */
	v_charger_min = <4400>;

	/*  Tracking TIME */
	onehundred_percent_tracking_time = <10>;	/* Unit: second */
	npercent_tracking_time = <20>;	/* Unit: second */
	sync_to_real_tracking_time = <60>;	/* Unit: second */
	v_0percent_tracking = <3450>;	/* Unit: mV */

	/* High battery support */
	high_battery_voltage_support = <0>;
};

&bat_meter {
	/* cust_battery_meter.h */
	/* ADC resistor  */
	r_bat_sense = <4>;
	r_i_sense = <4>;
	r_charger_1 = <330>;
	r_charger_2 = <39>;
	temperature_t0 = <110>;
	temperature_t1 = <0>;
	temperature_t2 = <25>;
	temperature_t3 = <50>;
	temperature_t = <255>;	/* this should be fixed, never change the value */
	fg_meter_resistance = <0>;

	/* Qmax for 0mA */
	q_max_pos_50 = <2426>;
	q_max_pos_25 = <2426>;
	q_max_pos_0 = <2426>;
	q_max_neg_10 = <2426>;
	/* Qmax for 600mA, said high current */
	q_max_pos_50_h_current = <2235>;
	q_max_pos_25_h_current = <2235>;
	q_max_pos_0_h_current = <2235>;
	q_max_neg_10_h_current = <2235>;
	/* Discharge percentage, 1: D5, 0: D2 */
	oam_d5 = <1>;

	change_tracking_point = <1>;
	/* SW OCV tracking setting */
	cust_tracking_point = <14>;
	cust_r_sense = <200>;
	cust_hw_cc = <0>;
	aging_tuning_value = <100>;
	cust_r_fg_offset = <0>;
	ocv_board_compesate = <0>;
	r_fg_board_base = <1000>;
	r_fg_board_slope = <1000>;
	car_tune_value = <89>;

	/* HW Fuel gague  */
	current_detect_r_fg = <10>;	/* Unit: mA */
	minerroroffset = <1000>;
	fg_vbat_average_size = <18>;
	r_fg_value = <10>;	/* Unit: mOhm */

	cust_poweron_delta_capacity_tolrance = <80>;
	cust_poweron_low_capacity_tolrance = <5>;
	cust_poweron_max_vbat_tolrance = <70>;
	cust_poweron_delta_vbat_tolrance = <60>;
	cust_poweron_delta_hw_sw_ocv_capacity_tolrance = <10>;

	/* Fixed battery temperature */
	fixed_tbat_25 = <1>;
	/* Dynamic change wake up period of battery thread when suspend */
	vbat_normal_wakeup = <3600>;	/* Unit: mV */
	vbat_low_power_wakeup = <3500>;	/* Unit: mV */
	normal_wakeup_period = <5400>;	/* Unit: second */
	low_power_wakeup_period = <300>;	/* Unit: second */
	close_poweroff_wakeup_period = <30>;	/* Unit: second */

	rbat_pull_up_r = <16900>;
	rbat_pull_up_volt = <1800>;

	batt_temperature_table_num = <17>;
	batt_temperature_table = <
			    (-20) 75022
			    (-15) 57926
			    (-10) 45168
			    (-5) 35548
			    0 28224
			    5 22595
			    10 18231
			    15 14820
			    20 12133
			    25 10000 30 8295 35 6922 40 5810 45 4903 50 4160 55 3547 60 3039>;

	battery_profile_t0_num = <85>;
	battery_profile_t0 = <0 4193
				1 4177
				2 4165
				4 4153
				5 4140
				6 4128
				7 4116
				9 4106
				10 4095
				11 4084
				12 4075
				14 4066
				15 4055
				16 4045
				17 4034
				19 4022
				20 4012
				21 4003
				22 3994
				23 3986
				25 3979
				26 3972
				27 3964
				28 3958
				30 3948
				31 3942
				32 3935
				33 3927
				35 3921
				36 3915
				37 3907
				38 3899
				40 3890
				41 3880
				42 3869
				43 3860
				45 3851
				46 3845
				47 3838
				48 3833
				49 3826
				51 3820
				52 3817
				53 3813
				54 3807
				56 3805
				57 3802
				58 3798
				59 3796
				61 3793
				62 3790
				63 3787
				64 3784
				66 3783
				67 3781
				68 3778
				69 3777
				70 3775
				72 3771
				73 3769
				74 3765
				75 3762
				77 3759
				78 3755
				79 3750
				80 3746
				82 3741
				83 3738
				84 3732
				85 3726
				87 3717
				88 3710
				89 3701
				90 3692
				91 3689
				93 3687
				94 3686
				95 3684
				96 3682
				98 3676
				99 3645
				100 3594
				101 3524
				101 3424
				101 3316>;

	battery_profile_t1_num = <85>;
	battery_profile_t1 = <0 4193
				1 4177
				2 4165
				4 4153
				5 4140
				6 4128
				7 4116
				9 4106
				10 4095
				11 4084
				12 4075
				14 4066
				15 4055
				16 4045
				17 4034
				19 4022
				20 4012
				21 4003
				22 3994
				23 3986
				25 3979
				26 3972
				27 3964
				28 3958
				30 3948
				31 3942
				32 3935
				33 3927
				35 3921
				36 3915
				37 3907
				38 3899
				40 3890
				41 3880
				42 3869
				43 3860
				45 3851
				46 3845
				47 3838
				48 3833
				49 3826
				51 3820
				52 3817
				53 3813
				54 3807
				56 3805
				57 3802
				58 3798
				59 3796
				61 3793
				62 3790
				63 3787
				64 3784
				66 3783
				67 3781
				68 3778
				69 3777
				70 3775
				72 3771
				73 3769
				74 3765
				75 3762
				77 3759
				78 3755
				79 3750
				80 3746
				82 3741
				83 3738
				84 3732
				85 3726
				87 3717
				88 3710
				89 3701
				90 3692
				91 3689
				93 3687
				94 3686
				95 3684
				96 3682
				98 3676
				99 3645
				100 3594
				101 3524
				101 3424
				101 3316>;

	battery_profile_t2_num = <85>;
	battery_profile_t2 = <0 4193
				1 4177
				2 4165
				4 4153
				5 4140
				6 4128
				7 4116
				9 4106
				10 4095
				11 4084
				12 4075
				14 4066
				15 4055
				16 4045
				17 4034
				19 4022
				20 4012
				21 4003
				22 3994
				23 3986
				25 3979
				26 3972
				27 3964
				28 3958
				30 3948
				31 3942
				32 3935
				33 3927
				35 3921
				36 3915
				37 3907
				38 3899
				40 3890
				41 3880
				42 3869
				43 3860
				45 3851
				46 3845
				47 3838
				48 3833
				49 3826
				51 3820
				52 3817
				53 3813
				54 3807
				56 3805
				57 3802
				58 3798
				59 3796
				61 3793
				62 3790
				63 3787
				64 3784
				66 3783
				67 3781
				68 3778
				69 3777
				70 3775
				72 3771
				73 3769
				74 3765
				75 3762
				77 3759
				78 3755
				79 3750
				80 3746
				82 3741
				83 3738
				84 3732
				85 3726
				87 3717
				88 3710
				89 3701
				90 3692
				91 3689
				93 3687
				94 3686
				95 3684
				96 3682
				98 3676
				99 3645
				100 3594
				101 3524
				101 3424
				101 3316>;


	battery_profile_t3_num = <85>;
	battery_profile_t3 = <0 4193
				1 4177
				2 4165
				4 4153
				5 4140
				6 4128
				7 4116
				9 4106
				10 4095
				11 4084
				12 4075
				14 4066
				15 4055
				16 4045
				17 4034
				19 4022
				20 4012
				21 4003
				22 3994
				23 3986
				25 3979
				26 3972
				27 3964
				28 3958
				30 3948
				31 3942
				32 3935
				33 3927
				35 3921
				36 3915
				37 3907
				38 3899
				40 3890
				41 3880
				42 3869
				43 3860
				45 3851
				46 3845
				47 3838
				48 3833
				49 3826
				51 3820
				52 3817
				53 3813
				54 3807
				56 3805
				57 3802
				58 3798
				59 3796
				61 3793
				62 3790
				63 3787
				64 3784
				66 3783
				67 3781
				68 3778
				69 3777
				70 3775
				72 3771
				73 3769
				74 3765
				75 3762
				77 3759
				78 3755
				79 3750
				80 3746
				82 3741
				83 3738
				84 3732
				85 3726
				87 3717
				88 3710
				89 3701
				90 3692
				91 3689
				93 3687
				94 3686
				95 3684
				96 3682
				98 3676
				99 3645
				100 3594
				101 3524
				101 3424
				101 3316>;

	r_profile_t0_num = <85>;
	r_profile_t0 = <137 4193
				137 4177
				142 4165
				138 4153
				143 4140
				147 4128
				139 4116
				147 4106
				148 4095
				140 4084
				152 4075
				153 4066
				141 4055
				155 4045
				158 4034
				142 4022
				158 4012
				157 4003
				143 3994
				158 3986
				158 3979
				144 3972
				158 3964
				163 3958
				145 3948
				162 3942
				165 3935
				146 3927
				168 3921
				168 3915
				147 3907
				167 3899
				162 3890
				148 3880
				152 3869
				152 3860
				149 3851
				148 3845
				147 3838
				150 3833
				142 3826
				142 3820
				151 3817
				145 3813
				140 3807
				152 3805
				148 3802
				147 3798
				153 3796
				148 3793
				148 3790
				154 3787
				148 3784
				152 3783
				155 3781
				148 3778
				152 3777
				156 3775
				147 3771
				148 3769
				157 3765
				143 3762
				147 3759
				158 3755
				142 3750
				145 3746
				159 3741
				148 3738
				148 3732
				160 3726
				145 3717
				147 3710
				161 3701
				143 3692
				145 3689
				162 3687
				153 3686
				160 3684
				163 3682
				173 3676
				162 3645
				164 3594
				168 3524
				180 3424
				165 3316>;

	r_profile_t1_num = <85>;
	r_profile_t1 = <137 4193
				137 4177
				142 4165
				138 4153
				143 4140
				147 4128
				139 4116
				147 4106
				148 4095
				140 4084
				152 4075
				153 4066
				141 4055
				155 4045
				158 4034
				142 4022
				158 4012
				157 4003
				143 3994
				158 3986
				158 3979
				144 3972
				158 3964
				163 3958
				145 3948
				162 3942
				165 3935
				146 3927
				168 3921
				168 3915
				147 3907
				167 3899
				162 3890
				148 3880
				152 3869
				152 3860
				149 3851
				148 3845
				147 3838
				150 3833
				142 3826
				142 3820
				151 3817
				145 3813
				140 3807
				152 3805
				148 3802
				147 3798
				153 3796
				148 3793
				148 3790
				154 3787
				148 3784
				152 3783
				155 3781
				148 3778
				152 3777
				156 3775
				147 3771
				148 3769
				157 3765
				143 3762
				147 3759
				158 3755
				142 3750
				145 3746
				159 3741
				148 3738
				148 3732
				160 3726
				145 3717
				147 3710
				161 3701
				143 3692
				145 3689
				162 3687
				153 3686
				160 3684
				163 3682
				173 3676
				162 3645
				164 3594
				168 3524
				180 3424
				165 3316>;

	r_profile_t2_num = <85>;
	r_profile_t2 = <137 4193
				137 4177
				142 4165
				138 4153
				143 4140
				147 4128
				139 4116
				147 4106
				148 4095
				140 4084
				152 4075
				153 4066
				141 4055
				155 4045
				158 4034
				142 4022
				158 4012
				157 4003
				143 3994
				158 3986
				158 3979
				144 3972
				158 3964
				163 3958
				145 3948
				162 3942
				165 3935
				146 3927
				168 3921
				168 3915
				147 3907
				167 3899
				162 3890
				148 3880
				152 3869
				152 3860
				149 3851
				148 3845
				147 3838
				150 3833
				142 3826
				142 3820
				151 3817
				145 3813
				140 3807
				152 3805
				148 3802
				147 3798
				153 3796
				148 3793
				148 3790
				154 3787
				148 3784
				152 3783
				155 3781
				148 3778
				152 3777
				156 3775
				147 3771
				148 3769
				157 3765
				143 3762
				147 3759
				158 3755
				142 3750
				145 3746
				159 3741
				148 3738
				148 3732
				160 3726
				145 3717
				147 3710
				161 3701
				143 3692
				145 3689
				162 3687
				153 3686
				160 3684
				163 3682
				173 3676
				162 3645
				164 3594
				168 3524
				180 3424
				165 3316>;
	r_profile_t3_num = <85>;
	r_profile_t3 = <137 4193
				137 4177
				142 4165
				138 4153
				143 4140
				147 4128
				139 4116
				147 4106
				148 4095
				140 4084
				152 4075
				153 4066
				141 4055
				155 4045
				158 4034
				142 4022
				158 4012
				157 4003
				143 3994
				158 3986
				158 3979
				144 3972
				158 3964
				163 3958
				145 3948
				162 3942
				165 3935
				146 3927
				168 3921
				168 3915
				147 3907
				167 3899
				162 3890
				148 3880
				152 3869
				152 3860
				149 3851
				148 3845
				147 3838
				150 3833
				142 3826
				142 3820
				151 3817
				145 3813
				140 3807
				152 3805
				148 3802
				147 3798
				153 3796
				148 3793
				148 3790
				154 3787
				148 3784
				152 3783
				155 3781
				148 3778
				152 3777
				156 3775
				147 3771
				148 3769
				157 3765
				143 3762
				147 3759
				158 3755
				142 3750
				145 3746
				159 3741
				148 3738
				148 3732
				160 3726
				145 3717
				147 3710
				161 3701
				143 3692
				145 3689
				162 3687
				153 3686
				160 3684
				163 3682
				173 3676
				162 3645
				164 3594
				168 3524
				180 3424
				165 3316>;
};
