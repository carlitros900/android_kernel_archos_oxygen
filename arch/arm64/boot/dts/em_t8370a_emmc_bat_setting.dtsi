/*************************
 * Customized Battery Setting dtsi file
*************************/
&bat_comm {
	gpio22_dc_det = <&pio 22 0>;
	gpio85_set_chr_set = <&pio 85 0>;
	gpio28_spec_cur_select = <&pio 28 0>;
	/* cust_charging.h */
	/* stop charging while in talking mode */
	stop_charging_in_takling = <1>;
	talking_recharge_voltage = <3800>;
	talking_sync_time = <60>;

	/* Battery Temperature Protection */
	mtk_temperature_recharge_support = <1>;
	max_charge_temperature = <50>;
	max_charge_temperature_minus_x_degree = <47>;
	min_charge_temperature = <0>;
	min_charge_temperature_plus_x_degree = <6>;
	err_charge_temperature = <0xff>;

	/* Linear Charging Threshold */
	v_pre2cc_thres = <3400>;	/* unit: mV */
	v_cc2topoff_thres = <4050>;
	recharging_voltage = <4110>;
	charging_full_current = <80>;	/* unit: mA */

	/* Charging Current Setting */
	config_usb_if = <0>;
	usb_charger_current_suspend = <0>;	/* Unit: 0.01 mA */
	usb_charger_current_unconfigured = <7000>;	/* Unit: 0.01 mA */
	usb_charger_current_configured = <7000>;	/* Unit: 0.01 mA */
	usb_charger_current = <20000>;	/* Unit: 0.01 mA */
	ac_charger_current = <20000>;	/* Unit: 0.01 mA */
	non_std_ac_charger_current = <20000>;	/* Unit: 0.01 mA */
	charging_host_charger_current = <20000>;	/* Unit: 0.01 mA */
	apple_0_5a_charger_current = <7000>;	/* Unit: 0.01 mA */
	apple_1_0a_charger_current = <7000>;	/* Unit: 0.01 mA */
	apple_2_1a_charger_current = <7000>;	/* Unit: 0.01 mA */

	/* charger error check */
	bat_low_temp_protect_enable = <0>;
	v_charger_enable = <0>;	/* 1:on , 0:off */
	v_charger_max = <6500>;	/* unit: mV */
	v_charger_min = <4400>;

	/*  Tracking TIME */
	onehundred_percent_tracking_time = <10>;	/* Unit: second */
	npercent_tracking_time = <20>;	/* Unit: second */
	sync_to_real_tracking_time = <60>;	/* Unit: second */
	v_0percent_tracking = <3500>;	/* Unit: mV */

	/* High battery support */
	high_battery_voltage_support = <0>;
};

&bat_meter {
	/* cust_battery_meter.h */
	/* ADC resistor  */
	r_bat_sense = <4>;
	r_i_sense = <4>;
	r_charger_1 = <330>;
	r_charger_2 = <39>;
	temperature_t0 = <110>;
	temperature_t1 = <0>;
	temperature_t2 = <25>;
	temperature_t3 = <50>;
	temperature_t = <255>;	/* this should be fixed, never change the value */
	fg_meter_resistance = <0>;

	/* Qmax for 0mA */
	q_max_pos_50 = <570>;
	q_max_pos_25 = <570>;
	q_max_pos_0 = <570>;
	q_max_neg_10 = <570>;
	/* Qmax for 600mA, said high current */
	q_max_pos_50_h_current = <462>;
	q_max_pos_25_h_current = <462>;
	q_max_pos_0_h_current = <462>;
	q_max_neg_10_h_current = <462>;
	/* Discharge percentage, 1: D5, 0: D2 */
	oam_d5 = <0>;

	change_tracking_point = <1>;
	/* SW OCV tracking setting */
	cust_tracking_point = <14>;
	cust_r_sense = <200>;
	cust_hw_cc = <0>;
	aging_tuning_value = <100>;
	cust_r_fg_offset = <0>;
	ocv_board_compesate = <0>;
	r_fg_board_base = <1000>;
	r_fg_board_slope = <1000>;
	car_tune_value = <89>;

	/* HW Fuel gague  */
	current_detect_r_fg = <10>;	/* Unit: mA */
	minerroroffset = <1000>;
	fg_vbat_average_size = <18>;
	r_fg_value = <10>;	/* Unit: mOhm */

	cust_poweron_delta_capacity_tolrance = <80>;
	cust_poweron_low_capacity_tolrance = <5>;
	cust_poweron_max_vbat_tolrance = <70>;
	cust_poweron_delta_vbat_tolrance = <60>;
	cust_poweron_delta_hw_sw_ocv_capacity_tolrance = <10>;

	/* Fixed battery temperature */
	fixed_tbat_25 = <1>;
	/* Dynamic change wake up period of battery thread when suspend */
	vbat_normal_wakeup = <3600>;	/* Unit: mV */
	vbat_low_power_wakeup = <3500>;	/* Unit: mV */
	normal_wakeup_period = <5400>;	/* Unit: second */
	low_power_wakeup_period = <300>;	/* Unit: second */
	close_poweroff_wakeup_period = <30>;	/* Unit: second */

	rbat_pull_up_r = <16900>;
	rbat_pull_up_volt = <1800>;

	batt_temperature_table_num = <17>;
	batt_temperature_table = <
			    (-20) 75022
			    (-15) 57926
			    (-10) 45168
			    (-5) 35548
			    0 28224
			    5 22595
			    10 18231
			    15 14820
			    20 12133
			    25 10000 30 8295 35 6922 40 5810 45 4903 50 4160 55 3547 60 3039>;

	battery_profile_t0_num = <72>;
	battery_profile_t0 = <0 4198
				1	4181
				3	4166
				4	4153
				6	4140
				7	4127
				8	4115
				10	4102
				11	4091
				13	4079
				14	4069
				15	4058
				17	4046
				18	4035
				20	4023
				21	4012
				22	4002
				24	3993
				25	3984
				27	3975
				28	3966
				29	3958
				31	3949
				32	3940
				34	3932
				35	3923
				36	3914
				38	3904
				39	3894
				41	3883
				42	3873
				44	3863
				45	3855
				46	3847
				48	3840
				49	3834
				51	3829
				52	3823
				53	3819
				55	3814
				56	3809
				58	3806
				59	3802
				60	3798
				62	3794
				63	3791
				65	3788
				66	3785
				67	3782
				69	3779
				70	3776
				72	3773
				73	3771
				74	3768
				76	3765
				77	3761
				79	3757
				80	3753
				81	3749
				83	3744
				84	3740
				86	3736
				87	3731
				88	3724
				90	3717
				91	3710
				93	3704
				94	3694
				95	3687
				97	3683
				98	3681
				100	3678>;

	battery_profile_t1_num = <72>;
	battery_profile_t1 = <0 4198
				1	4181
				3	4166
				4	4153
				6	4140
				7	4127
				8	4115
				10	4102
				11	4091
				13	4079
				14	4069
				15	4058
				17	4046
				18	4035
				20	4023
				21	4012
				22	4002
				24	3993
				25	3984
				27	3975
				28	3966
				29	3958
				31	3949
				32	3940
				34	3932
				35	3923
				36	3914
				38	3904
				39	3894
				41	3883
				42	3873
				44	3863
				45	3855
				46	3847
				48	3840
				49	3834
				51	3829
				52	3823
				53	3819
				55	3814
				56	3809
				58	3806
				59	3802
				60	3798
				62	3794
				63	3791
				65	3788
				66	3785
				67	3782
				69	3779
				70	3776
				72	3773
				73	3771
				74	3768
				76	3765
				77	3761
				79	3757
				80	3753
				81	3749
				83	3744
				84	3740
				86	3736
				87	3731
				88	3724
				90	3717
				91	3710
				93	3704
				94	3694
				95	3687
				97	3683
				98	3681
				100	3678>;

	battery_profile_t2_num = <72>;
	battery_profile_t2 = <0 4198
				1	4181
				3	4166
				4	4153
				6	4140
				7	4127
				8	4115
				10	4102
				11	4091
				13	4079
				14	4069
				15	4058
				17	4046
				18	4035
				20	4023
				21	4012
				22	4002
				24	3993
				25	3984
				27	3975
				28	3966
				29	3958
				31	3949
				32	3940
				34	3932
				35	3923
				36	3914
				38	3904
				39	3894
				41	3883
				42	3873
				44	3863
				45	3855
				46	3847
				48	3840
				49	3834
				51	3829
				52	3823
				53	3819
				55	3814
				56	3809
				58	3806
				59	3802
				60	3798
				62	3794
				63	3791
				65	3788
				66	3785
				67	3782
				69	3779
				70	3776
				72	3773
				73	3771
				74	3768
				76	3765
				77	3761
				79	3757
				80	3753
				81	3749
				83	3744
				84	3740
				86	3736
				87	3731
				88	3724
				90	3717
				91	3710
				93	3704
				94	3694
				95	3687
				97	3683
				98	3681
				100	3678>;


	battery_profile_t3_num = <72>;
	battery_profile_t3 = <0 4198
				1	4181
				3	4166
				4	4153
				6	4140
				7	4127
				8	4115
				10	4102
				11	4091
				13	4079
				14	4069
				15	4058
				17	4046
				18	4035
				20	4023
				21	4012
				22	4002
				24	3993
				25	3984
				27	3975
				28	3966
				29	3958
				31	3949
				32	3940
				34	3932
				35	3923
				36	3914
				38	3904
				39	3894
				41	3883
				42	3873
				44	3863
				45	3855
				46	3847
				48	3840
				49	3834
				51	3829
				52	3823
				53	3819
				55	3814
				56	3809
				58	3806
				59	3802
				60	3798
				62	3794
				63	3791
				65	3788
				66	3785
				67	3782
				69	3779
				70	3776
				72	3773
				73	3771
				74	3768
				76	3765
				77	3761
				79	3757
				80	3753
				81	3749
				83	3744
				84	3740
				86	3736
				87	3731
				88	3724
				90	3717
				91	3710
				93	3704
				94	3694
				95	3687
				97	3683
				98	3681
				100	3678>;

	r_profile_t0_num = <72>;
	r_profile_t0 = <40 4198
			40	 4181
			40	 4166
			40	 4153
			40	 4140
			40	 4127
			40	 4115
			40	 4102
			40	 4091
			40	 4079
			40	 4069
			40	 4058
			40	 4046
			40	 4035
			40	 4023
			40	 4012
			40	 4002
			40	 3993
			40	 3984
			40	 3975
			40	 3966
			40	 3958
			40	 3949
			40	 3940
			40	 3932
			40	 3923
			40	 3914
			40	 3904
			40	 3894
			40	 3883
			40	 3873
			40	 3863
			40	 3855
			40	 3847
			40	 3840
			40	 3834
			40	 3829
			40	 3823
			40	 3819
			40	 3814
			40	 3809
			40	 3806
			40	 3802
			40	 3798
			40	 3794
			40	 3791
			40	 3788
			40	 3785
			40	 3782
			40	 3779
			40	 3776
			40	 3773
			40	 3771
			40	 3768
			40	 3765
			40	 3761
			40	 3757
			40	 3753
			40	 3749
			40	 3744
			40	 3740
			40	 3736
			40	 3731
			40	 3724
			40	 3717
			40	 3710
			40	 3704
			40	 3694
			40	 3687
			40	 3683
			40	 3681
			40	 3678>;

	r_profile_t1_num = <72>;
	r_profile_t1 = <40 4198
			40	 4181
			40	 4166
			40	 4153
			40	 4140
			40	 4127
			40	 4115
			40	 4102
			40	 4091
			40	 4079
			40	 4069
			40	 4058
			40	 4046
			40	 4035
			40	 4023
			40	 4012
			40	 4002
			40	 3993
			40	 3984
			40	 3975
			40	 3966
			40	 3958
			40	 3949
			40	 3940
			40	 3932
			40	 3923
			40	 3914
			40	 3904
			40	 3894
			40	 3883
			40	 3873
			40	 3863
			40	 3855
			40	 3847
			40	 3840
			40	 3834
			40	 3829
			40	 3823
			40	 3819
			40	 3814
			40	 3809
			40	 3806
			40	 3802
			40	 3798
			40	 3794
			40	 3791
			40	 3788
			40	 3785
			40	 3782
			40	 3779
			40	 3776
			40	 3773
			40	 3771
			40	 3768
			40	 3765
			40	 3761
			40	 3757
			40	 3753
			40	 3749
			40	 3744
			40	 3740
			40	 3736
			40	 3731
			40	 3724
			40	 3717
			40	 3710
			40	 3704
			40	 3694
			40	 3687
			40	 3683
			40	 3681
			40	 3678>;

	r_profile_t2_num = <72>;
	r_profile_t2 = <40 4198
			40	 4181
			40	 4166
			40	 4153
			40	 4140
			40	 4127
			40	 4115
			40	 4102
			40	 4091
			40	 4079
			40	 4069
			40	 4058
			40	 4046
			40	 4035
			40	 4023
			40	 4012
			40	 4002
			40	 3993
			40	 3984
			40	 3975
			40	 3966
			40	 3958
			40	 3949
			40	 3940
			40	 3932
			40	 3923
			40	 3914
			40	 3904
			40	 3894
			40	 3883
			40	 3873
			40	 3863
			40	 3855
			40	 3847
			40	 3840
			40	 3834
			40	 3829
			40	 3823
			40	 3819
			40	 3814
			40	 3809
			40	 3806
			40	 3802
			40	 3798
			40	 3794
			40	 3791
			40	 3788
			40	 3785
			40	 3782
			40	 3779
			40	 3776
			40	 3773
			40	 3771
			40	 3768
			40	 3765
			40	 3761
			40	 3757
			40	 3753
			40	 3749
			40	 3744
			40	 3740
			40	 3736
			40	 3731
			40	 3724
			40	 3717
			40	 3710
			40	 3704
			40	 3694
			40	 3687
			40	 3683
			40	 3681
			40	 3678>;

	r_profile_t3_num = <72>;
	r_profile_t3 = <40 4193
			40	 4181
			40	 4166
			40	 4153
			40	 4140
			40	 4127
			40	 4115
			40	 4102
			40	 4091
			40	 4079
			40	 4069
			40	 4058
			40	 4046
			40	 4035
			40	 4023
			40	 4012
			40	 4002
			40	 3993
			40	 3984
			40	 3975
			40	 3966
			40	 3958
			40	 3949
			40	 3940
			40	 3932
			40	 3923
			40	 3914
			40	 3904
			40	 3894
			40	 3883
			40	 3873
			40	 3863
			40	 3855
			40	 3847
			40	 3840
			40	 3834
			40	 3829
			40	 3823
			40	 3819
			40	 3814
			40	 3809
			40	 3806
			40	 3802
			40	 3798
			40	 3794
			40	 3791
			40	 3788
			40	 3785
			40	 3782
			40	 3779
			40	 3776
			40	 3773
			40	 3771
			40	 3768
			40	 3765
			40	 3761
			40	 3757
			40	 3753
			40	 3749
			40	 3744
			40	 3740
			40	 3736
			40	 3731
			40	 3724
			40	 3717
			40	 3710
			40	 3704
			40	 3694
			40	 3687
			40	 3683
			40	 3681
			40	 3678>;
};
