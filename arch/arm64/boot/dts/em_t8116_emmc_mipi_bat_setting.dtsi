/*************************
 * Customized Battery Setting dtsi file
*************************/
&bat_comm {
	gpio22_dc_det = <&pio 22 0>;
	gpio85_set_chr_set = <&pio 85 0>;
	gpio28_spec_cur_select = <&pio 28 0>;
	/* cust_charging.h */
	/* stop charging while in talking mode */
	stop_charging_in_takling = <1>;
	talking_recharge_voltage = <3800>;
	talking_sync_time = <60>;

	/* Battery Temperature Protection */
	mtk_temperature_recharge_support = <1>;
	max_charge_temperature = <50>;
	max_charge_temperature_minus_x_degree = <47>;
	min_charge_temperature = <0>;
	min_charge_temperature_plus_x_degree = <6>;
	err_charge_temperature = <0xff>;

	/* Linear Charging Threshold */
	v_pre2cc_thres = <3400>;	/* unit: mV */
	v_cc2topoff_thres = <4050>;
	recharging_voltage = <4110>;
	charging_full_current = <80>;	/* unit: mA */

	/* Charging Current Setting */
	config_usb_if = <0>;
	usb_charger_current_suspend = <0>;	/* Unit: 0.01 mA */
	usb_charger_current_unconfigured = <7000>;	/* Unit: 0.01 mA */
	usb_charger_current_configured = <50000>;	/* Unit: 0.01 mA */
	usb_charger_current = <120000>;	/* Unit: 0.01 mA */
	ac_charger_current = <120000>;	/* Unit: 0.01 mA */
	non_std_ac_charger_current = <50000>;	/* Unit: 0.01 mA */
	charging_host_charger_current = <65000>;	/* Unit: 0.01 mA */
	apple_0_5a_charger_current = <50000>;	/* Unit: 0.01 mA */
	apple_1_0a_charger_current = <65000>;	/* Unit: 0.01 mA */
	apple_2_1a_charger_current = <80000>;	/* Unit: 0.01 mA */

	/* charger error check */
	bat_low_temp_protect_enable = <0>;
	v_charger_enable = <0>;	/* 1:on , 0:off */
	v_charger_max = <6500>;	/* unit: mV */
	v_charger_min = <4400>;

	/*  Tracking TIME */
	onehundred_percent_tracking_time = <1800>;	/* Unit: second */
	npercent_tracking_time = <200>;	/* Unit: second */
	sync_to_real_tracking_time = <300>;	/* Unit: second */
	v_0percent_tracking = <3470>;	/* Unit: mV */

	/* High battery support */
	high_battery_voltage_support = <0>;
};

&bat_meter {
	/* cust_battery_meter.h */
	/* ADC resistor  */
	r_bat_sense = <4>;
	r_i_sense = <4>;
	r_charger_1 = <330>;
	r_charger_2 = <39>;
	temperature_t0 = <110>;
	temperature_t1 = <0>;
	temperature_t2 = <25>;
	temperature_t3 = <50>;
	temperature_t = <255>;	/* this should be fixed, never change the value */
	fg_meter_resistance = <0>;

	/* Qmax for 0mA */
	q_max_pos_50 = <4063>;
	q_max_pos_25 = <4063>;
	q_max_pos_0 = <4063>;
	q_max_neg_10 = <4063>;
	/* Qmax for 600mA, said high current */
	q_max_pos_50_h_current = <3630>;
	q_max_pos_25_h_current = <3630>;
	q_max_pos_0_h_current = <3630>;
	q_max_neg_10_h_current = <3630>;
	/* Discharge percentage, 1: D5, 0: D2 */
	oam_d5 = <1>;

	change_tracking_point = <1>;
	/* SW OCV tracking setting */
	cust_tracking_point = <14>;
	cust_r_sense = <200>;
	cust_hw_cc = <0>;
	aging_tuning_value = <100>;
	cust_r_fg_offset = <0>;
	ocv_board_compesate = <0>;
	r_fg_board_base = <1000>;
	r_fg_board_slope = <1000>;
	car_tune_value = <89>;

	/* HW Fuel gague  */
	current_detect_r_fg = <10>;	/* Unit: mA */
	minerroroffset = <1000>;
	fg_vbat_average_size = <18>;
	r_fg_value = <20>;	/* Unit: mOhm */

	cust_poweron_delta_capacity_tolrance = <80>;
	cust_poweron_low_capacity_tolrance = <0>;
	cust_poweron_max_vbat_tolrance = <70>;
	cust_poweron_delta_vbat_tolrance = <60>;
	cust_poweron_delta_hw_sw_ocv_capacity_tolrance = <10>;

	/* Fixed battery temperature */
	fixed_tbat_25 = <1>;
	/* Dynamic change wake up period of battery thread when suspend */
	vbat_normal_wakeup = <3600>;	/* Unit: mV */
	vbat_low_power_wakeup = <3500>;	/* Unit: mV */
	normal_wakeup_period = <5400>;	/* Unit: second */
	low_power_wakeup_period = <300>;	/* Unit: second */
	close_poweroff_wakeup_period = <30>;	/* Unit: second */

	rbat_pull_up_r = <16900>;
	rbat_pull_up_volt = <1800>;

	batt_temperature_table_num = <17>;
	batt_temperature_table = <
			    (-20) 75022
			    (-15) 57926
			    (-10) 45168
			    (-5) 35548
			    0 28224
			    5 22595
			    10 18231
			    15 14820
			    20 12133
			    25 10000 30 8295 35 6922 40 5810 45 4903 50 4160 55 3547 60 3039>;

	battery_profile_t0_num = <83>;
	battery_profile_t0 = <0 4192
				1    4176	
				2    4162
                                4    4149
                                5    4137
                                6    4124
                                7    4114
                                9    4103
                                10   4091
                                11   4082
                                12   4072
                                14   4063
                                15   4053
                                16   4040
                                17   4028
                                18   4017
                                20   4005
                                21   3997
                                22   3990
                                23   3984
                                25   3975
                                26   3968
                                27   3960
                                28   3953
                                30   3944
                                31   3937
                                32   3929
                                33   3923
                                34   3916
                                36   3908
                                37   3902
                                38   3894
                                39   3885
                                41   3875
                                42   3865
                                43   3856
                                44   3847
                                46   3841
                                47   3835
                                48   3828
                                49   3823
                                50   3819
                                52   3813
                                53   3810
                                54   3807
                                55   3804
                                57   3800
                                58   3797
                                59   3795
                                60   3792
                                62   3789
                                63   3786
                                64   3784
                                65   3783
                                66   3780
                                68   3778
                                69   3777
                                70   3774
                                71   3771
                                73   3767
                                74   3763
                                75   3758
                                76   3755
                                78   3752
                                79   3748
                                80   3746
                                81   3742
                                82   3738
                                84   3734
                                85   3737
                                86   3731
                                87   3724
                                89   3717
                                90   3710
                                91   3701
                                92   3696
                                94   3695
                                95   3692
                                96   3689
                                97   3686
                                98   3663
                                100  3616
                                101  3552>;

	battery_profile_t1_num = <83>;
	battery_profile_t1 = <0 4192
				1    4176	
				2    4162
                                4    4149
                                5    4137
                                6    4124
                                7    4114
                                9    4103
                                10   4091
                                11   4082
                                12   4072
                                14   4063
                                15   4053
                                16   4040
                                17   4028
                                18   4017
                                20   4005
                                21   3997
                                22   3990
                                23   3984
                                25   3975
                                26   3968
                                27   3960
                                28   3953
                                30   3944
                                31   3937
                                32   3929
                                33   3923
                                34   3916
                                36   3908
                                37   3902
                                38   3894
                                39   3885
                                41   3875
                                42   3865
                                43   3856
                                44   3847
                                46   3841
                                47   3835
                                48   3828
                                49   3823
                                50   3819
                                52   3813
                                53   3810
                                54   3807
                                55   3804
                                57   3800
                                58   3797
                                59   3795
                                60   3792
                                62   3789
                                63   3786
                                64   3784
                                65   3783
                                66   3780
                                68   3778
                                69   3777
                                70   3774
                                71   3771
                                73   3767
                                74   3763
                                75   3758
                                76   3755
                                78   3752
                                79   3748
                                80   3746
                                81   3742
                                82   3738
                                84   3734
                                85   3737
                                86   3731
                                87   3724
                                89   3717
                                90   3710
                                91   3701
                                92   3696
                                94   3695
                                95   3692
                                96   3689
                                97   3686
                                98   3663
                                100  3616
                                101  3552>;

	battery_profile_t2_num = <83>;
	battery_profile_t2 = <0 4192
				1    4176	
				2    4162
                                4    4149
                                5    4137
                                6    4124
                                7    4114
                                9    4103
                                10   4091
                                11   4082
                                12   4072
                                14   4063
                                15   4053
                                16   4040
                                17   4028
                                18   4017
                                20   4005
                                21   3997
                                22   3990
                                23   3984
                                25   3975
                                26   3968
                                27   3960
                                28   3953
                                30   3944
                                31   3937
                                32   3929
                                33   3923
                                34   3916
                                36   3908
                                37   3902
                                38   3894
                                39   3885
                                41   3875
                                42   3865
                                43   3856
                                44   3847
                                46   3841
                                47   3835
                                48   3828
                                49   3823
                                50   3819
                                52   3813
                                53   3810
                                54   3807
                                55   3804
                                57   3800
                                58   3797
                                59   3795
                                60   3792
                                62   3789
                                63   3786
                                64   3784
                                65   3783
                                66   3780
                                68   3778
                                69   3777
                                70   3774
                                71   3771
                                73   3767
                                74   3763
                                75   3758
                                76   3755
                                78   3752
                                79   3748
                                80   3746
                                81   3742
                                82   3738
                                84   3734
                                85   3737
                                86   3731
                                87   3724
                                89   3717
                                90   3710
                                91   3701
                                92   3696
                                94   3695
                                95   3692
                                96   3689
                                97   3686
                                98   3663
                                100  3616
                                101  3552>;

	battery_profile_t3_num = <83>;
	battery_profile_t3 = <0 4192
				1    4176	
				2    4162
                                4    4149
                                5    4137
                                6    4124
                                7    4114
                                9    4103
                                10   4091
                                11   4082
                                12   4072
                                14   4063
                                15   4053
                                16   4040
                                17   4028
                                18   4017
                                20   4005
                                21   3997
                                22   3990
                                23   3984
                                25   3975
                                26   3968
                                27   3960
                                28   3953
                                30   3944
                                31   3937
                                32   3929
                                33   3923
                                34   3916
                                36   3908
                                37   3902
                                38   3894
                                39   3885
                                41   3875
                                42   3865
                                43   3856
                                44   3847
                                46   3841
                                47   3835
                                48   3828
                                49   3823
                                50   3819
                                52   3813
                                53   3810
                                54   3807
                                55   3804
                                57   3800
                                58   3797
                                59   3795
                                60   3792
                                62   3789
                                63   3786
                                64   3784
                                65   3783
                                66   3780
                                68   3778
                                69   3777
                                70   3774
                                71   3771
                                73   3767
                                74   3763
                                75   3758
                                76   3755
                                78   3752
                                79   3748
                                80   3746
                                81   3742
                                82   3738
                                84   3734
                                85   3737
                                86   3731
                                87   3724
                                89   3717
                                90   3710
                                91   3701
                                92   3696
                                94   3695
                                95   3692
                                96   3689
                                97   3686
                                98   3663
                                100  3616
                                101  3552>;

	r_profile_t0_num = <83>;
	r_profile_t0 = <118 4192
				100 4176
                                102 4162
                                101 4149
                                102 4137
                                101 4124
                                103 4114
                                104 4103
                                104 4091
                                106 4082
                                105 4072
                                106 4063
                                108 4053
                                107 4040
                                108 4028
                                108 4017
                                107 4005
                                110 3997
                                110 3990
                                112 3984
                                111 3975
                                112 3968
                                113 3960
                                114 3953
                                112 3944
                                114 3937
                                112 3929
                                115 3923
                                115 3916
                                115 3908
                                116 3902
                                115 3894
                                115 3885
                                111 3875
                                109 3865
                                106 3856
                                103 3847
                                103 3841
                                103 3835
                                104 3828
                                104 3823
                                107 3819
				106 3813
				108 3810
				103 3807
				103 3804
				102 3800
				103 3797
				103 3795
				103 3792
				103 3789
				103 3786
				104 3784
				105 3783
				104 3780
				105 3778
				106 3777
				104 3774
				104 3771
				103 3767
				102 3763
				100 3758
				102 3755
				104 3752
				106 3748
				110 3746
				111 3742
				110 3738
				111 3734
				121 3737
				112 3731
				111 3724
				111 3717
				114 3710
				112 3701
				112 3696
				116 3695
				118 3692
				122 3689
				131 3686
				127 3663
				126 3616
				129 3552>;

	r_profile_t1_num = <83>;
	r_profile_t1 = <118 4192
				100 4176
                                102 4162
                                101 4149
                                102 4137
                                101 4124
                                103 4114
                                104 4103
                                104 4091
                                106 4082
                                105 4072
                                106 4063
                                108 4053
                                107 4040
                                108 4028
                                108 4017
                                107 4005
                                110 3997
                                110 3990
                                112 3984
                                111 3975
                                112 3968
                                113 3960
                                114 3953
                                112 3944
                                114 3937
                                112 3929
                                115 3923
                                115 3916
                                115 3908
                                116 3902
                                115 3894
                                115 3885
                                111 3875
                                109 3865
                                106 3856
                                103 3847
                                103 3841
                                103 3835
                                104 3828
                                104 3823
                                107 3819
				106 3813
				108 3810
				103 3807
				103 3804
				102 3800
				103 3797
				103 3795
				103 3792
				103 3789
				103 3786
				104 3784
				105 3783
				104 3780
				105 3778
				106 3777
				104 3774
				104 3771
				103 3767
				102 3763
				100 3758
				102 3755
				104 3752
				106 3748
				110 3746
				111 3742
				110 3738
				111 3734
				121 3737
				112 3731
				111 3724
				111 3717
				114 3710
				112 3701
				112 3696
				116 3695
				118 3692
				122 3689
				131 3686
				127 3663
				126 3616
				129 3552>;

	r_profile_t2_num = <83>;
	r_profile_t2 = <118 4192
				100 4176
                                102 4162
                                101 4149
                                102 4137
                                101 4124
                                103 4114
                                104 4103
                                104 4091
                                106 4082
                                105 4072
                                106 4063
                                108 4053
                                107 4040
                                108 4028
                                108 4017
                                107 4005
                                110 3997
                                110 3990
                                112 3984
                                111 3975
                                112 3968
                                113 3960
                                114 3953
                                112 3944
                                114 3937
                                112 3929
                                115 3923
                                115 3916
                                115 3908
                                116 3902
                                115 3894
                                115 3885
                                111 3875
                                109 3865
                                106 3856
                                103 3847
                                103 3841
                                103 3835
                                104 3828
                                104 3823
                                107 3819
				106 3813
				108 3810
				103 3807
				103 3804
				102 3800
				103 3797
				103 3795
				103 3792
				103 3789
				103 3786
				104 3784
				105 3783
				104 3780
				105 3778
				106 3777
				104 3774
				104 3771
				103 3767
				102 3763
				100 3758
				102 3755
				104 3752
				106 3748
				110 3746
				111 3742
				110 3738
				111 3734
				121 3737
				112 3731
				111 3724
				111 3717
				114 3710
				112 3701
				112 3696
				116 3695
				118 3692
				122 3689
				131 3686
				127 3663
				126 3616
				129 3552>;

	r_profile_t3_num = <83>;
	r_profile_t3 = <118 4192
				100 4176
                                102 4162
                                101 4149
                                102 4137
                                101 4124
                                103 4114
                                104 4103
                                104 4091
                                106 4082
                                105 4072
                                106 4063
                                108 4053
                                107 4040
                                108 4028
                                108 4017
                                107 4005
                                110 3997
                                110 3990
                                112 3984
                                111 3975
                                112 3968
                                113 3960
                                114 3953
                                112 3944
                                114 3937
                                112 3929
                                115 3923
                                115 3916
                                115 3908
                                116 3902
                                115 3894
                                115 3885
                                111 3875
                                109 3865
                                106 3856
                                103 3847
                                103 3841
                                103 3835
                                104 3828
                                104 3823
                                107 3819
				106 3813
				108 3810
				103 3807
				103 3804
				102 3800
				103 3797
				103 3795
				103 3792
				103 3789
				103 3786
				104 3784
				105 3783
				104 3780
				105 3778
				106 3777
				104 3774
				104 3771
				103 3767
				102 3763
				100 3758
				102 3755
				104 3752
				106 3748
				110 3746
				111 3742
				110 3738
				111 3734
				121 3737
				112 3731
				111 3724
				111 3717
				114 3710
				112 3701
				112 3696
				116 3695
				118 3692
				122 3689
				131 3686
				127 3663
				126 3616
				129 3552>;
};
