/*************************
 * Customized Battery Setting dtsi file
*************************/
&bat_comm {
	gpio22_dc_det = <&pio 22 0>;
	gpio85_set_chr_set = <&pio 85 0>;
	gpio28_spec_cur_select = <&pio 28 0>;

	/* cust_charging.h */
	/* stop charging while in talking mode */
	stop_charging_in_takling = <1>;
	talking_recharge_voltage = <3800>;
	talking_sync_time = <60>;

	/* Battery Temperature Protection */
	mtk_temperature_recharge_support = <1>;
	max_charge_temperature = <50>;
	max_charge_temperature_minus_x_degree = <47>;
	min_charge_temperature = <0>;
	min_charge_temperature_plus_x_degree = <6>;
	err_charge_temperature = <0xff>;

	/* Linear Charging Threshold */
	v_pre2cc_thres = <3400>;	/* unit: mV */
	v_cc2topoff_thres = <4050>;
	recharging_voltage = <4110>;
	charging_full_current = <80>;	/* unit: mA */

	/* Charging Current Setting */
	config_usb_if = <0>;
	usb_charger_current_suspend = <0>;	/* Unit: 0.01 mA */
	usb_charger_current_unconfigured = <7000>;	/* Unit: 0.01 mA */
	usb_charger_current_configured = <50000>;	/* Unit: 0.01 mA */
	usb_charger_current = <50000>;	/* Unit: 0.01 mA */
	ac_charger_current = <130000>;	/* Unit: 0.01 mA */
	non_std_ac_charger_current = <50000>;	/* Unit: 0.01 mA */
	charging_host_charger_current = <65000>;	/* Unit: 0.01 mA */
	apple_0_5a_charger_current = <50000>;	/* Unit: 0.01 mA */
	apple_1_0a_charger_current = <65000>;	/* Unit: 0.01 mA */
	apple_2_1a_charger_current = <80000>;	/* Unit: 0.01 mA */

	/* charger error check */
	bat_low_temp_protect_enable = <0>;
	v_charger_enable = <0>;	/* 1:on , 0:off */
	v_charger_max = <6500>;	/* unit: mV */
	v_charger_min = <4400>;

	/*  Tracking TIME */
	onehundred_percent_tracking_time = <10>;	/* Unit: second */
	npercent_tracking_time = <20>;	/* Unit: second */
	sync_to_real_tracking_time = <60>;	/* Unit: second */
	v_0percent_tracking = <3450>;	/* Unit: mV */

	/* High battery support */
	high_battery_voltage_support = <0>;
};

&bat_meter {
	/* cust_battery_meter.h */
	/* ADC resistor  */
	r_bat_sense = <4>;
	r_i_sense = <4>;
	r_charger_1 = <330>;
	r_charger_2 = <39>;
	temperature_t0 = <110>;
	temperature_t1 = <0>;
	temperature_t2 = <25>;
	temperature_t3 = <50>;
	temperature_t = <255>;	/* this should be fixed, never change the value */
	fg_meter_resistance = <0>;

	/* Qmax for 0mA */
	q_max_pos_50 = <3355>;
	q_max_pos_25 = <3355>;
	q_max_pos_0 = <3355>;
	q_max_neg_10 = <3355>;
	/* Qmax for 400mA, said high current */
	q_max_pos_50_h_current = <3032>;
	q_max_pos_25_h_current = <3032>;
	q_max_pos_0_h_current = <3032>;
	q_max_neg_10_h_current = <3032>;
	/* Discharge percentage, 1: D5, 0: D2 */
	oam_d5 = <1>;

	change_tracking_point = <1>;
	/* SW OCV tracking setting */
	cust_tracking_point = <14>;
	cust_r_sense = <200>;
	cust_hw_cc = <0>;
	aging_tuning_value = <100>;
	cust_r_fg_offset = <0>;
	ocv_board_compesate = <0>;
	r_fg_board_base = <1000>;
	r_fg_board_slope = <1000>;
	car_tune_value = <89>;

	/* HW Fuel gague  */
	current_detect_r_fg = <10>;	/* Unit: mA */
	minerroroffset = <1000>;
	fg_vbat_average_size = <18>;
	r_fg_value = <10>;	/* Unit: mOhm */

	cust_poweron_delta_capacity_tolrance = <80>;
	cust_poweron_low_capacity_tolrance = <5>;
	cust_poweron_max_vbat_tolrance = <70>;
	cust_poweron_delta_vbat_tolrance = <60>;
	cust_poweron_delta_hw_sw_ocv_capacity_tolrance = <10>;

	/* Fixed battery temperature */
	fixed_tbat_25 = <1>;
	/* Dynamic change wake up period of battery thread when suspend */
	vbat_normal_wakeup = <3600>;	/* Unit: mV */
	vbat_low_power_wakeup = <3500>;	/* Unit: mV */
	normal_wakeup_period = <5400>;	/* Unit: second */
	low_power_wakeup_period = <300>;	/* Unit: second */
	close_poweroff_wakeup_period = <30>;	/* Unit: second */

	rbat_pull_up_r = <16900>;
	rbat_pull_up_volt = <1800>;

	batt_temperature_table_num = <17>;
	batt_temperature_table = <
			    (-20) 75022
			    (-15) 57926
			    (-10) 45168
			    (-5) 35548
			    0 28224
			    5 22595
			    10 18231
			    15 14820
			    20 12133
			    25 10000 30 8295 35 6922 40 5810 45 4903 50 4160 55 3547 60 3039>;

	battery_profile_t0_num = <50>;
	battery_profile_t0 = <0 4187
				2	4144
				4	4113
				6	4092
				8	4074
				10	4055
				13	4038
				15	4022
				17	4006
				19	3992
				21	3979
				23	3966
				25	3955
				27	3942
				29	3929
				31	3918
				33	3907
				35	3897
				38	3884
				40	3869
				42	3855
				44	3842
				46	3829
				48	3820
				50	3811
				52	3805
				54	3799
				56	3795
				58	3790
				61	3787
				63	3783
				65	3779
				67	3777
				69	3774
				71	3771
				73	3768
				75	3762
				77	3756
				79	3750
				81	3743
				83	3737
				86	3726
				88	3715
				90	3702
				92	3688
				94	3682
				96	3677
				98	3664
				100 3590
				102 3447>;

	battery_profile_t1_num = <50>;
	battery_profile_t1 = <0 4187
				2	4144
				4	4113
				6	4092
				8	4074
				10	4055
				13	4038
				15	4022
				17	4006
				19	3992
				21	3979
				23	3966
				25	3955
				27	3942
				29	3929
				31	3918
				33	3907
				35	3897
				38	3884
				40	3869
				42	3855
				44	3842
				46	3829
				48	3820
				50	3811
				52	3805
				54	3799
				56	3795
				58	3790
				61	3787
				63	3783
				65	3779
				67	3777
				69	3774
				71	3771
				73	3768
				75	3762
				77	3756
				79	3750
				81	3743
				83	3737
				86	3726
				88	3715
				90	3702
				92	3688
				94	3682
				96	3677
				98	3664
				100 3590
				102 3447>;

	battery_profile_t2_num = <50>;
	battery_profile_t2 = <0 4187
				2	4144
				4	4113
				6	4092
				8	4074
				10	4055
				13	4038
				15	4022
				17	4006
				19	3992
				21	3979
				23	3966
				25	3955
				27	3942
				29	3929
				31	3918
				33	3907
				35	3897
				38	3884
				40	3869
				42	3855
				44	3842
				46	3829
				48	3820
				50	3811
				52	3805
				54	3799
				56	3795
				58	3790
				61	3787
				63	3783
				65	3779
				67	3777
				69	3774
				71	3771
				73	3768
				75	3762
				77	3756
				79	3750
				81	3743
				83	3737
				86	3726
				88	3715
				90	3702
				92	3688
				94	3682
				96	3677
				98	3664
				100 3590
				102 3447>;

	battery_profile_t3_num = <50>;
	battery_profile_t3 = <0 4187
				2	4144
				4	4113
				6	4092
				8	4074
				10	4055
				13	4038
				15	4022
				17	4006
				19	3992
				21	3979
				23	3966
				25	3955
				27	3942
				29	3929
				31	3918
				33	3907
				35	3897
				38	3884
				40	3869
				42	3855
				44	3842
				46	3829
				48	3820
				50	3811
				52	3805
				54	3799
				56	3795
				58	3790
				61	3787
				63	3783
				65	3779
				67	3777
				69	3774
				71	3771
				73	3768
				75	3762
				77	3756
				79	3750
				81	3743
				83	3737
				86	3726
				88	3715
				90	3702
				92	3688
				94	3682
				96	3677
				98	3664
				100 3590
				102 3447>;

	r_profile_t0_num = <50>;
	r_profile_t0 = <127 4187
				127 4144
				130 4113
				136 4092
				137 4074
				139 4055
				143 4038
				146 4022
				150 4006
				154 3992
				157 3979
				160 3966
				166 3955
				166 3942
				164 3929
				166 3918
				160 3907
				161 3897
				157 3884
				153 3869
				146 3855
				140 3842
				131 3829
				126 3820
				126 3811
				126 3805
				130 3799
				133 3795
				133 3790
				136 3787
				137 3783
				137 3779
				139 3777
				143 3774
				143 3771
				144 3768
				143 3762
				139 3756
				140 3750
				141 3743
				143 3737
				140 3726
				141 3715
				140 3702
				139 3688
				144 3682
				157 3677
				173 3664
				164 3590
				177 3447>;

	r_profile_t1_num = <50>;
	r_profile_t1 = <127 4187
				127 4144
				130 4113
				136 4092
				137 4074
				139 4055
				143 4038
				146 4022
				150 4006
				154 3992
				157 3979
				160 3966
				166 3955
				166 3942
				164 3929
				166 3918
				160 3907
				161 3897
				157 3884
				153 3869
				146 3855
				140 3842
				131 3829
				126 3820
				126 3811
				126 3805
				130 3799
				133 3795
				133 3790
				136 3787
				137 3783
				137 3779
				139 3777
				143 3774
				143 3771
				144 3768
				143 3762
				139 3756
				140 3750
				141 3743
				143 3737
				140 3726
				141 3715
				140 3702
				139 3688
				144 3682
				157 3677
				173 3664
				164 3590
				177 3447>;

	r_profile_t2_num = <50>;
	r_profile_t2 = <127 4187
				127 4144
				130 4113
				136 4092
				137 4074
				139 4055
				143 4038
				146 4022
				150 4006
				154 3992
				157 3979
				160 3966
				166 3955
				166 3942
				164 3929
				166 3918
				160 3907
				161 3897
				157 3884
				153 3869
				146 3855
				140 3842
				131 3829
				126 3820
				126 3811
				126 3805
				130 3799
				133 3795
				133 3790
				136 3787
				137 3783
				137 3779
				139 3777
				143 3774
				143 3771
				144 3768
				143 3762
				139 3756
				140 3750
				141 3743
				143 3737
				140 3726
				141 3715
				140 3702
				139 3688
				144 3682
				157 3677
				173 3664
				164 3590
				177 3447>;

	r_profile_t3_num = <50>;
	r_profile_t3 = <127 4187
				127 4144
				130 4113
				136 4092
				137 4074
				139 4055
				143 4038
				146 4022
				150 4006
				154 3992
				157 3979
				160 3966
				166 3955
				166 3942
				164 3929
				166 3918
				160 3907
				161 3897
				157 3884
				153 3869
				146 3855
				140 3842
				131 3829
				126 3820
				126 3811
				126 3805
				130 3799
				133 3795
				133 3790
				136 3787
				137 3783
				137 3779
				139 3777
				143 3774
				143 3771
				144 3768
				143 3762
				139 3756
				140 3750
				141 3743
				143 3737
				140 3726
				141 3715
				140 3702
				139 3688
				144 3682
				157 3677
				173 3664
				164 3590
				177 3447>;
};
