/*************************
 * Customized Battery Setting dtsi file
*************************/
&bat_comm {
	gpio22_dc_det = <&pio 22 0>;
	gpio85_set_chr_set = <&pio 85 0>;
	gpio28_spec_cur_select = <&pio 28 0>;
	/* cust_charging.h */
	/* stop charging while in talking mode */
	stop_charging_in_takling = <1>;
	talking_recharge_voltage = <3800>;
	talking_sync_time = <60>;

	/* Battery Temperature Protection */
	mtk_temperature_recharge_support = <1>;
	max_charge_temperature = <50>;
	max_charge_temperature_minus_x_degree = <47>;
	min_charge_temperature = <0>;
	min_charge_temperature_plus_x_degree = <6>;
	err_charge_temperature = <0xff>;

	/* Linear Charging Threshold */
	v_pre2cc_thres = <3400>;	/* unit: mV */
	v_cc2topoff_thres = <4050>;
	recharging_voltage = <4110>;
	charging_full_current = <80>;	/* unit: mA */

	/* Charging Current Setting */
	config_usb_if = <0>;
	usb_charger_current_suspend = <0>;	/* Unit: 0.01 mA */
	usb_charger_current_unconfigured = <7000>;	/* Unit: 0.01 mA */
	usb_charger_current_configured = <50000>;	/* Unit: 0.01 mA */
	usb_charger_current = <140000>;	/* Unit: 0.01 mA */
	ac_charger_current = <140000>;	/* Unit: 0.01 mA */
	non_std_ac_charger_current = <140000>;	/* Unit: 0.01 mA */
	charging_host_charger_current = <65000>;	/* Unit: 0.01 mA */
	apple_0_5a_charger_current = <50000>;	/* Unit: 0.01 mA */
	apple_1_0a_charger_current = <65000>;	/* Unit: 0.01 mA */
	apple_2_1a_charger_current = <50000>;	/* Unit: 0.01 mA */

	/* charger error check */
	bat_low_temp_protect_enable = <0>;
	v_charger_enable = <0>;	/* 1:on , 0:off */
	v_charger_max = <6500>;	/* unit: mV */
	v_charger_min = <4400>;

	/*  Tracking TIME */
	onehundred_percent_tracking_time = <10>;	/* Unit: second */
	npercent_tracking_time = <20>;	/* Unit: second */
	sync_to_real_tracking_time = <60>;	/* Unit: second */
	v_0percent_tracking = <3450>;	/* Unit: mV */

	/* High battery support */
	high_battery_voltage_support = <0>;
};

&bat_meter {
	/* cust_battery_meter.h */
	/* ADC resistor  */
	r_bat_sense = <4>;
	r_i_sense = <4>;
	r_charger_1 = <330>;
	r_charger_2 = <39>;
	temperature_t0 = <110>;
	temperature_t1 = <0>;
	temperature_t2 = <25>;
	temperature_t3 = <50>;
	temperature_t = <255>;	/* this should be fixed, never change the value */
	fg_meter_resistance = <0>;

	/* Qmax for 0mA */
	q_max_pos_50 = <3450>;
	q_max_pos_25 = <3450>;
	q_max_pos_0 = <3450>;
	q_max_neg_10 = <3450>;
	/* Qmax for 600mA, said high current */
	q_max_pos_50_h_current = <3113>;
	q_max_pos_25_h_current = <3113>;
	q_max_pos_0_h_current = <3113>;
	q_max_neg_10_h_current = <3113>;
	/* Discharge percentage, 1: D5, 0: D2 */
	oam_d5 = <1>;

	change_tracking_point = <1>;
	/* SW OCV tracking setting */
	cust_tracking_point = <14>;
	cust_r_sense = <200>;
	cust_hw_cc = <0>;
	aging_tuning_value = <100>;
	cust_r_fg_offset = <0>;
	ocv_board_compesate = <0>;
	r_fg_board_base = <1000>;
	r_fg_board_slope = <1000>;
	car_tune_value = <89>;

	/* HW Fuel gague  */
	current_detect_r_fg = <10>;	/* Unit: mA */
	minerroroffset = <1000>;
	fg_vbat_average_size = <18>;
	r_fg_value = <10>;	/* Unit: mOhm */

	cust_poweron_delta_capacity_tolrance = <80>;
	cust_poweron_low_capacity_tolrance = <5>;
	cust_poweron_max_vbat_tolrance = <70>;
	cust_poweron_delta_vbat_tolrance = <60>;
	cust_poweron_delta_hw_sw_ocv_capacity_tolrance = <10>;

	/* Fixed battery temperature */
	fixed_tbat_25 = <1>;
	/* Dynamic change wake up period of battery thread when suspend */
	vbat_normal_wakeup = <3600>;	/* Unit: mV */
	vbat_low_power_wakeup = <3500>;	/* Unit: mV */
	normal_wakeup_period = <5400>;	/* Unit: second */
	low_power_wakeup_period = <300>;	/* Unit: second */
	close_poweroff_wakeup_period = <30>;	/* Unit: second */

	rbat_pull_up_r = <16900>;
	rbat_pull_up_volt = <1800>;

	batt_temperature_table_num = <17>;
	batt_temperature_table = <
			    (-20) 75022
			    (-15) 57926
			    (-10) 45168
			    (-5) 35548
			    0 28224
			    5 22595
			    10 18231
			    15 14820
			    20 12133
			    25 10000 30 8295 35 6922 40 5810 45 4903 50 4160 55 3547 60 3039>;

	battery_profile_t0_num = <81>;
	battery_profile_t0 = <0 4189
				1 4166
				3 4149
				4 4132
				6 4118
				7 4104
				9 4092
				10 4079
				12 4067
				13 4055
				14 4043
				16 4031
				17 4019
				19 4008
				20 3997
				22 3988
				23 3978
				25 3969
				26 3959
				28 3948
				29 3939
				30 3931
				32 3923
				33 3915
				35 3906
				36 3899
				38 3891
				39 3884
				41 3876
				42 3869
				43 3863
				45 3856
				46 3848
				48 3840
				49 3831
				51 3820
				52 3811
				54 3802
				55 3796
				57 3790
				58 3786
				59 3783
				61 3780
				62 3778
				64 3777
				65 3776
				67 3775
				68 3774
				70 3773
				71 3771
				72 3771
				74 3770
				75 3768
				77 3766
				78 3765
				80 3762
				81 3757
				83 3751
				84 3743
				86 3736
				87 3728
				88 3718
				90 3706
				91 3692
				93 3675
				94 3659
				96 3641
				97 3626
				99 3613
				100 3600
				101 3585
				103 3570
				104 3557
				106 3543
				107 3527
				109 3516
				110 3508
				112 3499
				113 3488
				114 3475
				116 3451>;

	battery_profile_t1_num = <81>;
	battery_profile_t1 = <0 4189
				1 4166
				3 4149
				4 4132
				6 4118
				7 4104
				9 4092
				10 4079
				12 4067
				13 4055
				14 4043
				16 4031
				17 4019
				19 4008
				20 3997
				22 3988
				23 3978
				25 3969
				26 3959
				28 3948
				29 3939
				30 3931
				32 3923
				33 3915
				35 3906
				36 3899
				38 3891
				39 3884
				41 3876
				42 3869
				43 3863
				45 3856
				46 3848
				48 3840
				49 3831
				51 3820
				52 3811
				54 3802
				55 3796
				57 3790
				58 3786
				59 3783
				61 3780
				62 3778
				64 3777
				65 3776
				67 3775
				68 3774
				70 3773
				71 3771
				72 3771
				74 3770
				75 3768
				77 3766
				78 3765
				80 3762
				81 3757
				83 3751
				84 3743
				86 3736
				87 3728
				88 3718
				90 3706
				91 3692
				93 3675
				94 3659
				96 3641
				97 3626
				99 3613
				100 3600
				101 3585
				103 3570
				104 3557
				106 3543
				107 3527
				109 3516
				110 3508
				112 3499
				113 3488
				114 3475
				116 3451>;

	battery_profile_t2_num = <81>;
	battery_profile_t2 = <0 4189
				1 4166
				3 4149
				4 4132
				6 4118
				7 4104
				9 4092
				10 4079
				12 4067
				13 4055
				14 4043
				16 4031
				17 4019
				19 4008
				20 3997
				22 3988
				23 3978
				25 3969
				26 3959
				28 3948
				29 3939
				30 3931
				32 3923
				33 3915
				35 3906
				36 3899
				38 3891
				39 3884
				41 3876
				42 3869
				43 3863
				45 3856
				46 3848
				48 3840
				49 3831
				51 3820
				52 3811
				54 3802
				55 3796
				57 3790
				58 3786
				59 3783
				61 3780
				62 3778
				64 3777
				65 3776
				67 3775
				68 3774
				70 3773
				71 3771
				72 3771
				74 3770
				75 3768
				77 3766
				78 3765
				80 3762
				81 3757
				83 3751
				84 3743
				86 3736
				87 3728
				88 3718
				90 3706
				91 3692
				93 3675
				94 3659
				96 3641
				97 3626
				99 3613
				100 3600
				101 3585
				103 3570
				104 3557
				106 3543
				107 3527
				109 3516
				110 3508
				112 3499
				113 3488
				114 3475
				116 3451>;
	battery_profile_t3_num = <81>;
	battery_profile_t3 = <0 4189
				1 4166
				3 4149
				4 4132
				6 4118
				7 4104
				9 4092
				10 4079
				12 4067
				13 4055
				14 4043
				16 4031
				17 4019
				19 4008
				20 3997
				22 3988
				23 3978
				25 3969
				26 3959
				28 3948
				29 3939
				30 3931
				32 3923
				33 3915
				35 3906
				36 3899
				38 3891
				39 3884
				41 3876
				42 3869
				43 3863
				45 3856
				46 3848
				48 3840
				49 3831
				51 3820
				52 3811
				54 3802
				55 3796
				57 3790
				58 3786
				59 3783
				61 3780
				62 3778
				64 3777
				65 3776
				67 3775
				68 3774
				70 3773
				71 3771
				72 3771
				74 3770
				75 3768
				77 3766
				78 3765
				80 3762
				81 3757
				83 3751
				84 3743
				86 3736
				87 3728
				88 3718
				90 3706
				91 3692
				93 3675
				94 3659
				96 3641
				97 3626
				99 3613
				100 3600
				101 3585
				103 3570
				104 3557
				106 3543
				107 3527
				109 3516
				110 3508
				112 3499
				113 3488
				114 3475
				116 3451>;
	r_profile_t0_num = <81>;
	r_profile_t0 = <83 4189
				83 4166
				85 4149
				85 4132
				86 4118
				85 4104
				87 4092
				85 4079
				86 4067
				85 4055
				86 4043
				88 4031
				88 4019
				88 4008
				89 3997
				90 3988
				91 3978
				91 3969
				92 3959
				91 3948
				91 3939
				93 3931
				97 3923
				98 3915
				97 3906
				99 3899
				99 3891
				101 3884
				101 3876
				102 3869
				101 3863
				101 3856
				101 3848
				102 3840
				99 3831
				94 3820
				91 3811
				89 3802
				87 3796
				86 3790
				85 3786
				85 3783
				85 3780
				85 3778
				85 3777
				85 3776
				86 3775
				87 3774
				87 3773
				87 3772
				86 3771
				88 3770
				88 3768
				90 3766
				90 3765
				91 3762
				92 3757
				92 3751
				94 3743
				99 3736
				100 3728
				102 3718
				102 3706
				103 3692
				100 3675
				100 3659
				98 3641
				98 3626
				99 3613
				98 3600
				97 3585
				98 3570
				99 3557
				100 3543
				99 3527
				102 3516
				106 3508
				110 3499
				116 3488
				128 3475
				145 3451>;

	r_profile_t1_num = <81>;
	r_profile_t1 = <83 4189
				83 4166
				85 4149
				85 4132
				86 4118
				85 4104
				87 4092
				85 4079
				86 4067
				85 4055
				86 4043
				88 4031
				88 4019
				88 4008
				89 3997
				90 3988
				91 3978
				91 3969
				92 3959
				91 3948
				91 3939
				93 3931
				97 3923
				98 3915
				97 3906
				99 3899
				99 3891
				101 3884
				101 3876
				102 3869
				101 3863
				101 3856
				101 3848
				102 3840
				99 3831
				94 3820
				91 3811
				89 3802
				87 3796
				86 3790
				85 3786
				85 3783
				85 3780
				85 3778
				85 3777
				85 3776
				86 3775
				87 3774
				87 3773
				87 3772
				86 3771
				88 3770
				88 3768
				90 3766
				90 3765
				91 3762
				92 3757
				92 3751
				94 3743
				99 3736
				100 3728
				102 3718
				102 3706
				103 3692
				100 3675
				100 3659
				98 3641
				98 3626
				99 3613
				98 3600
				97 3585
				98 3570
				99 3557
				100 3543
				99 3527
				102 3516
				106 3508
				110 3499
				116 3488
				128 3475
				145 3451>;

	r_profile_t2_num = <81>;
	r_profile_t2 = <83 4189
				83 4166
				85 4149
				85 4132
				86 4118
				85 4104
				87 4092
				85 4079
				86 4067
				85 4055
				86 4043
				88 4031
				88 4019
				88 4008
				89 3997
				90 3988
				91 3978
				91 3969
				92 3959
				91 3948
				91 3939
				93 3931
				97 3923
				98 3915
				97 3906
				99 3899
				99 3891
				101 3884
				101 3876
				102 3869
				101 3863
				101 3856
				101 3848
				102 3840
				99 3831
				94 3820
				91 3811
				89 3802
				87 3796
				86 3790
				85 3786
				85 3783
				85 3780
				85 3778
				85 3777
				85 3776
				86 3775
				87 3774
				87 3773
				87 3772
				86 3771
				88 3770
				88 3768
				90 3766
				90 3765
				91 3762
				92 3757
				92 3751
				94 3743
				99 3736
				100 3728
				102 3718
				102 3706
				103 3692
				100 3675
				100 3659
				98 3641
				98 3626
				99 3613
				98 3600
				97 3585
				98 3570
				99 3557
				100 3543
				99 3527
				102 3516
				106 3508
				110 3499
				116 3488
				128 3475
				145 3451>;

	r_profile_t3_num = <81>;
	r_profile_t3 = <83 4189
				83 4166
				85 4149
				85 4132
				86 4118
				85 4104
				87 4092
				85 4079
				86 4067
				85 4055
				86 4043
				88 4031
				88 4019
				88 4008
				89 3997
				90 3988
				91 3978
				91 3969
				92 3959
				91 3948
				91 3939
				93 3931
				97 3923
				98 3915
				97 3906
				99 3899
				99 3891
				101 3884
				101 3876
				102 3869
				101 3863
				101 3856
				101 3848
				102 3840
				99 3831
				94 3820
				91 3811
				89 3802
				87 3796
				86 3790
				85 3786
				85 3783
				85 3780
				85 3778
				85 3777
				85 3776
				86 3775
				87 3774
				87 3773
				87 3772
				86 3771
				88 3770
				88 3768
				90 3766
				90 3765
				91 3762
				92 3757
				92 3751
				94 3743
				99 3736
				100 3728
				102 3718
				102 3706
				103 3692
				100 3675
				100 3659
				98 3641
				98 3626
				99 3613
				98 3600
				97 3585
				98 3570
				99 3557
				100 3543
				99 3527
				102 3516
				106 3508
				110 3499
				116 3488
				128 3475
				145 3451>;
};
