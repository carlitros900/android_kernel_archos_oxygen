/*************************
 * Customized Battery Setting dtsi file
*************************/
&bat_comm {
	gpio22_dc_det = <&pio 22 0>;
	gpio85_set_chr_set = <&pio 85 0>;
	gpio28_spec_cur_select = <&pio 28 0>;

	/* cust_charging.h */
	/* stop charging while in talking mode */
	stop_charging_in_takling = <1>;
	talking_recharge_voltage = <3800>;
	talking_sync_time = <60>;

	/* Battery Temperature Protection */
	mtk_temperature_recharge_support = <1>;
	max_charge_temperature = <50>;
	max_charge_temperature_minus_x_degree = <47>;
	min_charge_temperature = <0>;
	min_charge_temperature_plus_x_degree = <6>;
	err_charge_temperature = <0xff>;

	/* Linear Charging Threshold */
	v_pre2cc_thres = <3400>;	/* unit: mV */
	v_cc2topoff_thres = <4050>;
	recharging_voltage = <4110>;
	charging_full_current = <80>;	/* unit: mA */

	/* Charging Current Setting */
	config_usb_if = <0>;
	usb_charger_current_suspend = <0>;	/* Unit: 0.01 mA */
	usb_charger_current_unconfigured = <7000>;	/* Unit: 0.01 mA */
	usb_charger_current_configured = <50000>;	/* Unit: 0.01 mA */
	usb_charger_current = <50000>;	/* Unit: 0.01 mA */
	ac_charger_current = <130000>;	/* Unit: 0.01 mA */
	non_std_ac_charger_current = <50000>;	/* Unit: 0.01 mA */
	charging_host_charger_current = <65000>;	/* Unit: 0.01 mA */
	apple_0_5a_charger_current = <50000>;	/* Unit: 0.01 mA */
	apple_1_0a_charger_current = <65000>;	/* Unit: 0.01 mA */
	apple_2_1a_charger_current = <80000>;	/* Unit: 0.01 mA */

	/* charger error check */
	bat_low_temp_protect_enable = <0>;
	v_charger_enable = <0>;	/* 1:on , 0:off */
	v_charger_max = <6500>;	/* unit: mV */
	v_charger_min = <4400>;

	/*  Tracking TIME */
	onehundred_percent_tracking_time = <10>;	/* Unit: second */
	npercent_tracking_time = <20>;	/* Unit: second */
	sync_to_real_tracking_time = <60>;	/* Unit: second */
	v_0percent_tracking = <3450>;	/* Unit: mV */

	/* High battery support */
	high_battery_voltage_support = <1>;
};

&bat_meter {
	/* cust_battery_meter.h */
	/* ADC resistor  */
	r_bat_sense = <4>;
	r_i_sense = <4>;
	r_charger_1 = <330>;
	r_charger_2 = <39>;
	temperature_t0 = <110>;
	temperature_t1 = <0>;
	temperature_t2 = <25>;
	temperature_t3 = <50>;
	temperature_t = <255>;	/* this should be fixed, never change the value */
	fg_meter_resistance = <0>;

	/* Qmax for 0mA */
	q_max_pos_50 = <3450>;
	q_max_pos_25 = <3450>;
	q_max_pos_0 = <3450>;
	q_max_neg_10 = <3450>;
	/* Qmax for 400mA, said high current */
	q_max_pos_50_h_current = <3420>;
	q_max_pos_25_h_current = <3420>;
	q_max_pos_0_h_current = <3420>;
	q_max_neg_10_h_current = <3420>;
	/* Discharge percentage, 1: D5, 0: D2 */
	oam_d5 = <1>;

	change_tracking_point = <1>;
	/* SW OCV tracking setting */
	cust_tracking_point = <14>;
	cust_r_sense = <200>;
	cust_hw_cc = <0>;
	aging_tuning_value = <100>;
	cust_r_fg_offset = <0>;
	ocv_board_compesate = <0>;
	r_fg_board_base = <1000>;
	r_fg_board_slope = <1000>;
	car_tune_value = <89>;

	/* HW Fuel gague  */
	current_detect_r_fg = <10>;	/* Unit: mA */
	minerroroffset = <1000>;
	fg_vbat_average_size = <18>;
	r_fg_value = <10>;	/* Unit: mOhm */

	cust_poweron_delta_capacity_tolrance = <80>;
	cust_poweron_low_capacity_tolrance = <5>;
	cust_poweron_max_vbat_tolrance = <70>;
	cust_poweron_delta_vbat_tolrance = <60>;
	cust_poweron_delta_hw_sw_ocv_capacity_tolrance = <10>;

	/* Fixed battery temperature */
	fixed_tbat_25 = <1>;
	/* Dynamic change wake up period of battery thread when suspend */
	vbat_normal_wakeup = <3600>;	/* Unit: mV */
	vbat_low_power_wakeup = <3500>;	/* Unit: mV */
	normal_wakeup_period = <5400>;	/* Unit: second */
	low_power_wakeup_period = <300>;	/* Unit: second */
	close_poweroff_wakeup_period = <30>;	/* Unit: second */

	rbat_pull_up_r = <16900>;
	rbat_pull_up_volt = <1800>;

	batt_temperature_table_num = <17>;
	batt_temperature_table = <
			    (-20) 75022
			    (-15) 57926
			    (-10) 45168
			    (-5) 35548
			    0 28224
			    5 22595
			    10 18231
			    15 14820
			    20 12133
			    25 10000 30 8295 35 6922 40 5810 45 4903 50 4160 55 3547 60 3039>;

	battery_profile_t0_num = <97>;
	battery_profile_t0 = <  0        4345
				1  	4289
				2  	4274
				3  	4261
				3  	4249
				4  	4238
				5  	4227
				6  	4217
				7  	4207
				8  	4197
				9  	4187
				10 	4168
				11 	4159
				12 	4151
				13 	4142
				14 	4133
				15 	4123
				16 	4115
				17 	4094
				18 	4085
				19 	4080
				20 	4071
				21 	4063
				23 	4039
				24 	4032
				25 	4027
				27 	4009
				28 	3996
				29 	3983
				30 	3958
				31 	3951
				33 	3938
				34 	3933
				35 	3928
				36 	3924
				37 	3915
				38 	3909
				39 	3903
				40 	3896
				41 	3890
				42 	3884
				43 	3871
				44 	3864
				45 	3855
				46 	3849
				47 	3843
				48 	3840
				49 	3835
				50      3826
				51       3822
				52       3818
				53       3815
				54       3812
				55       3809
				56       3804
				57       3797
				58       3794
				59       3791
				60       3788
				61       3785
				62       3782
				63       3776
				64       3773
				65       3771
				66       3768
				67       3766
				68       3763
				69       3761
				70       3757
				71       3755
				72       3752
				73       3750
				74       3748
				76       3743
				77       3738
				78       3734
				79       3732
				80       3729
				81       3726
				82       3722
				83       3717
				84       3713
				85       3709
				86       3704
				87       3699
				88       3694
				89       3689
				90       3678
				91       3672
				92       3670
				94       3666
				96       3659
				97       3647
				98       3633
				99       3604
				100      3561 >;

	battery_profile_t1_num = <97>;
	battery_profile_t1 = <  0        4345
				1  	4289
				2  	4274
				3  	4261
				3  	4249
				4  	4238
				5  	4227
				6  	4217
				7  	4207
				8  	4197
				9  	4187
				10 	4168
				11 	4159
				12 	4151
				13 	4142
				14 	4133
				15 	4123
				16 	4115
				17 	4094
				18 	4085
				19 	4080
				20 	4071
				21 	4063
				23 	4039
				24 	4032
				25 	4027
				27 	4009
				28 	3996
				29 	3983
				30 	3958
				31 	3951
				33 	3938
				34 	3933
				35 	3928
				36 	3924
				37 	3915
				38 	3909
				39 	3903
				40 	3896
				41 	3890
				42 	3884
				43 	3871
				44 	3864
				45 	3855
				46 	3849
				47 	3843
				48 	3840
				49 	3835
				50      3826
				51       3822
				52       3818
				53       3815
				54       3812
				55       3809
				56       3804
				57       3797
				58       3794
				59       3791
				60       3788
				61       3785
				62       3782
				63       3776
				64       3773
				65       3771
				66       3768
				67       3766
				68       3763
				69       3761
				70       3757
				71       3755
				72       3752
				73       3750
				74       3748
				76       3743
				77       3738
				78       3734
				79       3732
				80       3729
				81       3726
				82       3722
				83       3717
				84       3713
				85       3709
				86       3704
				87       3699
				88       3694
				89       3689
				90       3678
				91       3672
				92       3670
				94       3666
				96       3659
				97       3647
				98       3633
				99       3604
				100      3561 >;

	battery_profile_t2_num = <97>;
	battery_profile_t2 = <  0        4345
				1  	4289
				2  	4274
				3  	4261
				3  	4249
				4  	4238
				5  	4227
				6  	4217
				7  	4207
				8  	4197
				9  	4187
				10 	4168
				11 	4159
				12 	4151
				13 	4142
				14 	4133
				15 	4123
				16 	4115
				17 	4094
				18 	4085
				19 	4080
				20 	4071
				21 	4063
				23 	4039
				24 	4032
				25 	4027
				27 	4009
				28 	3996
				29 	3983
				30 	3958
				31 	3951
				33 	3938
				34 	3933
				35 	3928
				36 	3924
				37 	3915
				38 	3909
				39 	3903
				40 	3896
				41 	3890
				42 	3884
				43 	3871
				44 	3864
				45 	3855
				46 	3849
				47 	3843
				48 	3840
				49 	3835
				50      3826
				51       3822
				52       3818
				53       3815
				54       3812
				55       3809
				56       3804
				57       3797
				58       3794
				59       3791
				60       3788
				61       3785
				62       3782
				63       3776
				64       3773
				65       3771
				66       3768
				67       3766
				68       3763
				69       3761
				70       3757
				71       3755
				72       3752
				73       3750
				74       3748
				76       3743
				77       3738
				78       3734
				79       3732
				80       3729
				81       3726
				82       3722
				83       3717
				84       3713
				85       3709
				86       3704
				87       3699
				88       3694
				89       3689
				90       3678
				91       3672
				92       3670
				94       3666
				96       3659
				97       3647
				98       3633
				99       3604
				100      3561 >;

	battery_profile_t3_num = <97>;
	battery_profile_t3 = <  0        4345
				1  	4289
				2  	4274
				3  	4261
				3  	4249
				4  	4238
				5  	4227
				6  	4217
				7  	4207
				8  	4197
				9  	4187
				10 	4168
				11 	4159
				12 	4151
				13 	4142
				14 	4133
				15 	4123
				16 	4115
				17 	4094
				18 	4085
				19 	4080
				20 	4071
				21 	4063
				23 	4039
				24 	4032
				25 	4027
				27 	4009
				28 	3996
				29 	3983
				30 	3958
				31 	3951
				33 	3938
				34 	3933
				35 	3928
				36 	3924
				37 	3915
				38 	3909
				39 	3903
				40 	3896
				41 	3890
				42 	3884
				43 	3871
				44 	3864
				45 	3855
				46 	3849
				47 	3843
				48 	3840
				49 	3835
				50      3826
				51       3822
				52       3818
				53       3815
				54       3812
				55       3809
				56       3804
				57       3797
				58       3794
				59       3791
				60       3788
				61       3785
				62       3782
				63       3776
				64       3773
				65       3771
				66       3768
				67       3766
				68       3763
				69       3761
				70       3757
				71       3755
				72       3752
				73       3750
				74       3748
				76       3743
				77       3738
				78       3734
				79       3732
				80       3729
				81       3726
				82       3722
				83       3717
				84       3713
				85       3709
				86       3704
				87       3699
				88       3694
				89       3689
				90       3678
				91       3672
				92       3670
				94       3666
				96       3659
				97       3647
				98       3633
				99       3604
				100      3561 >;

	r_profile_t0_num = <97>;
	r_profile_t0 = <        54      4345
				48	4289
				49	4274
				49	4261
				52	4249
				53	4238
				55	4227
				56	4217
				55	4207
				56	4197
				56	4187
				55	4168
				56	4159
				55	4151
				51	4142
				51	4133
				52	4123
				50	4115
				53	4094
				50	4085
				62	4080
				61	4071
				58	4063
				59	4039
				58	4032
				56	4027
				51	4009
				58	3996
				58	3983
				53	3958
				56	3951
				57	3938
				57	3933
				58	3928
				56	3924
				53	3915
				53	3909
				55	3903
				53	3896
				54	3890
				56	3884
				58	3871
				61	3864
				62	3855
				62	3849
				71	3843
				66	3840
				64	3835
				67     3826
				68      3822
				69      3818
				81      3815
				80      3812
				79      3809
				79      3804
				80      3797
				79      3794
				81      3791
				80      3788
				81      3785
				82      3782
				79      3776
				79      3773
				80      3771
				82      3768
				82      3766
				82      3763
				83      3761
				79      3757
				78      3755
				81      3752
				83      3750
				83      3748
				82      3743
				78      3738
				76      3734
				78      3732
				78      3729
				80      3726
				80      3722
				85      3717
				86      3713
				83      3709
				81      3704
				82      3699
				83      3694
				80      3689
				82      3678
				85      3672
				91      3670
				84      3666
				79      3659
				75      3647
				81      3633
				87      3604
				87      3561 >;


	r_profile_t1_num = <97>;
	r_profile_t1 = <        54      4345
				48	4289
				49	4274
				49	4261
				52	4249
				53	4238
				55	4227
				56	4217
				55	4207
				56	4197
				56	4187
				55	4168
				56	4159
				55	4151
				51	4142
				51	4133
				52	4123
				50	4115
				53	4094
				50	4085
				62	4080
				61	4071
				58	4063
				59	4039
				58	4032
				56	4027
				51	4009
				58	3996
				58	3983
				53	3958
				56	3951
				57	3938
				57	3933
				58	3928
				56	3924
				53	3915
				53	3909
				55	3903
				53	3896
				54	3890
				56	3884
				58	3871
				61	3864
				62	3855
				62	3849
				71	3843
				66	3840
				64	3835
				67     3826
				68      3822
				69      3818
				81      3815
				80      3812
				79      3809
				79      3804
				80      3797
				79      3794
				81      3791
				80      3788
				81      3785
				82      3782
				79      3776
				79      3773
				80      3771
				82      3768
				82      3766
				82      3763
				83      3761
				79      3757
				78      3755
				81      3752
				83      3750
				83      3748
				82      3743
				78      3738
				76      3734
				78      3732
				78      3729
				80      3726
				80      3722
				85      3717
				86      3713
				83      3709
				81      3704
				82      3699
				83      3694
				80      3689
				82      3678
				85      3672
				91      3670
				84      3666
				79      3659
				75      3647
				81      3633
				87      3604
				87      3561 >;


	r_profile_t2_num = <97>;
	r_profile_t2 = <        54      4345
				48	4289
				49	4274
				49	4261
				52	4249
				53	4238
				55	4227
				56	4217
				55	4207
				56	4197
				56	4187
				55	4168
				56	4159
				55	4151
				51	4142
				51	4133
				52	4123
				50	4115
				53	4094
				50	4085
				62	4080
				61	4071
				58	4063
				59	4039
				58	4032
				56	4027
				51	4009
				58	3996
				58	3983
				53	3958
				56	3951
				57	3938
				57	3933
				58	3928
				56	3924
				53	3915
				53	3909
				55	3903
				53	3896
				54	3890
				56	3884
				58	3871
				61	3864
				62	3855
				62	3849
				71	3843
				66	3840
				64	3835
				67     3826
				68      3822
				69      3818
				81      3815
				80      3812
				79      3809
				79      3804
				80      3797
				79      3794
				81      3791
				80      3788
				81      3785
				82      3782
				79      3776
				79      3773
				80      3771
				82      3768
				82      3766
				82      3763
				83      3761
				79      3757
				78      3755
				81      3752
				83      3750
				83      3748
				82      3743
				78      3738
				76      3734
				78      3732
				78      3729
				80      3726
				80      3722
				85      3717
				86      3713
				83      3709
				81      3704
				82      3699
				83      3694
				80      3689
				82      3678
				85      3672
				91      3670
				84      3666
				79      3659
				75      3647
				81      3633
				87      3604
				87      3561 >;


	r_profile_t3_num = <97>;
	r_profile_t3 = <        54      4345
				48	4289
				49	4274
				49	4261
				52	4249
				53	4238
				55	4227
				56	4217
				55	4207
				56	4197
				56	4187
				55	4168
				56	4159
				55	4151
				51	4142
				51	4133
				52	4123
				50	4115
				53	4094
				50	4085
				62	4080
				61	4071
				58	4063
				59	4039
				58	4032
				56	4027
				51	4009
				58	3996
				58	3983
				53	3958
				56	3951
				57	3938
				57	3933
				58	3928
				56	3924
				53	3915
				53	3909
				55	3903
				53	3896
				54	3890
				56	3884
				58	3871
				61	3864
				62	3855
				62	3849
				71	3843
				66	3840
				64	3835
				67     3826
				68      3822
				69      3818
				81      3815
				80      3812
				79      3809
				79      3804
				80      3797
				79      3794
				81      3791
				80      3788
				81      3785
				82      3782
				79      3776
				79      3773
				80      3771
				82      3768
				82      3766
				82      3763
				83      3761
				79      3757
				78      3755
				81      3752
				83      3750
				83      3748
				82      3743
				78      3738
				76      3734
				78      3732
				78      3729
				80      3726
				80      3722
				85      3717
				86      3713
				83      3709
				81      3704
				82      3699
				83      3694
				80      3689
				82      3678
				85      3672
				91      3670
				84      3666
				79      3659
				75      3647
				81      3633
				87      3604
				87      3561 >;

};
