/*************************
 * Customized Battery Setting dtsi file
*************************/
&bat_comm {
	gpio22_dc_det = <&pio 22 0>;
	gpio85_set_chr_set = <&pio 85 0>;
	gpio28_spec_cur_select = <&pio 28 0>;
	/* cust_charging.h */
	/* stop charging while in talking mode */
	stop_charging_in_takling = <1>;
	talking_recharge_voltage = <3800>;
	talking_sync_time = <60>;

	/* Battery Temperature Protection */
	mtk_temperature_recharge_support = <1>;
	max_charge_temperature = <50>;
	max_charge_temperature_minus_x_degree = <47>;
	min_charge_temperature = <0>;
	min_charge_temperature_plus_x_degree = <6>;
	err_charge_temperature = <0xff>;

	/* Linear Charging Threshold */
	v_pre2cc_thres = <3400>;	/* unit: mV */
	v_cc2topoff_thres = <4050>;
	recharging_voltage = <4110>;
	charging_full_current = <80>;	/* unit: mA */

	/* Charging Current Setting */
	config_usb_if = <0>;
	usb_charger_current_suspend = <0>;	/* Unit: 0.01 mA */
	usb_charger_current_unconfigured = <7000>;	/* Unit: 0.01 mA */
	usb_charger_current_configured = <50000>;	/* Unit: 0.01 mA */
	usb_charger_current = <120000>;	/* Unit: 0.01 mA */
	ac_charger_current = <120000>;	/* Unit: 0.01 mA */
	non_std_ac_charger_current = <50000>;	/* Unit: 0.01 mA */
	charging_host_charger_current = <65000>;	/* Unit: 0.01 mA */
	apple_0_5a_charger_current = <50000>;	/* Unit: 0.01 mA */
	apple_1_0a_charger_current = <65000>;	/* Unit: 0.01 mA */
	apple_2_1a_charger_current = <80000>;	/* Unit: 0.01 mA */

	/* charger error check */
	bat_low_temp_protect_enable = <0>;
	v_charger_enable = <0>;	/* 1:on , 0:off */
	v_charger_max = <6500>;	/* unit: mV */
	v_charger_min = <4400>;

	/*  Tracking TIME */
	onehundred_percent_tracking_time = <1800>;	/* Unit: second */
	npercent_tracking_time = <200>;	/* Unit: second */
	sync_to_real_tracking_time = <300>;	/* Unit: second */
	v_0percent_tracking = <3470>;	/* Unit: mV */

	/* High battery support */
	high_battery_voltage_support = <0>;
};

&bat_meter {
	/* cust_battery_meter.h */
	/* ADC resistor  */
	r_bat_sense = <4>;
	r_i_sense = <4>;
	r_charger_1 = <330>;
	r_charger_2 = <39>;
	temperature_t0 = <110>;
	temperature_t1 = <0>;
	temperature_t2 = <25>;
	temperature_t3 = <50>;
	temperature_t = <255>;	/* this should be fixed, never change the value */
	fg_meter_resistance = <0>;

	/* Qmax for 0mA */
	q_max_pos_50 = <4063>;
	q_max_pos_25 = <4063>;
	q_max_pos_0 = <4063>;
	q_max_neg_10 = <4063>;
	/* Qmax for 600mA, said high current */
	q_max_pos_50_h_current = <3630>;
	q_max_pos_25_h_current = <3630>;
	q_max_pos_0_h_current = <3630>;
	q_max_neg_10_h_current = <3630>;
	/* Discharge percentage, 1: D5, 0: D2 */
	oam_d5 = <1>;

	change_tracking_point = <1>;
	/* SW OCV tracking setting */
	cust_tracking_point = <14>;
	cust_r_sense = <200>;
	cust_hw_cc = <0>;
	aging_tuning_value = <100>;
	cust_r_fg_offset = <0>;
	ocv_board_compesate = <0>;
	r_fg_board_base = <1000>;
	r_fg_board_slope = <1000>;
	car_tune_value = <89>;

	/* HW Fuel gague  */
	current_detect_r_fg = <10>;	/* Unit: mA */
	minerroroffset = <1000>;
	fg_vbat_average_size = <18>;
	r_fg_value = <20>;	/* Unit: mOhm */

	cust_poweron_delta_capacity_tolrance = <80>;
	cust_poweron_low_capacity_tolrance = <0>;
	cust_poweron_max_vbat_tolrance = <70>;
	cust_poweron_delta_vbat_tolrance = <60>;
	cust_poweron_delta_hw_sw_ocv_capacity_tolrance = <10>;

	/* Fixed battery temperature */
	fixed_tbat_25 = <1>;
	/* Dynamic change wake up period of battery thread when suspend */
	vbat_normal_wakeup = <3600>;	/* Unit: mV */
	vbat_low_power_wakeup = <3500>;	/* Unit: mV */
	normal_wakeup_period = <5400>;	/* Unit: second */
	low_power_wakeup_period = <300>;	/* Unit: second */
	close_poweroff_wakeup_period = <30>;	/* Unit: second */

	rbat_pull_up_r = <16900>;
	rbat_pull_up_volt = <1800>;

	batt_temperature_table_num = <17>;
	batt_temperature_table = <
			    (-20) 75022
			    (-15) 57926
			    (-10) 45168
			    (-5) 35548
			    0 28224
			    5 22595
			    10 18231
			    15 14820
			    20 12133
			    25 10000 30 8295 35 6922 40 5810 45 4903 50 4160 55 3547 60 3039>;

	battery_profile_t0_num = <87>;
	battery_profile_t0 = <0 4189
				1    4167	
				3    4152
                                4    4137
                                5    4123
                                7    4111
                                8    4099
                                9    4089
                                11   4078
                                12   4067
                                13   4058
                                15   4050
                                16   4043
                                18   4035
                                19   4028
                                20   4019
                                22   4010
                                23   4000
                                24   3991
                                26   3983
                                27   3975
                                28   3966
                                30   3958
                                31   3948
                                32   3941
                                34   3933
                                35   3926
                                36   3919
                                38   3912
                                39   3906
                                40   3900
                                42   3894
                                43   3885
                                44   3877
                                46   3871
                                47   3863
                                49   3853
                                50   3842
                                51   3832
                                53   3820
                                54   3813
                                55   3805
                                57   3799
                                58   3795
                                59   3790
                                61   3786
                                62   3783
                                63   3781
                                65   3778
                                67   3775
                                69   3775
                                71   3773
                                73   3772
                                75   3770
                                77   3769
                                78   3768
                                79   3765
                                81   3762
                                82   3756
                                84   3749
                                85   3741
                                86   3733
                                88   3724
                                89   3713
                                90   3701
                                92   3686
                                93   3671
                                94   3656
                                96   3642
                                97   3627
                                98   3615
                                100  3603
                                101  3589
                                101  3576
                                101  3564
                                101  3551
                                101  3539
                                101  3527
                                101  3517
                                101  3508
                                101  3500
                                101  3491
                                101  3481
                                101  3463
                                101  3429
                                101  3375
                                101  3359>;


	battery_profile_t1_num = <83>;
	battery_profile_t1 = <0 4189
				 1    4167
				 3    4152
                                 4    4137
                                 5    4123
                                 7    4111
                                 8    4099
                                 9    4089
                                 11   4078
                                 12   4067
                                 13   4058
                                 15   4050
                                 16   4043
                                 18   4035
                                 19   4028
                                 20   4019
                                 22   4010
                                 23   4000
                                 24   3991
                                 26   3983
                                 27   3975
                                 28   3966
                                 30   3958
                                 31   3948
                                 32   3941
                                 34   3933
                                 35   3926
                                 36   3919
                                 38   3912
                                 39   3906
                                 40   3900
                                 42   3894
                                 43   3885
                                 44   3877
                                 46   3871
                                 47   3863
                                 49   3853
                                 50   3842
                                 51   3832
                                 53   3820
                                 54   3813
                                 55   3805
                                 57   3799
                                 58   3795
                                 59   3790
                                 61   3786
                                 62   3783
                                 63   3781
                                 65   3778
                                 67   3775
                                 69   3775
                                 71   3773
                                 73   3772
                                 75   3770
                                 77   3769
                                 78   3768
                                 79   3765
                                 81   3762
                                 82   3756
                                 84   3749
                                 85   3741
                                 86   3733
                                 88   3724
                                 89   3713
                                 90   3701
                                 92   3686
                                 93   3671
                                 94   3656
                                 96   3642
                                 97   3627
                                 98   3615
                                 100  3603
                                 101  3589
                                 101  3576
                                 101  3564
                                 101  3551
                                 101  3539
                                 101  3527
                                 101  3517
                                 101  3508
                                 101  3500
                                 101  3491
                                 101  3481
                                 101  3463
                                 101  3429
                                 101  3375
                                 101  3359>;

	battery_profile_t2_num = <87>;
	battery_profile_t2 = <0 4189
				1    4167 
				3    4152
                                4    4137
                                5    4123
                                7    4111
                                8    4099
                                9    4089
                                11   4078
                                12   4067
                                13   4058
                                15   4050
                                16   4043
                                18   4035
                                19   4028
                                20   4019
                                22   4010
                                23   4000
                                24   3991
                                26   3983
                                27   3975
                                28   3966
                                30   3958
                                31   3948
                                32   3941
                                34   3933
                                35   3926
                                36   3919
                                38   3912
                                39   3906
                                40   3900
                                42   3894
                                43   3885
                                44   3877
                                46   3871
                                47   3863
                                49   3853
                                50   3842
                                51   3832
                                53   3820
                                54   3813
                                55   3805
                                57   3799
                                58   3795
                                59   3790
                                61   3786
                                62   3783
                                63   3781
                                65   3778
                                67   3775
                                69   3775
                                71   3773
                                73   3772
                                75   3770
                                77   3769
                                78   3768
                                79   3765
                                81   3762
                                82   3756
                                84   3749
                                85   3741
                                86   3733
                                88   3724
                                89   3713
                                90   3701
                                92   3686
                                93   3671
                                94   3656
                                96   3642
                                97   3627
                                98   3615
                                100  3603
                                101  3589
                                101  3576
                                101  3564
                                101  3551
                                101  3539
                                101  3527
                                101  3517
                                101  3508
                                101  3500
                                101  3491
                                101  3481
                                101  3463
                                101  3429
                                101  3375
                                101  3359>;

	battery_profile_t3_num = <87>;
	battery_profile_t3 = <0 4189
				1    4167
				3    4152
                                4    4137
                                5    4123
                                7    4111
                                8    4099
                                9    4089
                                11   4078
                                12   4067
                                13   4058
                                15   4050
                                16   4043
                                18   4035
                                19   4028
                                20   4019
                                22   4010
                                23   4000
                                24   3991
                                26   3983
                                27   3975
                                28   3966
                                30   3958
                                31   3948
                                32   3941
                                34   3933
                                35   3926
                                36   3919
                                38   3912
                                39   3906
                                40   3900
                                42   3894
                                43   3885
                                44   3877
                                46   3871
                                47   3863
                                49   3853
                                50   3842
                                51   3832
                                53   3820
                                54   3813
                                55   3805
                                57   3799
                                58   3795
                                59   3790
                                61   3786
                                62   3783
                                63   3781
                                65   3778
                                67   3775
                                69   3775
                                71   3773
                                73   3772
                                75   3770
                                77   3769
                                78   3768
                                79   3765
                                81   3762
                                82   3756
                                84   3749
                                85   3741
                                86   3733
                                88   3724
                                89   3713
                                90   3701
                                92   3686
                                93   3671
                                94   3656
                                96   3642
                                97   3627
                                98   3615
                                100  3603
                                101  3589
                                101  3576
                                101  3564
                                101  3551
                                101  3539
                                101  3527
                                101  3517
                                101  3508
                                101  3500
                                101  3491
                                101  3481
                                101  3463
                                101  3429
                                101  3375
                                101  3359>;

	r_profile_t0_num = <87>;
	r_profile_t0 = <118 4189
				93   4167
                                97   4152
                                96   4137
                                95   4123
                                95   4111
                                96   4099
                                98   4089
                                97   4078
                                97   4067
                                97   4058
                                98   4050
                                101  4043
                                100  4035
                                101  4028
                                102  4019
                                101  4010
                                101  4000
                                103  3991
                                105  3983
                                105  3975
                                106  3966
                                106  3958
                                106  3948
                                108  3941
                                108  3933
                                111  3926
                                111  3919
                                113  3912
                                113  3906
                                115  3900
                                112  3894
                                114  3885
                                115  3877
                                116  3871
                                116  3863
                                112  3853
                                108  3842
                                104  3832
                                98   3820
                                97   3813
                                95   3805
				94   3799
				95   3795
				94   3790
				94   3786
				94   3783
				95   3781
				93   3778
				93   3775
				95   3775
				95   3773
				95   3772
				97   3770
				97   3769
				99   3768
				99   3765
				101  3762
				101  3756
				103  3749
				105  3741
				108  3733
				111  3724
				112  3713
				113  3701
				112  3686
				113  3671
				112  3656
				112  3642
				111  3627
				112  3615
				112  3603
				111  3589
				110  3576
				112  3564
				112  3551
				113  3539
				114  3527
				115  3517
				117  3508
				120  3500
				125  3491
				135  3481
                                146  3463
                                158  3429
                                176  3375
                                161  3359>;

	r_profile_t1_num = <87>;
	r_profile_t1 = <118 4189
				93   4167
                	        97   4152
                	        96   4137
                	        95   4123
				95   4111
                	        96   4099
                	        98   4089
                	        97   4078
                	        97   4067
                	        97   4058
                	        98   4050
                	        101  4043
                	        100  4035
                	        101  4028
                	        102  4019
                	        101  4010
                	        101  4000
                	        103  3991
                	        105  3983
                	        105  3975
                	        106  3966
                	        106  3958
                	        106  3948
                	        108  3941
                	        108  3933
                	        111  3926
                	        111  3919
                	        113  3912
                	        113  3906
                	        115  3900
                	        112  3894
                	        114  3885
                	        115  3877
                	        116  3871
                	        116  3863
                	        112  3853
                	        108  3842
                	        104  3832
                	        98   3820
                	        97   3813
                	        95   3805
                	        94   3799
                	        95   3795
                	        94   3790
                	        94   3786
				94   3783
				95   3781
				93   3778
				93   3775
				95   3775
				95   3773
				95   3772
				97   3770
				97   3769
				99   3768
				99   3765
				101  3762
				101  3756
				103  3749
				105  3741
				108  3733
				111  3724
				112  3713
				113  3701
				112  3686
				113  3671
				112  3656
				112  3642
				111  3627
				112  3615
				112  3603
				111  3589
				110  3576
				112  3564
				112  3551
				113  3539
				114  3527
				115  3517
				117  3508
				120  3500
				125  3491
				135  3481
				146  3463
				158  3429
				176  3375
				161  3359>;

	r_profile_t2_num = <87>;
	r_profile_t2 = <118 4189
				93   4167
                	        97   4152
                	        96   4137
                	        95   4123
				95   4111
                	        96   4099
                	        98   4089
                	        97   4078
                	        97   4067
                	        97   4058
                	        98   4050
                	        101  4043
                	        100  4035
                	        101  4028
                	        102  4019
                	        101  4010
                	        101  4000
                	        103  3991
                	        105  3983
                	        105  3975
                	        106  3966
                	        106  3958
                	        106  3948
                	        108  3941
                	        108  3933
                	        111  3926
                	        111  3919
                	        113  3912
                	        113  3906
                	        115  3900
                	        112  3894
                	        114  3885
                	        115  3877
                	        116  3871
                	        116  3863
                	        112  3853
                	        108  3842
                	        104  3832
                	        98   3820
                	        97   3813
                	        95   3805
                	        94   3799
                	        95   3795
                	        94   3790
                	        94   3786
				94   3783
				95   3781
				93   3778
				93   3775
				95   3775
				95   3773
				95   3772
				97   3770
				97   3769
				99   3768
				99   3765
				101  3762
				101  3756
				103  3749
				105  3741
				108  3733
				111  3724
				112  3713
				113  3701
				112  3686
				113  3671
				112  3656
				112  3642
				111  3627
				112  3615
				112  3603
				111  3589
				110  3576
				112  3564
				112  3551
				113  3539
				114  3527
				115  3517
				117  3508
				120  3500
				125  3491
				135  3481
				146  3463
				158  3429
				176  3375
				161  3359>;

	r_profile_t3_num = <87>;
	r_profile_t3 = <118 4189
				93   4167
                                97   4152
                                96   4137
                                95   4123
				95   4111 
                                96   4099 
                                98   4089 
                                97   4078 
                                97   4067 
                                97   4058 
                                98   4050 
                                101  4043 
                                100  4035 
                                101  4028 
                                102  4019 
                                101  4010 
                                101  4000 
                                103  3991 
                                105  3983 
                                105  3975 
                                106  3966 
                                106  3958 
                                106  3948 
                                108  3941 
                                108  3933 
                                111  3926 
                                111  3919 
                                113  3912 
                                113  3906 
                                115  3900 
                                112  3894 
                                114  3885 
                                115  3877 
                                116  3871 
                                116  3863 
                                112  3853 
                                108  3842 
                                104  3832 
                                98   3820 
                                97   3813 
                                95   3805 
                                94   3799 
                                95   3795 
                                94   3790 
                                94   3786 
				94   3783 
				95   3781 
				93   3778 
				93   3775 
				95   3775 
				95   3773 
				95   3772 
				97   3770 
				97   3769 
				99   3768 
				99   3765 
				101  3762 
				101  3756 
				103  3749 
				105  3741 
				108  3733 
				111  3724 
				112  3713 
				113  3701 
				112  3686 
				113  3671 
				112  3656 
				112  3642 
				111  3627 
				112  3615 
				112  3603 
				111  3589 
				110  3576 
				112  3564 
				112  3551 
				113  3539 
				114  3527 
				115  3517 
				117  3508 
				120  3500 
				125  3491 
				135  3481 
				146  3463 
				158  3429 
				176  3375 
				161  3359>;
};
