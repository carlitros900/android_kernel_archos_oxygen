/*************************
 * Customized Battery Setting dtsi file
*************************/
&bat_comm {
	gpio22_dc_det = <&pio 22 0>;
	gpio85_set_chr_set = <&pio 85 0>;
	gpio28_spec_cur_select = <&pio 28 0>;
	/* cust_charging.h */
	/* stop charging while in talking mode */
	stop_charging_in_takling = <1>;
	talking_recharge_voltage = <3800>;
	talking_sync_time = <60>;

	/* Battery Temperature Protection */
	mtk_temperature_recharge_support = <1>;
	max_charge_temperature = <50>;
	max_charge_temperature_minus_x_degree = <47>;
	min_charge_temperature = <0>;
	min_charge_temperature_plus_x_degree = <6>;
	err_charge_temperature = <0xff>;

	/* Linear Charging Threshold */
	v_pre2cc_thres = <3400>;	/* unit: mV */
	v_cc2topoff_thres = <4050>;
	recharging_voltage = <4110>;
	charging_full_current = <80>;	/* unit: mA */

	/* Charging Current Setting */
	config_usb_if = <0>;
	usb_charger_current_suspend = <0>;	/* Unit: 0.01 mA */
	usb_charger_current_unconfigured = <7000>;	/* Unit: 0.01 mA */
	usb_charger_current_configured = <65000>;	/* Unit: 0.01 mA */
	usb_charger_current = <120000>;	/* Unit: 0.01 mA */
	ac_charger_current = <120000>;	/* Unit: 0.01 mA */
	non_std_ac_charger_current = <65000>;	/* Unit: 0.01 mA */
	charging_host_charger_current = <65000>;	/* Unit: 0.01 mA */
	apple_0_5a_charger_current = <65000>;	/* Unit: 0.01 mA */
	apple_1_0a_charger_current = <65000>;	/* Unit: 0.01 mA */
	apple_2_1a_charger_current = <80000>;	/* Unit: 0.01 mA */

	/* charger error check */
	bat_low_temp_protect_enable = <0>;
	v_charger_enable = <0>;	/* 1:on , 0:off */
	v_charger_max = <6500>;	/* unit: mV */
	v_charger_min = <4400>;

	/*  Tracking TIME */
	onehundred_percent_tracking_time = <1800>;	/* Unit: second */
	npercent_tracking_time = <200>;	/* Unit: second */
	sync_to_real_tracking_time = <300>;	/* Unit: second */
	v_0percent_tracking = <3470>;	/* Unit: mV */

	/* High battery support */
	high_battery_voltage_support = <0>;
};

&bat_meter {
	/* cust_battery_meter.h */
	/* ADC resistor  */
	r_bat_sense = <4>;
	r_i_sense = <4>;
	r_charger_1 = <330>;
	r_charger_2 = <39>;
	temperature_t0 = <110>;
	temperature_t1 = <0>;
	temperature_t2 = <25>;
	temperature_t3 = <50>;
	temperature_t = <255>;	/* this should be fixed, never change the value */
	fg_meter_resistance = <0>;

	/* Qmax for 0mA */
	q_max_pos_50 = <3969>;
	q_max_pos_25 = <3969>;
	q_max_pos_0 = <3969>;
	q_max_neg_10 = <3969>;
	/* Qmax for 600mA, said high current */
	q_max_pos_50_h_current = <3471>;
	q_max_pos_25_h_current = <3471>;
	q_max_pos_0_h_current = <3471>;
	q_max_neg_10_h_current = <3471>;
	/* Discharge percentage, 1: D5, 0: D2 */
	oam_d5 = <1>;

	change_tracking_point = <1>;
	/* SW OCV tracking setting */
	cust_tracking_point = <14>;
	cust_r_sense = <200>;
	cust_hw_cc = <0>;
	aging_tuning_value = <100>;
	cust_r_fg_offset = <0>;
	ocv_board_compesate = <0>;
	r_fg_board_base = <1000>;
	r_fg_board_slope = <1000>;
	car_tune_value = <89>;

	/* HW Fuel gague  */
	current_detect_r_fg = <10>;	/* Unit: mA */
	minerroroffset = <1000>;
	fg_vbat_average_size = <18>;
	r_fg_value = <20>;	/* Unit: mOhm */

	cust_poweron_delta_capacity_tolrance = <80>;
	cust_poweron_low_capacity_tolrance = <0>;
	cust_poweron_max_vbat_tolrance = <70>;
	cust_poweron_delta_vbat_tolrance = <60>;
	cust_poweron_delta_hw_sw_ocv_capacity_tolrance = <10>;

	/* Fixed battery temperature */
	fixed_tbat_25 = <1>;
	/* Dynamic change wake up period of battery thread when suspend */
	vbat_normal_wakeup = <3600>;	/* Unit: mV */
	vbat_low_power_wakeup = <3500>;	/* Unit: mV */
	normal_wakeup_period = <5400>;	/* Unit: second */
	low_power_wakeup_period = <300>;	/* Unit: second */
	close_poweroff_wakeup_period = <30>;	/* Unit: second */

	rbat_pull_up_r = <16900>;
	rbat_pull_up_volt = <1800>;

	batt_temperature_table_num = <17>;
	batt_temperature_table = <
			    (-20) 75022
			    (-15) 57926
			    (-10) 45168
			    (-5) 35548
			    0 28224
			    5 22595
			    10 18231
			    15 14820
			    20 12133
			    25 10000 30 8295 35 6922 40 5810 45 4903 50 4160 55 3547 60 3039>;

	battery_profile_t0_num = <83>;
	battery_profile_t0 = <
				0  	   4195			
				1  	   4179
				3  	   4165
				4  	   4152
				5  	   4139
				6  	   4127
				8  	   4115
				9  	   4104
				10 	   4093
				11 	   4082
				13 	   4075
				14 	   4069
				15 	   4059
				16 	   4043
				18 	   4024
				19 	   4008
				20 	   3996
				21 	   3987
				23 	   3982
				24 	   3978
				25 	   3973
				26 	   3966
				28 	   3958
				29 	   3950
				30 	   3943
				31 	   3935
				33 	   3928
				34 	   3920
				35 	   3913
				37 	   3905
				38 	   3897
				39 	   3888
				40 	   3877
				42 	   3866
				43 	   3855
				44 	   3846
				45 	   3839
				47 	   3833
				48 	   3827
				49 	   3822
				50 	   3817
				52 	   3813
				53 	   3809
				54 	   3805
				55 	   3802
				57 	   3799
				58 	   3796
				59 	   3793
				60 	   3790
				62 	   3788
				63 	   3785
				64 	   3783
				66 	   3781
        67 	   3779
        68 	   3777
        69 	   3776
        71 	   3774
        72 	   3772
        73 	   3770
        74 	   3767
        76 	   3764
        77 	   3761
        78 	   3757
        79 	   3752
        81 	   3748
        82 	   3745
        83 	   3741
        84 	   3736
        86 	   3729
        87 	   3721
        88 	   3715
        89 	   3707
        91 	   3697
        92 	   3693
        93 	   3691
        94 	   3690
        96 	   3688
        97 	   3685
        98 	   3672
        100	   3626
        101    3559
        102    3463
        103    3357>;

	battery_profile_t1_num = <83>;
	battery_profile_t1 = <
	      0  	   4195	
				1  	   4179
				3  	   4165
				4  	   4152
				5  	   4139
				6  	   4127
				8  	   4115
				9  	   4104
				10 	   4093
				11 	   4082
				13 	   4075
				14 	   4069
				15 	   4059
				16 	   4043
				18 	   4024
				19 	   4008
				20 	   3996
				21 	   3987
				23 	   3982
				24 	   3978
				25 	   3973
				26 	   3966
				28 	   3958
				29 	   3950
				30 	   3943
				31 	   3935
				33 	   3928
				34 	   3920
				35 	   3913
				37 	   3905
				38 	   3897
				39 	   3888
				40 	   3877
				42 	   3866
				43 	   3855
				44 	   3846
				45 	   3839
				47 	   3833
				48 	   3827
				49 	   3822
				50 	   3817
				52 	   3813
				53 	   3809
				54 	   3805
				55 	   3802
				57 	   3799
				58 	   3796
				59 	   3793
				60 	   3790
				62 	   3788
				63 	   3785
				64 	   3783
				66 	   3781
				67 	   3779
        68 	   3777
        69 	   3776
        71 	   3774
        72 	   3772
        73 	   3770
        74 	   3767
        76 	   3764
        77 	   3761
        78 	   3757
        79 	   3752
        81 	   3748
        82 	   3745
        83 	   3741
        84 	   3736
        86 	   3729
        87 	   3721
        88 	   3715
        89 	   3707
        91 	   3697
        92 	   3693
        93 	   3691
        94 	   3690
        96 	   3688
        97 	   3685
        98 	   3672
        100	   3626
        101    3559
        102    3463
        103    3357>;

	battery_profile_t2_num = <83>;
	battery_profile_t2 = <
				0  	   4195
				1  	   4179
				3  	   4165
				4  	   4152
				5  	   4139
				6  	   4127
				8  	   4115
				9  	   4104
				10 	   4093
				11 	   4082
				13 	   4075
				14 	   4069
				15 	   4059
				16 	   4043
				18 	   4024
				19 	   4008
				20 	   3996
				21 	   3987
				23 	   3982
				24 	   3978
				25 	   3973
				26 	   3966
				28 	   3958
				29 	   3950
				30 	   3943
				31 	   3935
				33 	   3928
				34 	   3920
				35 	   3913
				37 	   3905
				38 	   3897
				39 	   3888
				40 	   3877
				42 	   3866
				43 	   3855
				44 	   3846
				45 	   3839
				47 	   3833
				48 	   3827
				49 	   3822
				50 	   3817
				52 	   3813
				53 	   3809
				54 	   3805
				55 	   3802
				57 	   3799
				58 	   3796
				59 	   3793
				60 	   3790
				62 	   3788
				63 	   3785
				64 	   3783
				66 	   3781
				67 	   3779
        68 	   3777
        69 	   3776
        71 	   3774
        72 	   3772
        73 	   3770
        74 	   3767
        76 	   3764
        77 	   3761
        78 	   3757
        79 	   3752
        81 	   3748
        82 	   3745
        83 	   3741
        84 	   3736
        86 	   3729
        87 	   3721
        88 	   3715
        89 	   3707
        91 	   3697
        92 	   3693
        93 	   3691
        94 	   3690
        96 	   3688
        97 	   3685
        98 	   3672
        100	   3626
        101    3559
        102    3463
        103    3357>;
  
   
	battery_profile_t3_num = <83>;
	battery_profile_t3 = <
				0  	   4195
				1  	   4179
				3  	   4165
				4  	   4152
				5  	   4139
				6  	   4127
				8  	   4115
				9  	   4104
				10 	   4093
				11 	   4082
				13 	   4075
				14 	   4069
				15 	   4059
				16 	   4043
				18 	   4024
				19 	   4008
				20 	   3996
				21 	   3987
				23 	   3982
				24 	   3978
				25 	   3973
				26 	   3966
				28 	   3958
				29 	   3950
				30 	   3943
				31 	   3935
				33 	   3928
				34 	   3920
				35 	   3913
				37 	   3905
				38 	   3897
				39 	   3888
				40 	   3877
				42 	   3866
				43 	   3855
				44 	   3846
				45 	   3839
				47 	   3833
				48 	   3827
				49 	   3822
				50 	   3817
				52 	   3813
				53 	   3809
				54 	   3805
				55 	   3802
				57 	   3799
				58 	   3796
				59 	   3793
				60 	   3790
				62 	   3788
				63 	   3785
				64 	   3783
				66 	   3781
				67 	   3779
        68 	   3777
        69 	   3776
        71 	   3774
        72 	   3772
        73 	   3770
        74 	   3767
        76 	   3764
        77 	   3761
        78 	   3757
        79 	   3752
        81 	   3748
        82 	   3745
        83 	   3741
        84 	   3736
        86 	   3729
        87 	   3721
        88 	   3715
        89 	   3707
        91 	   3697
        92 	   3693
        93 	   3691
        94 	   3690
        96 	   3688
        97 	   3685
        98 	   3672
        100	   3626
        101    3559
        102    3463
        103    3357>;



	r_profile_t0_num = <83>;
	r_profile_t0 = <				
				118	  4195
				113	  4179
				113	  4165
				113	  4152
				114	  4139
				114	  4127
				115	  4115
				117	  4104
				117	  4093
				118	  4082
				120	  4075
				122	  4069
				123	  4059
				122	  4043
				121	  4024
				121	  4008
				121	  3996
				123	  3987
				125	  3982
				126	  3978
				128	  3973
				128	  3966
				128	  3958
				128	  3950
				129	  3943
				130	  3935
				132	  3928
				132	  3920
				133	  3913
				132	  3905
				132	  3897
				130	  3888
				126	  3877
				123	  3866
				118	  3855
				116	  3846
				114	  3839
				113	  3833
				113	  3827
				112	  3822
				111	  3817
				112	  3813
				112	  3809
				113	  3805
				113	  3802
				114	  3799
				115	  3796
				115	  3793
				115	  3790
				116	  3788
				116	  3785
        116	  3783
        116	  3781
        117	  3779
        116	  3777
        117	  3776
        117	  3774
        117	  3772
        117	  3770
        116	  3767
        116	  3764
        117	  3761
        117	  3757
        115	  3752
        116	  3748
        117	  3745
        118	  3741
        119	  3736
        119	  3729
        118	  3721
        119	  3715
        120	  3707
        119	  3697
        119	  3693
        121	  3691
        124	  3690
        127	  3688
        134	  3685
        139	  3672
        136	  3626
        145	  3559
        162	  3463
        159	  3357>;
        
	r_profile_t1_num = <83>;
	r_profile_t1 = <
				118	  4195
				113	  4179
				113	  4165
				113	  4152
				114	  4139
				114	  4127
				115	  4115
				117	  4104
				117	  4093
				118	  4082
				120	  4075
				122	  4069
				123	  4059
				122	  4043
				121	  4024
				121	  4008
				121	  3996
				123	  3987
				125	  3982
				126	  3978
				128	  3973
				128	  3966
				128	  3958
				128	  3950
				129	  3943
				130	  3935
				132	  3928
				132	  3920
				133	  3913
				132	  3905
				132	  3897
				130	  3888
				126	  3877
				123	  3866
				118	  3855
				116	  3846
				114	  3839
				113	  3833
				113	  3827
				112	  3822
				111	  3817
				112	  3813
				112	  3809
				113	  3805
				113	  3802
				114	  3799
				115	  3796
				115	  3793
				115	  3790
				116	  3788
				116	  3785
				116	  3783
				116	  3781
				117	  3779
        116	  3777
        117	  3776
        117	  3774
        117	  3772
        117	  3770
        116	  3767
        116	  3764
        117	  3761
        117	  3757
        115	  3752
        116	  3748
        117	  3745
        118	  3741
        119	  3736
        119	  3729
        118	  3721
        119	  3715
        120	  3707
        119	  3697
        119	  3693
        121	  3691
        124	  3690
        127	  3688
        134	  3685
        139	  3672
        136	  3626
        145	  3559
        162	  3463
        159	  3357>;
 
 
 
	r_profile_t2_num = <83>;
	r_profile_t2 = <
				118	  4195
				113	  4179
				113	  4165
				113	  4152
				114	  4139
				114	  4127
				115	  4115
				117	  4104
				117	  4093
				118	  4082
				120	  4075
				122	  4069
				123	  4059
				122	  4043
				121	  4024
				121	  4008
				121	  3996
				123	  3987
				125	  3982
				126	  3978
				128	  3973
				128	  3966
				128	  3958
				128	  3950
				129	  3943
				130	  3935
				132	  3928
				132	  3920
				133	  3913
				132	  3905
				132	  3897
				130	  3888
				126	  3877
				123	  3866
				118	  3855
				116	  3846
				114	  3839
				113	  3833
				113	  3827
				112	  3822
				111	  3817
				112	  3813
				112	  3809
				113	  3805
				113	  3802
				114	  3799
				115	  3796
				115	  3793
				115	  3790
				116	  3788
				116	  3785
				116	  3783
				116	  3781
				117	  3779
        116	  3777
        117	  3776
        117	  3774
        117	  3772
        117	  3770
        116	  3767
        116	  3764
        117	  3761
        117	  3757
        115	  3752
        116	  3748
        117	  3745
        118	  3741
        119	  3736
        119	  3729
        118	  3721
        119	  3715
        120	  3707
        119	  3697
        119	  3693
        121	  3691
        124	  3690
        127	  3688
        134	  3685
        139	  3672
        136	  3626
        145	  3559
        162	  3463
        159	  3357>;
  
  
  
  
	r_profile_t3_num = <83>;
	r_profile_t3 = <
				118	  4195
				113	  4179
				113	  4165
				113	  4152
				114	  4139
				114	  4127
				115	  4115
				117	  4104
				117	  4093
				118	  4082
				120	  4075
				122	  4069
				123	  4059
				122	  4043
				121	  4024
				121	  4008
				121	  3996
				123	  3987
				125	  3982
				126	  3978
				128	  3973
				128	  3966
				128	  3958
				128	  3950
				129	  3943
				130	  3935
				132	  3928
				132	  3920
				133	  3913
				132	  3905
				132	  3897
				130	  3888
				126	  3877
				123	  3866
				118	  3855
				116	  3846
				114	  3839
				113	  3833
				113	  3827
				112	  3822
				111	  3817
				112	  3813
				112	  3809
				113	  3805
				113	  3802
				114	  3799
				115	  3796
				115	  3793
				115	  3790
				116	  3788
				116	  3785
				116	  3783
				116	  3781
				117	  3779   
				116	  3777
				117	  3776
				117	  3774
				117	  3772
				117	  3770
				116	  3767
				116	  3764
				117	  3761
				117	  3757
				115	  3752
				116	  3748
				117	  3745
				118	  3741
				119	  3736
				119	  3729
				118	  3721
				119	  3715
				120	  3707
				119	  3697
				119	  3693
				121	  3691
				124	  3690
				127	  3688
				134	  3685
				139	  3672
				136	  3626
				145	  3559
				162	  3463
				159	  3357>;				
};
