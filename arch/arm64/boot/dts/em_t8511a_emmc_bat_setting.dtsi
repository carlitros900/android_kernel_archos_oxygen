/*************************
 * Customized Battery Setting dtsi file
*************************/
&bat_comm {
	gpio22_dc_det = <&pio 22 0>;
	gpio85_set_chr_set = <&pio 85 0>;
	gpio28_spec_cur_select = <&pio 28 0>;
	/* cust_charging.h */
	/* stop charging while in talking mode */
	stop_charging_in_takling = <1>;
	talking_recharge_voltage = <3800>;
	talking_sync_time = <60>;

	/* Battery Temperature Protection */
	mtk_temperature_recharge_support = <1>;
	max_charge_temperature = <50>;
	max_charge_temperature_minus_x_degree = <47>;
	min_charge_temperature = <0>;
	min_charge_temperature_plus_x_degree = <6>;
	err_charge_temperature = <0xff>;

	/* Linear Charging Threshold */
	v_pre2cc_thres = <3400>;	/* unit: mV */
	v_cc2topoff_thres = <4050>;
	recharging_voltage = <4110>;
	charging_full_current = <80>;	/* unit: mA */

	/* Charging Current Setting */
	config_usb_if = <0>;
	usb_charger_current_suspend = <0>;	/* Unit: 0.01 mA */
	usb_charger_current_unconfigured = <7000>;	/* Unit: 0.01 mA */
	usb_charger_current_configured = <50000>;	/* Unit: 0.01 mA */
	usb_charger_current = <120000>;	/* Unit: 0.01 mA */
	ac_charger_current = <120000>;	/* Unit: 0.01 mA */
	non_std_ac_charger_current = <50000>;	/* Unit: 0.01 mA */
	charging_host_charger_current = <65000>;	/* Unit: 0.01 mA */
	apple_0_5a_charger_current = <50000>;	/* Unit: 0.01 mA */
	apple_1_0a_charger_current = <65000>;	/* Unit: 0.01 mA */
	apple_2_1a_charger_current = <80000>;	/* Unit: 0.01 mA */

	/* charger error check */
	bat_low_temp_protect_enable = <0>;
	v_charger_enable = <0>;	/* 1:on , 0:off */
	v_charger_max = <6500>;	/* unit: mV */
	v_charger_min = <4400>;

	/*  Tracking TIME */
	onehundred_percent_tracking_time = <1800>;	/* Unit: second */
	npercent_tracking_time = <200>;	/* Unit: second */
	sync_to_real_tracking_time = <300>;	/* Unit: second */
	v_0percent_tracking = <3470>;	/* Unit: mV */

	/* High battery support */
	high_battery_voltage_support = <0>;
};

&bat_meter {
	/* cust_battery_meter.h */
	/* ADC resistor  */
	r_bat_sense = <4>;
	r_i_sense = <4>;
	r_charger_1 = <330>;
	r_charger_2 = <39>;
	temperature_t0 = <110>;
	temperature_t1 = <0>;
	temperature_t2 = <25>;
	temperature_t3 = <50>;
	temperature_t = <255>;	/* this should be fixed, never change the value */
	fg_meter_resistance = <0>;

	/* Qmax for 0mA */
	q_max_pos_50 = <4063>;
	q_max_pos_25 = <4063>;
	q_max_pos_0 = <4063>;
	q_max_neg_10 = <4063>;
	/* Qmax for 600mA, said high current */
	q_max_pos_50_h_current = <3630>;
	q_max_pos_25_h_current = <3630>;
	q_max_pos_0_h_current = <3630>;
	q_max_neg_10_h_current = <3630>;
	/* Discharge percentage, 1: D5, 0: D2 */
	oam_d5 = <1>;

	change_tracking_point = <1>;
	/* SW OCV tracking setting */
	cust_tracking_point = <14>;
	cust_r_sense = <200>;
	cust_hw_cc = <0>;
	aging_tuning_value = <100>;
	cust_r_fg_offset = <0>;
	ocv_board_compesate = <0>;
	r_fg_board_base = <1000>;
	r_fg_board_slope = <1000>;
	car_tune_value = <89>;

	/* HW Fuel gague  */
	current_detect_r_fg = <10>;	/* Unit: mA */
	minerroroffset = <1000>;
	fg_vbat_average_size = <18>;
	r_fg_value = <20>;	/* Unit: mOhm */

	cust_poweron_delta_capacity_tolrance = <80>;
	cust_poweron_low_capacity_tolrance = <0>;
	cust_poweron_max_vbat_tolrance = <70>;
	cust_poweron_delta_vbat_tolrance = <60>;
	cust_poweron_delta_hw_sw_ocv_capacity_tolrance = <10>;

	/* Fixed battery temperature */
	fixed_tbat_25 = <1>;
	/* Dynamic change wake up period of battery thread when suspend */
	vbat_normal_wakeup = <3600>;	/* Unit: mV */
	vbat_low_power_wakeup = <3500>;	/* Unit: mV */
	normal_wakeup_period = <5400>;	/* Unit: second */
	low_power_wakeup_period = <300>;	/* Unit: second */
	close_poweroff_wakeup_period = <30>;	/* Unit: second */

	rbat_pull_up_r = <16900>;
	rbat_pull_up_volt = <1800>;

	batt_temperature_table_num = <17>;
	batt_temperature_table = <
			    (-20) 75022
			    (-15) 57926
			    (-10) 45168
			    (-5) 35548
			    0 28224
			    5 22595
			    10 18231
			    15 14820
			    20 12133
			    25 10000 30 8295 35 6922 40 5810 45 4903 50 4160 55 3547 60 3039>;

	battery_profile_t0_num = <77>;
	battery_profile_t0 = <0 4182
				1    4156	
				3    4138
                                4    4122
                                5    4107
                                7    4095
                                8    4085
                                9    4075
                                11   4065
                                12   4058
                                14   4049
                                15   4043
                                16   4038
                                18   4033
                                19   4027
                                20   4022
                                22   4013
                                23   4005
                                24   3997
                                26   3988
                                27   3980
                                28   3972
                                30   3964
                                31   3955
                                32   3947
                                34   3939
                                35   3933
                                36   3926
                                38   3919
                                39   3913
                                41   3906
                                42   3900
                                43   3894
                                45   3886
                                46   3878
                                47   3872
                                49   3863
                                50   3854
                                51   3845
                                53   3836
                                54   3826
                                55   3819
                                57   3811
                                58   3805
                                59   3799
                                61   3794
                                62   3790
                                64   3786
                                65   3782
                                66   3779
                                68   3778
                                69   3777
                                70   3776
                                72   3775
                                73   3774
                                74   3771
                                76   3770
                                77   3769
                                78   3768
                                80   3765
                                81   3762
                                82   3755
                                84   3748
                                85   3740
                                86   3731
                                88   3720
                                89   3707
                                91   3694
                                92   3680
                                93   3665
                                95   3650
                                96   3637
                                97   3624
                                99   3612
                                100  3600
                                101  3589
                                103  3578>;

	battery_profile_t1_num = <77>;
	battery_profile_t1 = <0 4182
				1    4156	
				3    4138
                                4    4122
                                5    4107
                                7    4095
                                8    4085
                                9    4075
                                11   4065
                                12   4058
                                14   4049
                                15   4043
                                16   4038
                                18   4033
                                19   4027
                                20   4022
                                22   4013
                                23   4005
                                24   3997
                                26   3988
                                27   3980
                                28   3972
                                30   3964
                                31   3955
                                32   3947
                                34   3939
                                35   3933
                                36   3926
                                38   3919
                                39   3913
                                41   3906
                                42   3900
                                43   3894
                                45   3886
                                46   3878
                                47   3872
                                49   3863
                                50   3854
                                51   3845
                                53   3836
                                54   3826
                                55   3819
                                57   3811
                                58   3805
                                59   3799
                                61   3794
                                62   3790
                                64   3786
                                65   3782
                                66   3779
                                68   3778
                                69   3777
                                70   3776
                                72   3775
                                73   3774
                                74   3771
                                76   3770
                                77   3769
                                78   3768
                                80   3765
                                81   3762
                                82   3755
                                84   3748
                                85   3740
                                86   3731
                                88   3720
                                89   3707
                                91   3694
                                92   3680
                                93   3665
                                95   3650
                                96   3637
                                97   3624
                                99   3612
                                100  3600
                                101  3589
                                103  3578>;

	battery_profile_t2_num = <77>;
	battery_profile_t2 = <0 4182
				1    4156	
				3    4138
                                4    4122
                                5    4107
                                7    4095
                                8    4085
                                9    4075
                                11   4065
                                12   4058
                                14   4049
                                15   4043
                                16   4038
                                18   4033
                                19   4027
                                20   4022
                                22   4013
                                23   4005
                                24   3997
                                26   3988
                                27   3980
                                28   3972
                                30   3964
                                31   3955
                                32   3947
                                34   3939
                                35   3933
                                36   3926
                                38   3919
                                39   3913
                                41   3906
                                42   3900
                                43   3894
                                45   3886
                                46   3878
                                47   3872
                                49   3863
                                50   3854
                                51   3845
                                53   3836
                                54   3826
                                55   3819
                                57   3811
                                58   3805
                                59   3799
                                61   3794
                                62   3790
                                64   3786
                                65   3782
                                66   3779
                                68   3778
                                69   3777
                                70   3776
                                72   3775
                                73   3774
                                74   3771
                                76   3770
                                77   3769
                                78   3768
                                80   3765
                                81   3762
                                82   3755
                                84   3748
                                85   3740
                                86   3731
                                88   3720
                                89   3707
                                91   3694
                                92   3680
                                93   3665
                                95   3650
                                96   3637
                                97   3624
                                99   3612
                                100  3600
                                101  3589
                                103  3578>;

	battery_profile_t3_num = <77>;
	battery_profile_t3 = <0 4182
				1    4156	
				3    4138
                                4    4122
                                5    4107
                                7    4095
                                8    4085
                                9    4075
                                11   4065
                                12   4058
                                14   4049
                                15   4043
                                16   4038
                                18   4033
                                19   4027
                                20   4022
                                22   4013
                                23   4005
                                24   3997
                                26   3988
                                27   3980
                                28   3972
                                30   3964
                                31   3955
                                32   3947
                                34   3939
                                35   3933
                                36   3926
                                38   3919
                                39   3913
                                41   3906
                                42   3900
                                43   3894
                                45   3886
                                46   3878
                                47   3872
                                49   3863
                                50   3854
                                51   3845
                                53   3836
                                54   3826
                                55   3819
                                57   3811
                                58   3805
                                59   3799
                                61   3794
                                62   3790
                                64   3786
                                65   3782
                                66   3779
                                68   3778
                                69   3777
                                70   3776
                                72   3775
                                73   3774
                                74   3771
                                76   3770
                                77   3769
                                78   3768
                                80   3765
                                81   3762
                                82   3755
                                84   3748
                                85   3740
                                86   3731
                                88   3720
                                89   3707
                                91   3694
                                92   3680
                                93   3665
                                95   3650
                                96   3637
                                97   3624
                                99   3612
                                100  3600
                                101  3589
                                103  3578>;

	r_profile_t0_num = <77>;
	r_profile_t0 = <118 4182
                                98  4156
                                100 4138
                                99  4122
                                97  4107
                                99  4095
                                100 4085
                                101 4075
                                101 4065
                                103 4058
                                102 4049
                                104 4043
                                105 4038
                                106 4033
                                106 4027
                                109 4022
                                107 4013
                                108 4005
                                110 3997
                                108 3988
                                111 3980
                                112 3972
                                113 3964
                                113 3955
                                112 3947
                                110 3939
                                113 3933
                                115 3926
                                117 3919
                                117 3913
                                117 3906
                                117 3900
                                118 3894
                                117 3886
                                116 3878
                                116 3872
                                113 3863
                                111 3854
                                108 3845
                                106 3836
                                102 3826
				101 3819
				99  3811
				98  3805
				98  3799
				97  3794
				98  3790
				98  3786
				98  3782
				100 3779
				101 3778
				101 3777
				101 3776
				101 3775
				102 3774
				100 3771
				102 3770
				102 3769
				103 3768
				103 3765
				106 3762
				106 3755
				102 3748
				103 3740
				109 3731
				109 3720
				107 3707
				108 3694
				107 3680
				106 3665
				104 3650
				105 3637
				106 3624
				105 3612
				104 3600
				104 3589
				106 3578>;

	r_profile_t1_num = <77>;
	r_profile_t1 = <118 4182
				98  4156
                                100 4138
                                99  4122
                                97  4107
                                99  4095
                                100 4085
                                101 4075
                                101 4065
                                103 4058
                                102 4049
                                104 4043
                                105 4038
                                106 4033
                                106 4027
                                109 4022
                                107 4013
                                108 4005
                                110 3997
                                108 3988
                                111 3980
                                112 3972
                                113 3964
                                113 3955
                                112 3947
                                110 3939
                                113 3933
                                115 3926
                                117 3919
                                117 3913
                                117 3906
                                117 3900
                                118 3894
                                117 3886
                                116 3878
                                116 3872
                                113 3863
                                111 3854
                                108 3845
                                106 3836
                                102 3826
                                101 3819
				99  3811
				98  3805
				98  3799
				97  3794
				98  3790
				98  3786
				98  3782
				100 3779
				101 3778
				101 3777
				101 3776
				101 3775
				102 3774
				100 3771
				102 3770
				102 3769
				103 3768
				103 3765
				106 3762
				106 3755
				102 3748
				103 3740
				109 3731
				109 3720
				107 3707
				108 3694
				107 3680
				106 3665
				104 3650
				105 3637
				106 3624
				105 3612
				104 3600
				104 3589
				106 3578>;

	r_profile_t2_num = <77>;
	r_profile_t2 = <118 4182
				98  4156
                                100 4138
                                99  4122
                                97  4107
                                99  4095
                                100 4085
                                101 4075
                                101 4065
                                103 4058
                                102 4049
                                104 4043
                                105 4038
                                106 4033
                                106 4027
                                109 4022
                                107 4013
                                108 4005
                                110 3997
                                108 3988
                                111 3980
                                112 3972
                                113 3964
                                113 3955
                                112 3947
                                110 3939
                                113 3933
                                115 3926
                                117 3919
                                117 3913
                                117 3906
                                117 3900
                                118 3894
                                117 3886
                                116 3878
                                116 3872
                                113 3863
                                111 3854
                                108 3845
                                106 3836
                                102 3826
                                101 3819
				99  3811
				98  3805
				98  3799
				97  3794
				98  3790
				98  3786
				98  3782
				100 3779
				101 3778
				101 3777
				101 3776
				101 3775
				102 3774
				100 3771
				102 3770
				102 3769
				103 3768
				103 3765
				106 3762
				106 3755
				102 3748
				103 3740
				109 3731
				109 3720
				107 3707
				108 3694
				107 3680
				106 3665
				104 3650
				105 3637
				106 3624
				105 3612
				104 3600
				104 3589
				106 3578>;

	r_profile_t3_num = <77>;
	r_profile_t3 = <118 4182
				98  4156
                                100 4138
                                99  4122
                                97  4107
                                99  4095
                                100 4085
                                101 4075
                                101 4065
                                103 4058
                                102 4049
                                104 4043
                                105 4038
                                106 4033
                                106 4027
                                109 4022
                                107 4013
                                108 4005
                                110 3997
                                108 3988
                                111 3980
                                112 3972
                                113 3964
                                113 3955
                                112 3947
                                110 3939
                                113 3933
                                115 3926
                                117 3919
                                117 3913
                                117 3906
                                117 3900
                                118 3894
                                117 3886
                                116 3878
                                116 3872
                                113 3863
                                111 3854
                                108 3845
                                106 3836
                                102 3826
                                101 3819
				99  3811
				98  3805
				98  3799
				97  3794
				98  3790
				98  3786
				98  3782
				100 3779
				101 3778
				101 3777
				101 3776
				101 3775
				102 3774
				100 3771
				102 3770
				102 3769
				103 3768
				103 3765
				106 3762
				106 3755
				102 3748
				103 3740
				109 3731
				109 3720
				107 3707
				108 3694
				107 3680
				106 3665
				104 3650
				105 3637
				106 3624
				105 3612
				104 3600
				104 3589
				106 3578
				>;
};
