/*************************
 * Customized Battery Setting dtsi file
*************************/
&bat_comm {
	gpio22_dc_det = <&pio 22 0>;
	gpio85_set_chr_set = <&pio 85 0>;
	gpio28_spec_cur_select = <&pio 28 0>;
	/* cust_charging.h */
	/* stop charging while in talking mode */
	stop_charging_in_takling = <1>;
	talking_recharge_voltage = <3800>;
	talking_sync_time = <60>;

	/* Battery Temperature Protection */
	mtk_temperature_recharge_support = <1>;
	max_charge_temperature = <50>;
	max_charge_temperature_minus_x_degree = <47>;
	min_charge_temperature = <0>;
	min_charge_temperature_plus_x_degree = <6>;
	err_charge_temperature = <0xff>;

	/* Linear Charging Threshold */
	v_pre2cc_thres = <3400>;	/* unit: mV */
	v_cc2topoff_thres = <4050>;
	recharging_voltage = <4110>;
	charging_full_current = <80>;	/* unit: mA */

	/* Charging Current Setting */
	config_usb_if = <0>;
	usb_charger_current_suspend = <0>;	/* Unit: 0.01 mA */
	usb_charger_current_unconfigured = <7000>;	/* Unit: 0.01 mA */
	usb_charger_current_configured = <50000>;	/* Unit: 0.01 mA */
	usb_charger_current = <50000>;	/* Unit: 0.01 mA */
	ac_charger_current = <130000>;	/* Unit: 0.01 mA */
	non_std_ac_charger_current = <50000>;	/* Unit: 0.01 mA */
	charging_host_charger_current = <65000>;	/* Unit: 0.01 mA */
	apple_0_5a_charger_current = <50000>;	/* Unit: 0.01 mA */
	apple_1_0a_charger_current = <65000>;	/* Unit: 0.01 mA */
	apple_2_1a_charger_current = <50000>;	/* Unit: 0.01 mA */

	/* charger error check */
	bat_low_temp_protect_enable = <0>;
	v_charger_enable = <0>;	/* 1:on , 0:off */
	v_charger_max = <6500>;	/* unit: mV */
	v_charger_min = <4400>;

	/*  Tracking TIME */
	onehundred_percent_tracking_time = <10>;	/* Unit: second */
	npercent_tracking_time = <20>;	/* Unit: second */
	sync_to_real_tracking_time = <60>;	/* Unit: second */
	v_0percent_tracking = <3450>;	/* Unit: mV */

	/* High battery support */
	high_battery_voltage_support = <0>;
};

&bat_meter {
	/* cust_battery_meter.h */
	/* ADC resistor  */
	r_bat_sense = <4>;
	r_i_sense = <4>;
	r_charger_1 = <330>;
	r_charger_2 = <39>;
	temperature_t0 = <110>;
	temperature_t1 = <0>;
	temperature_t2 = <25>;
	temperature_t3 = <50>;
	temperature_t = <255>;	/* this should be fixed, never change the value */
	fg_meter_resistance = <0>;

	/* Qmax for 0mA */
	q_max_pos_50 = <2495 >;
	q_max_pos_25 = <2495 >;
	q_max_pos_0 = <2495 >;
	q_max_neg_10 = <2495 >;
	/* Qmax for 600mA, said high current */
	q_max_pos_50_h_current = <2442>;
	q_max_pos_25_h_current = <2442>;
	q_max_pos_0_h_current = <2442>;
	q_max_neg_10_h_current = <2442>;
	/* Discharge percentage, 1: D5, 0: D2 */
	oam_d5 = <1>;

	change_tracking_point = <1>;
	/* SW OCV tracking setting */
	cust_tracking_point = <14>;
	cust_r_sense = <200>;
	cust_hw_cc = <0>;
	aging_tuning_value = <100>;
	cust_r_fg_offset = <0>;
	ocv_board_compesate = <0>;
	r_fg_board_base = <1000>;
	r_fg_board_slope = <1000>;
	car_tune_value = <89>;

	/* HW Fuel gague  */
	current_detect_r_fg = <10>;	/* Unit: mA */
	minerroroffset = <1000>;
	fg_vbat_average_size = <18>;
	r_fg_value = <10>;	/* Unit: mOhm */

	cust_poweron_delta_capacity_tolrance = <80>;
	cust_poweron_low_capacity_tolrance = <5>;
	cust_poweron_max_vbat_tolrance = <70>;
	cust_poweron_delta_vbat_tolrance = <60>;
	cust_poweron_delta_hw_sw_ocv_capacity_tolrance = <10>;

	/* Fixed battery temperature */
	fixed_tbat_25 = <1>;
	/* Dynamic change wake up period of battery thread when suspend */
	vbat_normal_wakeup = <3600>;	/* Unit: mV */
	vbat_low_power_wakeup = <3500>;	/* Unit: mV */
	normal_wakeup_period = <5400>;	/* Unit: second */
	low_power_wakeup_period = <300>;	/* Unit: second */
	close_poweroff_wakeup_period = <30>;	/* Unit: second */

	rbat_pull_up_r = <16900>;
	rbat_pull_up_volt = <1800>;

	batt_temperature_table_num = <17>;
	batt_temperature_table = <
			    (-20) 75022
			    (-15) 57926
			    (-10) 45168
			    (-5) 35548
			    0 28224
			    5 22595
			    10 18231
			    15 14820
			    20 12133
			    25 10000 30 8295 35 6922 40 5810 45 4903 50 4160 55 3547 60 3039>;

	battery_profile_t0_num = <91>;
	battery_profile_t0 = <
				0	   4192
				1	   4177
				2	   4163
				3	   4151
				4	   4139
				6	   4128
				7	   4117
				8	   4107
				9	   4097
				10	 4087
				11	 4079
				12	 4074
				13	 4070
				15	 4064
				16	 4054
				17	 4044
				18	 4032
				19	 4020
				20	 4008
				21	 3997
				22	 3989
				24	 3982
				25	 3976
				26	 3973
				27	 3970
				28	 3966
				29	 3960
				30	 3953
				31	 3947
				33	 3941
				34	 3934
				35	 3928
				36	 3922
				37	 3916
				38	 3909
				39	 3902
				40	 3893
				42	 3883
				43	 3873
				44	 3863
				45	 3855
				46	 3848
				47	 3842
				48	 3836
				49	 3832
				51	 3827
				52	 3823
				53	 3819
				54	 3816
				55	 3812
				56	 3809
				57	 3805
				58	 3802
				59	 3799
				61	 3796
				62	 3794
				63	 3791
				64	 3789
				65	 3786
				66	 3784
				67	 3782
				68	 3780
				70	 3778
				71	 3776
				72	 3774
				73	 3772
				74	 3770
				75	 3768
				76	 3765
				77	 3762
				79	 3759
				80	 3754
				81	 3750
				82	 3747
				83	 3743
				84	 3738
				85	 3732
				86	 3725
				88	 3719
				89	 3713
				90	 3703
				91	 3696
				92	 3694
				93	 3693
				94	 3692
				95	 3691
				97	 3689
				98	 3683
				99	 3656
				100  3607
				101  3541>;
			

	battery_profile_t1_num = <91>;
	battery_profile_t1 = <
				0	   4192
				1	   4177
				2	   4163
				3	   4151
				4	   4139
				6	   4128
				7	   4117
				8	   4107
				9	   4097
				10	 4087
				11	 4079
				12	 4074
				13	 4070
				15	 4064
				16	 4054
				17	 4044
				18	 4032
				19	 4020
				20	 4008
				21	 3997
				22	 3989
				24	 3982
				25	 3976
				26	 3973
				27	 3970
				28	 3966
				29	 3960
				30	 3953
				31	 3947
				33	 3941
				34	 3934
				35	 3928
				36	 3922
				37	 3916
				38	 3909
				39	 3902
				40	 3893
				42	 3883
				43	 3873
				44	 3863
				45	 3855
				46	 3848
				47	 3842
				48	 3836
				49	 3832
				51	 3827
				52	 3823
				53	 3819
				54	 3816
				55	 3812
				56	 3809
				57	 3805
				58	 3802
				59	 3799
				61	 3796
				62	 3794
				63	 3791
				64	 3789
				65	 3786
				66	 3784
				67	 3782
				68	 3780
				70	 3778
				71	 3776
				72	 3774
				73	 3772
				74	 3770
				75	 3768
				76	 3765
				77	 3762
				79	 3759
				80	 3754
				81	 3750
				82	 3747
				83	 3743
				84	 3738
				85	 3732
				86	 3725
				88	 3719
				89	 3713
				90	 3703
				91	 3696
				92	 3694
				93	 3693
				94	 3692
				95	 3691
				97	 3689
				98	 3683
				99	 3656
				100  3607
				101  3541>;

	battery_profile_t2_num = <91>;
	battery_profile_t2 = <
				0	   4192
				1	   4177
				2	   4163
				3	   4151
				4	   4139
				6	   4128
				7	   4117
				8	   4107
				9	   4097
				10	 4087
				11	 4079
				12	 4074
				13	 4070
				15	 4064
				16	 4054
				17	 4044
				18	 4032
				19	 4020
				20	 4008
				21	 3997
				22	 3989
				24	 3982
				25	 3976
				26	 3973
				27	 3970
				28	 3966
				29	 3960
				30	 3953
				31	 3947
				33	 3941
				34	 3934
				35	 3928
				36	 3922
				37	 3916
				38	 3909
				39	 3902
				40	 3893
				42	 3883
				43	 3873
				44	 3863
				45	 3855
				46	 3848
				47	 3842
				48	 3836
				49	 3832
				51	 3827
				52	 3823
				53	 3819
				54	 3816
				55	 3812
				56	 3809
				57	 3805
				58	 3802
				59	 3799
				61	 3796
				62	 3794
				63	 3791
				64	 3789
				65	 3786
				66	 3784
				67	 3782
				68	 3780
				70	 3778
				71	 3776
				72	 3774
				73	 3772
				74	 3770
				75	 3768
				76	 3765
				77	 3762
				79	 3759
				80	 3754
				81	 3750
				82	 3747
				83	 3743
				84	 3738
				85	 3732
				86	 3725
				88	 3719
				89	 3713
				90	 3703
				91	 3696
				92	 3694
				93	 3693
				94	 3692
				95	 3691
				97	 3689
				98	 3683
				99	 3656
				100  3607
				101  3541>;


	battery_profile_t3_num = <91>;
	battery_profile_t3 = <
				0	   4192
				1	   4177
				2	   4163
				3	   4151
				4	   4139
				6	   4128
				7	   4117
				8	   4107
				9	   4097
				10	 4087
				11	 4079
				12	 4074
				13	 4070
				15	 4064
				16	 4054
				17	 4044
				18	 4032
				19	 4020
				20	 4008
				21	 3997
				22	 3989
				24	 3982
				25	 3976
				26	 3973
				27	 3970
				28	 3966
				29	 3960
				30	 3953
				31	 3947
				33	 3941
				34	 3934
				35	 3928
				36	 3922
				37	 3916
				38	 3909
				39	 3902
				40	 3893
				42	 3883
				43	 3873
				44	 3863
				45	 3855
				46	 3848
				47	 3842
				48	 3836
				49	 3832
				51	 3827
				52	 3823
				53	 3819
				54	 3816
				55	 3812
				56	 3809
				57	 3805
				58	 3802
				59	 3799
				61	 3796
				62	 3794
				63	 3791
				64	 3789
				65	 3786
				66	 3784
				67	 3782
				68	 3780
				70	 3778
				71	 3776
				72	 3774
				73	 3772
				74	 3770
				75	 3768
				76	 3765
				77	 3762
				79	 3759
				80	 3754
				81	 3750
				82	 3747
				83	 3743
				84	 3738
				85	 3732
				86	 3725
				88	 3719
				89	 3713
				90	 3703
				91	 3696
				92	 3694
				93	 3693
				94	 3692
				95	 3691
				97	 3689
				98	 3683
				99	 3656
				100  3607
				101  3541>;

	r_profile_t0_num = <91>;
	r_profile_t0 = <
				70	   4192
				70	   4177
				70	   4163
				70	   4151
				70	   4139
				70	   4128
				70	   4117
				70	   4107
				70		 4097
				70		 4087
				70		 4079
				70		 4074
				70		 4070
				70		 4064
				70		 4054
				70		 4044
				70		 4032
				70		 4020
				70		 4008
				70		 3997
				70		 3989
				70		 3982
				70		 3976
				70		 3973
				70		 3970
				70		 3966
				70		 3960
				70		 3953
				70		 3947
				70		 3941
				70		 3934
				70		 3928
				70		 3922
				70		 3916
				70		 3909
				70		 3902
				70		 3893
				70		 3883
				70		 3873
				70		 3863
				70		 3855
				70		 3848
				70		 3842
				70		 3836
				70		 3832
				70		 3827
				70		 3823
				70		 3819
				70		 3816
				70		 3812
				70		 3809
				70		 3805
				70		 3802
				70		 3799
				70		 3796
				70		 3794
				70		 3791
				70		 3789
				70		 3786
				70		 3784
				70		 3782
				70		 3780
				70		 3778
				70		 3776
				70		 3774
				70		 3772
				70		 3770
				70		 3768
				70		 3765
				70		 3762
				70		 3759
				70		 3754
				70		 3750
				70		 3747
				70		 3743
				70		 3738
				70		 3732
				70		 3725
				70		 3719
				70		 3713
				70		 3703
				70		 3696
				70		 3694
				70		 3693
				70		 3692
				70		 3691
				70		 3689
				70		 3683
				70		 3656
				70		 3607
				70		 3541>;

	r_profile_t1_num = <91>;
	r_profile_t1 = <
				70	   4192
				70	   4177
				70	   4163
				70	   4151
				70	   4139
				70	   4128
				70	   4117
				70	   4107
				70		 4097
				70		 4087
				70		 4079
				70		 4074
				70		 4070
				70		 4064
				70		 4054
				70		 4044
				70		 4032
				70		 4020
				70		 4008
				70		 3997
				70		 3989
				70		 3982
				70		 3976
				70		 3973
				70		 3970
				70		 3966
				70		 3960
				70		 3953
				70		 3947
				70		 3941
				70		 3934
				70		 3928
				70		 3922
				70		 3916
				70		 3909
				70		 3902
				70		 3893
				70		 3883
				70		 3873
				70		 3863
				70		 3855
				70		 3848
				70		 3842
				70		 3836
				70		 3832
				70		 3827
				70		 3823
				70		 3819
				70		 3816
				70		 3812
				70		 3809
				70		 3805
				70		 3802
				70		 3799
				70		 3796
				70		 3794
				70		 3791
				70		 3789
				70		 3786
				70		 3784
				70		 3782
				70		 3780
				70		 3778
				70		 3776
				70		 3774
				70		 3772
				70		 3770
				70		 3768
				70		 3765
				70		 3762
				70		 3759
				70		 3754
				70		 3750
				70		 3747
				70		 3743
				70		 3738
				70		 3732
				70		 3725
				70		 3719
				70		 3713
				70		 3703
				70		 3696
				70		 3694
				70		 3693
				70		 3692
				70		 3691
				70		 3689
				70		 3683
				70		 3656
				70		 3607
				70		 3541>;

	r_profile_t2_num = <91>;
	r_profile_t2 = <
				70	   4192
				70	   4177
				70	   4163
				70	   4151
				70	   4139
				70	   4128
				70	   4117
				70	   4107
				70		 4097
				70		 4087
				70		 4079
				70		 4074
				70		 4070
				70		 4064
				70		 4054
				70		 4044
				70		 4032
				70		 4020
				70		 4008
				70		 3997
				70		 3989
				70		 3982
				70		 3976
				70		 3973
				70		 3970
				70		 3966
				70		 3960
				70		 3953
				70		 3947
				70		 3941
				70		 3934
				70		 3928
				70		 3922
				70		 3916
				70		 3909
				70		 3902
				70		 3893
				70		 3883
				70		 3873
				70		 3863
				70		 3855
				70		 3848
				70		 3842
				70		 3836
				70		 3832
				70		 3827
				70		 3823
				70		 3819
				70		 3816
				70		 3812
				70		 3809
				70		 3805
				70		 3802
				70		 3799
				70		 3796
				70		 3794
				70		 3791
				70		 3789
				70		 3786
				70		 3784
				70		 3782
				70		 3780
				70		 3778
				70		 3776
				70		 3774
				70		 3772
				70		 3770
				70		 3768
				70		 3765
				70		 3762
				70		 3759
				70		 3754
				70		 3750
				70		 3747
				70		 3743
				70		 3738
				70		 3732
				70		 3725
				70		 3719
				70		 3713
				70		 3703
				70		 3696
				70		 3694
				70		 3693
				70		 3692
				70		 3691
				70		 3689
				70		 3683
				70		 3656
				70		 3607
				70		 3541>;
				
	r_profile_t3_num = <91>;
	r_profile_t3 = <
				70	   4192
				70	   4177
				70	   4163
				70	   4151
				70	   4139
				70	   4128
				70	   4117
				70	   4107
				70		 4097
				70		 4087
				70		 4079
				70		 4074
				70		 4070
				70		 4064
				70		 4054
				70		 4044
				70		 4032
				70		 4020
				70		 4008
				70		 3997
				70		 3989
				70		 3982
				70		 3976
				70		 3973
				70		 3970
				70		 3966
				70		 3960
				70		 3953
				70		 3947
				70		 3941
				70		 3934
				70		 3928
				70		 3922
				70		 3916
				70		 3909
				70		 3902
				70		 3893
				70		 3883
				70		 3873
				70		 3863
				70		 3855
				70		 3848
				70		 3842
				70		 3836
				70		 3832
				70		 3827
				70		 3823
				70		 3819
				70		 3816
				70		 3812
				70		 3809
				70		 3805
				70		 3802
				70		 3799
				70		 3796
				70		 3794
				70		 3791
				70		 3789
				70		 3786
				70		 3784
				70		 3782
				70		 3780
				70		 3778
				70		 3776
				70		 3774
				70		 3772
				70		 3770
				70		 3768
				70		 3765
				70		 3762
				70		 3759
				70		 3754
				70		 3750
				70		 3747
				70		 3743
				70		 3738
				70		 3732
				70		 3725
				70		 3719
				70		 3713
				70		 3703
				70		 3696
				70		 3694
				70		 3693
				70		 3692
				70		 3691
				70		 3689
				70		 3683
				70		 3656
				70		 3607
				70		 3541>;
};
