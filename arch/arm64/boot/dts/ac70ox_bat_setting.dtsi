/*************************
 * Customized Battery Setting dtsi file
*************************/
&bat_comm {
	gpio22_dc_det = <&pio 22 0>;
	gpio85_set_chr_set = <&pio 85 0>;
	gpio28_spec_cur_select = <&pio 28 0>;

	/* cust_charging.h */
	/* stop charging while in talking mode */
	stop_charging_in_takling = <1>;
	talking_recharge_voltage = <3800>;
	talking_sync_time = <60>;

	/* Battery Temperature Protection */
	mtk_temperature_recharge_support = <1>;
	max_charge_temperature = <50>;
	max_charge_temperature_minus_x_degree = <47>;
	min_charge_temperature = <0>;
	min_charge_temperature_plus_x_degree = <6>;
	err_charge_temperature = <0xff>;

	/* Linear Charging Threshold */
	v_pre2cc_thres = <3400>;	/* unit: mV */
	v_cc2topoff_thres = <4050>;
	recharging_voltage = <4110>;
	charging_full_current = <80>;	/* unit: mA */

	/* Charging Current Setting */
	config_usb_if = <0>;
	usb_charger_current_suspend = <0>;	/* Unit: 0.01 mA */
	usb_charger_current_unconfigured = <7000>;	/* Unit: 0.01 mA */
	usb_charger_current_configured = <50000>;	/* Unit: 0.01 mA */
	usb_charger_current = <50000>;	/* Unit: 0.01 mA */
	ac_charger_current = <140000>;	/* Unit: 0.01 mA */
	non_std_ac_charger_current = <50000>;	/* Unit: 0.01 mA */
	charging_host_charger_current = <65000>;	/* Unit: 0.01 mA */
	apple_0_5a_charger_current = <50000>;	/* Unit: 0.01 mA */
	apple_1_0a_charger_current = <65000>;	/* Unit: 0.01 mA */
	apple_2_1a_charger_current = <80000>;	/* Unit: 0.01 mA */

	/* charger error check */
	bat_low_temp_protect_enable = <0>;
	v_charger_enable = <0>;	/* 1:on , 0:off */
	v_charger_max = <6500>;	/* unit: mV */
	v_charger_min = <4400>;

	/*  Tracking TIME */
	onehundred_percent_tracking_time = <10>;	/* Unit: second */
	npercent_tracking_time = <20>;	/* Unit: second */
	sync_to_real_tracking_time = <60>;	/* Unit: second */
	v_0percent_tracking = <3450>;	/* Unit: mV */

	/* High battery support */
	high_battery_voltage_support = <0>;
};

&bat_meter {
	/* cust_battery_meter.h */
	/* ADC resistor  */
	r_bat_sense = <4>;
	r_i_sense = <4>;
	r_charger_1 = <330>;
	r_charger_2 = <39>;
	temperature_t0 = <110>;
	temperature_t1 = <0>;
	temperature_t2 = <25>;
	temperature_t3 = <50>;
	temperature_t = <255>;	/* this should be fixed, never change the value */
	fg_meter_resistance = <0>;

	/* Qmax for 0mA */
	q_max_pos_50 = <2920>;
	q_max_pos_25 = <2920>;
	q_max_pos_0 = <2920>;
	q_max_neg_10 = <2920>;
	/* Qmax for 400mA, said high current */
	q_max_pos_50_h_current = <2598>;
	q_max_pos_25_h_current = <2598>;
	q_max_pos_0_h_current = <2598>;
	q_max_neg_10_h_current = <2598>;
	/* Discharge percentage, 1: D5, 0: D2 */
	oam_d5 = <1>;

	change_tracking_point = <1>;
	/* SW OCV tracking setting */
	cust_tracking_point = <14>;
	cust_r_sense = <200>;
	cust_hw_cc = <0>;
	aging_tuning_value = <100>;
	cust_r_fg_offset = <0>;
	ocv_board_compesate = <0>;
	r_fg_board_base = <1000>;
	r_fg_board_slope = <1000>;
	car_tune_value = <89>;

	/* HW Fuel gague  */
	current_detect_r_fg = <10>;	/* Unit: mA */
	minerroroffset = <1000>;
	fg_vbat_average_size = <18>;
	r_fg_value = <10>;	/* Unit: mOhm */

	cust_poweron_delta_capacity_tolrance = <80>;
	cust_poweron_low_capacity_tolrance = <5>;
	cust_poweron_max_vbat_tolrance = <70>;
	cust_poweron_delta_vbat_tolrance = <60>;
	cust_poweron_delta_hw_sw_ocv_capacity_tolrance = <10>;

	/* Fixed battery temperature */
	fixed_tbat_25 = <1>;
	/* Dynamic change wake up period of battery thread when suspend */
	vbat_normal_wakeup = <3600>;	/* Unit: mV */
	vbat_low_power_wakeup = <3500>;	/* Unit: mV */
	normal_wakeup_period = <5400>;	/* Unit: second */
	low_power_wakeup_period = <300>;	/* Unit: second */
	close_poweroff_wakeup_period = <30>;	/* Unit: second */

	rbat_pull_up_r = <16900>;
	rbat_pull_up_volt = <1800>;

	batt_temperature_table_num = <17>;
	batt_temperature_table = <
			    (-20) 75022
			    (-15) 57926
			    (-10) 45168
			    (-5) 35548
			    0 28224
			    5 22595
			    10 18231
			    15 14820
			    20 12133
			    25 10000 30 8295 35 6922 40 5810 45 4903 50 4160 55 3547 60 3039>;

	battery_profile_t0_num = <85>;
	battery_profile_t0 = <0    4192
				1    4175
				2    4161
				4    4148
				5    4136
				6    4124
				7    4113
				9    4101
				10   4090
				11   4080
				12   4071
				14   4064
				15   4054
				16   4042
				17   4029
				18   4017
				20   4006
				21   3996
				22   3987
				23   3979
				25   3973
				26   3969
				27   3962
				28   3955
				30   3948
				31   3941
				32   3933
				33   3927
				35   3920
				36   3914
				37   3907
				38   3901
				39   3894
				41   3887
				42   3879
				43   3870
				44   3859
				46   3850
				47   3841
				48   3834
				49   3828
				51   3823
				52   3818
				53   3813
				54   3810
				55   3806
				57   3802
				58   3799
				59   3796
				60   3793
				62   3790
				63   3788
				64   3785
				65   3783
				67   3781
				68   3779
				69   3777
				70   3775
				72   3774
				73   3773
				74   3771
				75   3768
				76   3766
				78   3762
				79   3758
				80   3752
				81   3748
				83   3743
				84   3739
				85   3732
				86   3724
				88   3717
				89   3709
				90   3699
				91   3692
				92   3690
				94   3689
				95   3687
				96   3686
				97   3681
				99   3656
				100  3607
				101  3539
				102  3444
				103  3323>;

	battery_profile_t1_num = <85>;
	battery_profile_t1 =  <0    4192
				1    4175
				2    4161
				4    4148
				5    4136
				6    4124
				7    4113
				9    4101
				10   4090
				11   4080
				12   4071
				14   4064
				15   4054
				16   4042
				17   4029
				18   4017
				20   4006
				21   3996
				22   3987
				23   3979
				25   3973
				26   3969
				27   3962
				28   3955
				30   3948
				31   3941
				32   3933
				33   3927
				35   3920
				36   3914
				37   3907
				38   3901
				39   3894
				41   3887
				42   3879
				43   3870
				44   3859
				46   3850
				47   3841
				48   3834
				49   3828
				51   3823
				52   3818
				53   3813
				54   3810
				55   3806
				57   3802
				58   3799
				59   3796
				60   3793
				62   3790
				63   3788
				64   3785
				65   3783
				67   3781
				68   3779
				69   3777
				70   3775
				72   3774
				73   3773
				74   3771
				75   3768
				76   3766
				78   3762
				79   3758
				80   3752
				81   3748
				83   3743
				84   3739
				85   3732
				86   3724
				88   3717
				89   3709
				90   3699
				91   3692
				92   3690
				94   3689
				95   3687
				96   3686
				97   3681
				99   3656
				100  3607
				101  3539
				102  3444
				103  3323>;

	battery_profile_t2_num = <85>;
	battery_profile_t2 =  <0    4192
				1    4175
				2    4161
				4    4148
				5    4136
				6    4124
				7    4113
				9    4101
				10   4090
				11   4080
				12   4071
				14   4064
				15   4054
				16   4042
				17   4029
				18   4017
				20   4006
				21   3996
				22   3987
				23   3979
				25   3973
				26   3969
				27   3962
				28   3955
				30   3948
				31   3941
				32   3933
				33   3927
				35   3920
				36   3914
				37   3907
				38   3901
				39   3894
				41   3887
				42   3879
				43   3870
				44   3859
				46   3850
				47   3841
				48   3834
				49   3828
				51   3823
				52   3818
				53   3813
				54   3810
				55   3806
				57   3802
				58   3799
				59   3796
				60   3793
				62   3790
				63   3788
				64   3785
				65   3783
				67   3781
				68   3779
				69   3777
				70   3775
				72   3774
				73   3773
				74   3771
				75   3768
				76   3766
				78   3762
				79   3758
				80   3752
				81   3748
				83   3743
				84   3739
				85   3732
				86   3724
				88   3717
				89   3709
				90   3699
				91   3692
				92   3690
				94   3689
				95   3687
				96   3686
				97   3681
				99   3656
				100  3607
				101  3539
				102  3444
				103  3323>;


	battery_profile_t3_num = <85>;
	battery_profile_t3 =  <0    4192
				1    4175
				2    4161
				4    4148
				5    4136
				6    4124
				7    4113
				9    4101
				10   4090
				11   4080
				12   4071
				14   4064
				15   4054
				16   4042
				17   4029
				18   4017
				20   4006
				21   3996
				22   3987
				23   3979
				25   3973
				26   3969
				27   3962
				28   3955
				30   3948
				31   3941
				32   3933
				33   3927
				35   3920
				36   3914
				37   3907
				38   3901
				39   3894
				41   3887
				42   3879
				43   3870
				44   3859
				46   3850
				47   3841
				48   3834
				49   3828
				51   3823
				52   3818
				53   3813
				54   3810
				55   3806
				57   3802
				58   3799
				59   3796
				60   3793
				62   3790
				63   3788
				64   3785
				65   3783
				67   3781
				68   3779
				69   3777
				70   3775
				72   3774
				73   3773
				74   3771
				75   3768
				76   3766
				78   3762
				79   3758
				80   3752
				81   3748
				83   3743
				84   3739
				85   3732
				86   3724
				88   3717
				89   3709
				90   3699
				91   3692
				92   3690
				94   3689
				95   3687
				96   3686
				97   3681
				99   3656
				100  3607
				101  3539
				102  3444
				103  3323>;


	r_profile_t0_num = <85>;
	r_profile_t0 = <111  4192
				112  4175
				112  4161
				113  4148
				113  4136
				114  4124
				117  4113
				116  4101
				117  4090
				118  4080
				120  4071
				123  4064
				122  4054
				122  4042
				122  4029
				122  4017
				123  4006
				126  3996
				128  3987
				129  3979
				130  3973
				136  3969
				131  3962
				131  3955
				129  3948
				129  3941
				127  3933
				129  3927
				128  3920
				131  3914
				133  3907
				134  3901
				136  3894
				134  3887
				133  3879
				129  3870
				124  3859
				120  3850
				118  3841
				114  3834
				114  3828
				114  3823
				114  3818
				113  3813
				114  3810
				116  3806
				114  3802
				117  3799
				117  3796
				118  3793
				118  3790
				119  3788
				119  3785
				120  3783
				119  3781
				121  3779
				120  3777
				121  3775
				122  3774
				123  3773
				122  3771
				121  3768
				121  3766
				120  3762
				119  3758
				118  3752
				119  3748
				120  3743
				121  3739
				120  3732
				119  3724
				120  3717
				120  3709
				116  3699
				112  3692
				117  3690
				123  3689
				129  3687
				137  3686
				141  3681
				133  3656
				130  3607
				133  3539
				140  3444
				139  3323>;

	r_profile_t1_num = <85>;
	r_profile_t1 = <111  4192
				112  4175
				112  4161
				113  4148
				113  4136
				114  4124
				117  4113
				116  4101
				117  4090
				118  4080
				120  4071
				123  4064
				122  4054
				122  4042
				122  4029
				122  4017
				123  4006
				126  3996
				128  3987
				129  3979
				130  3973
				136  3969
				131  3962
				131  3955
				129  3948
				129  3941
				127  3933
				129  3927
				128  3920
				131  3914
				133  3907
				134  3901
				136  3894
				134  3887
				133  3879
				129  3870
				124  3859
				120  3850
				118  3841
				114  3834
				114  3828
				114  3823
				114  3818
				113  3813
				114  3810
				116  3806
				114  3802
				117  3799
				117  3796
				118  3793
				118  3790
				119  3788
				119  3785
				120  3783
				119  3781
				121  3779
				120  3777
				121  3775
				122  3774
				123  3773
				122  3771
				121  3768
				121  3766
				120  3762
				119  3758
				118  3752
				119  3748
				120  3743
				121  3739
				120  3732
				119  3724
				120  3717
				120  3709
				116  3699
				112  3692
				117  3690
				123  3689
				129  3687
				137  3686
				141  3681
				133  3656
				130  3607
				133  3539
				140  3444
				139  3323>;


	r_profile_t2_num = <85>;
	r_profile_t2 = <111  4192
				112  4175
				112  4161
				113  4148
				113  4136
				114  4124
				117  4113
				116  4101
				117  4090
				118  4080
				120  4071
				123  4064
				122  4054
				122  4042
				122  4029
				122  4017
				123  4006
				126  3996
				128  3987
				129  3979
				130  3973
				136  3969
				131  3962
				131  3955
				129  3948
				129  3941
				127  3933
				129  3927
				128  3920
				131  3914
				133  3907
				134  3901
				136  3894
				134  3887
				133  3879
				129  3870
				124  3859
				120  3850
				118  3841
				114  3834
				114  3828
				114  3823
				114  3818
				113  3813
				114  3810
				116  3806
				114  3802
				117  3799
				117  3796
				118  3793
				118  3790
				119  3788
				119  3785
				120  3783
				119  3781
				121  3779
				120  3777
				121  3775
				122  3774
				123  3773
				122  3771
				121  3768
				121  3766
				120  3762
				119  3758
				118  3752
				119  3748
				120  3743
				121  3739
				120  3732
				119  3724
				120  3717
				120  3709
				116  3699
				112  3692
				117  3690
				123  3689
				129  3687
				137  3686
				141  3681
				133  3656
				130  3607
				133  3539
				140  3444
				139  3323>;


	r_profile_t3_num = <85>;
	r_profile_t3 = <111  4192
				112  4175
				112  4161
				113  4148
				113  4136
				114  4124
				117  4113
				116  4101
				117  4090
				118  4080
				120  4071
				123  4064
				122  4054
				122  4042
				122  4029
				122  4017
				123  4006
				126  3996
				128  3987
				129  3979
				130  3973
				136  3969
				131  3962
				131  3955
				129  3948
				129  3941
				127  3933
				129  3927
				128  3920
				131  3914
				133  3907
				134  3901
				136  3894
				134  3887
				133  3879
				129  3870
				124  3859
				120  3850
				118  3841
				114  3834
				114  3828
				114  3823
				114  3818
				113  3813
				114  3810
				116  3806
				114  3802
				117  3799
				117  3796
				118  3793
				118  3790
				119  3788
				119  3785
				120  3783
				119  3781
				121  3779
				120  3777
				121  3775
				122  3774
				123  3773
				122  3771
				121  3768
				121  3766
				120  3762
				119  3758
				118  3752
				119  3748
				120  3743
				121  3739
				120  3732
				119  3724
				120  3717
				120  3709
				116  3699
				112  3692
				117  3690
				123  3689
				129  3687
				137  3686
				141  3681
				133  3656
				130  3607
				133  3539
				140  3444
				139  3323>;

};
