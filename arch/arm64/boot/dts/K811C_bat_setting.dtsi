/*************************
 * Customized Battery Setting dtsi file
*************************/
&bat_comm {
	gpio22_dc_det = <&pio 22 0>;
	gpio85_set_chr_set = <&pio 85 0>;
	gpio28_spec_cur_select = <&pio 28 0>;

	/* cust_charging.h */
	/* stop charging while in talking mode */
	stop_charging_in_takling = <1>;
	talking_recharge_voltage = <3800>;
	talking_sync_time = <60>;

	/* Battery Temperature Protection */
	mtk_temperature_recharge_support = <1>;
	max_charge_temperature = <50>;
	max_charge_temperature_minus_x_degree = <47>;
	min_charge_temperature = <0>;
	min_charge_temperature_plus_x_degree = <6>;
	err_charge_temperature = <0xff>;

	/* Linear Charging Threshold */
	v_pre2cc_thres = <3400>;	/* unit: mV */
	v_cc2topoff_thres = <4050>;
	recharging_voltage = <4110>;
	charging_full_current = <80>;	/* unit: mA */

	/* Charging Current Setting */
	config_usb_if = <0>;
	usb_charger_current_suspend = <0>;	/* Unit: 0.01 mA */
	usb_charger_current_unconfigured = <7000>;	/* Unit: 0.01 mA */
	usb_charger_current_configured = <50000>;	/* Unit: 0.01 mA */
	usb_charger_current = <50000>;	/* Unit: 0.01 mA */
	ac_charger_current = <130000>;	/* Unit: 0.01 mA */
	non_std_ac_charger_current = <50000>;	/* Unit: 0.01 mA */
	charging_host_charger_current = <65000>;	/* Unit: 0.01 mA */
	apple_0_5a_charger_current = <50000>;	/* Unit: 0.01 mA */
	apple_1_0a_charger_current = <65000>;	/* Unit: 0.01 mA */
	apple_2_1a_charger_current = <80000>;	/* Unit: 0.01 mA */

	/* charger error check */
	bat_low_temp_protect_enable = <0>;
	v_charger_enable = <0>;	/* 1:on , 0:off */
	v_charger_max = <6500>;	/* unit: mV */
	v_charger_min = <4400>;

	/*  Tracking TIME */
	onehundred_percent_tracking_time = <10>;	/* Unit: second */
	npercent_tracking_time = <20>;	/* Unit: second */
	sync_to_real_tracking_time = <60>;	/* Unit: second */
	v_0percent_tracking = <3450>;	/* Unit: mV */

	/* High battery support */
	high_battery_voltage_support = <0>;
};

&bat_meter {
	/* cust_battery_meter.h */
	/* ADC resistor  */
	r_bat_sense = <4>;
	r_i_sense = <4>;
	r_charger_1 = <330>;
	r_charger_2 = <39>;
	temperature_t0 = <110>;
	temperature_t1 = <0>;
	temperature_t2 = <25>;
	temperature_t3 = <50>;
	temperature_t = <255>;	/* this should be fixed, never change the value */
	fg_meter_resistance = <0>;

	/* Qmax for 0mA */
	q_max_pos_50 = <3942>;
	q_max_pos_25 = <3942>;
	q_max_pos_0 = <3942>;
	q_max_neg_10 = <3942>;
	/* Qmax for 400mA, said high current */
	q_max_pos_50_h_current = <3561>;
	q_max_pos_25_h_current = <3561>;
	q_max_pos_0_h_current = <3561>;
	q_max_neg_10_h_current = <3561>;
	/* Discharge percentage, 1: D5, 0: D2 */
	oam_d5 = <1>;

	change_tracking_point = <1>;
	/* SW OCV tracking setting */
	cust_tracking_point = <14>;
	cust_r_sense = <200>;
	cust_hw_cc = <0>;
	aging_tuning_value = <100>;
	cust_r_fg_offset = <0>;
	ocv_board_compesate = <0>;
	r_fg_board_base = <1000>;
	r_fg_board_slope = <1000>;
	car_tune_value = <89>;

	/* HW Fuel gague  */
	current_detect_r_fg = <10>;	/* Unit: mA */
	minerroroffset = <1000>;
	fg_vbat_average_size = <18>;
	r_fg_value = <10>;	/* Unit: mOhm */

	cust_poweron_delta_capacity_tolrance = <80>;
	cust_poweron_low_capacity_tolrance = <5>;
	cust_poweron_max_vbat_tolrance = <70>;
	cust_poweron_delta_vbat_tolrance = <60>;
	cust_poweron_delta_hw_sw_ocv_capacity_tolrance = <10>;

	/* Fixed battery temperature */
	fixed_tbat_25 = <1>;
	/* Dynamic change wake up period of battery thread when suspend */
	vbat_normal_wakeup = <3600>;	/* Unit: mV */
	vbat_low_power_wakeup = <3500>;	/* Unit: mV */
	normal_wakeup_period = <5400>;	/* Unit: second */
	low_power_wakeup_period = <300>;	/* Unit: second */
	close_poweroff_wakeup_period = <30>;	/* Unit: second */

	rbat_pull_up_r = <16900>;
	rbat_pull_up_volt = <1800>;

	batt_temperature_table_num = <17>;
	batt_temperature_table = <
			    (-20) 75022
			    (-15) 57926
			    (-10) 45168
			    (-5) 35548
			    0 28224
			    5 22595
			    10 18231
			    15 14820
			    20 12133
			    25 10000 30 8295 35 6922 40 5810 45 4903 50 4160 55 3547 60 3039>;

	battery_profile_t0_num = <91>;
	battery_profile_t0 = < 0  4190 
				 1  4170 
				 2  4156 
				 3  4144 
				 5  4132 
				 6  4119 
				 7  4109 
				 8  4098 
				 9  4089 
				 10  4079 
				 11  4068 
				 13  4058 
				 14  4048 
				 15  4039 
				 16  4030 
				 17  4021 
				 18  4012 
				 19  4003 
				 21  3995 
				 22  3987 
				 23  3980 
				 24  3972 
				 25  3964 
				 26  3958 
				 27  3951 
				 29  3943 
				 30  3935 
				 31  3929 
				 32  3923 
				 33  3917 
				 34  3911 
				 35  3905 
				 37  3899 
				 38  3893 
				 39  3886 
				 40  3880 
				 41  3873 
				 42  3865 
				 43  3854 
				 45  3845 
				 46  3836 
				 47  3828 
				 48  3822 
				 49  3817 
				 50  3813 
				 51  3808 
				 53  3804 
				 54  3802 
				 55  3798 
				 56  3795 
				 57  3793 
				 58  3790 
				 59  3788 
				 61  3786 
				 62  3783 
				 63  3781 
				 64  3780 
				 65  3778 
				 66  3777 
				 67  3775 
				 68  3774 
				 70  3771 
				 71  3770 
				 72  3769 
				 73  3767 
				 74  3764 
				 75  3761 
				 76  3759 
				 78  3755 
				 79  3752 
				 80  3747 
				 81  3743 
				 82  3740 
				 83  3734 
				 84  3731 
				 86  3725 
				 87  3717 
				 88  3710 
				 89  3703 
				 90  3695 
				 91  3685 
				 92  3679 
				 94  3676 
				 95  3673 
				 96  3670 
				 97  3664 
				 98  3655 
				 99  3630 
				 100  3580 
				 102  3515 
				 103  3429>;

	battery_profile_t1_num = <91>;
	battery_profile_t1 = < 0  4190 
				 1  4170 
				 2  4156 
				 3  4144 
				 5  4132 
				 6  4119 
				 7  4109 
				 8  4098 
				 9  4089 
				 10  4079 
				 11  4068 
				 13  4058 
				 14  4048 
				 15  4039 
				 16  4030 
				 17  4021 
				 18  4012 
				 19  4003 
				 21  3995 
				 22  3987 
				 23  3980 
				 24  3972 
				 25  3964 
				 26  3958 
				 27  3951 
				 29  3943 
				 30  3935 
				 31  3929 
				 32  3923 
				 33  3917 
				 34  3911 
				 35  3905 
				 37  3899 
				 38  3893 
				 39  3886 
				 40  3880 
				 41  3873 
				 42  3865 
				 43  3854 
				 45  3845 
				 46  3836 
				 47  3828 
				 48  3822 
				 49  3817 
				 50  3813 
				 51  3808 
				 53  3804 
				 54  3802 
				 55  3798 
				 56  3795 
				 57  3793 
				 58  3790 
				 59  3788 
				 61  3786 
				 62  3783 
				 63  3781 
				 64  3780 
				 65  3778 
				 66  3777 
				 67  3775 
				 68  3774 
				 70  3771 
				 71  3770 
				 72  3769 
				 73  3767 
				 74  3764 
				 75  3761 
				 76  3759 
				 78  3755 
				 79  3752 
				 80  3747 
				 81  3743 
				 82  3740 
				 83  3734 
				 84  3731 
				 86  3725 
				 87  3717 
				 88  3710 
				 89  3703 
				 90  3695 
				 91  3685 
				 92  3679 
				 94  3676 
				 95  3673 
				 96  3670 
				 97  3664 
				 98  3655 
				 99  3630 
				 100  3580 
				 102  3515 
				 103  3429>;

	battery_profile_t2_num = <91>;
	battery_profile_t2 = < 0  4190 
				 1  4170 
				 2  4156 
				 3  4144 
				 5  4132 
				 6  4119 
				 7  4109 
				 8  4098 
				 9  4089 
				 10  4079 
				 11  4068 
				 13  4058 
				 14  4048 
				 15  4039 
				 16  4030 
				 17  4021 
				 18  4012 
				 19  4003 
				 21  3995 
				 22  3987 
				 23  3980 
				 24  3972 
				 25  3964 
				 26  3958 
				 27  3951 
				 29  3943 
				 30  3935 
				 31  3929 
				 32  3923 
				 33  3917 
				 34  3911 
				 35  3905 
				 37  3899 
				 38  3893 
				 39  3886 
				 40  3880 
				 41  3873 
				 42  3865 
				 43  3854 
				 45  3845 
				 46  3836 
				 47  3828 
				 48  3822 
				 49  3817 
				 50  3813 
				 51  3808 
				 53  3804 
				 54  3802 
				 55  3798 
				 56  3795 
				 57  3793 
				 58  3790 
				 59  3788 
				 61  3786 
				 62  3783 
				 63  3781 
				 64  3780 
				 65  3778 
				 66  3777 
				 67  3775 
				 68  3774 
				 70  3771 
				 71  3770 
				 72  3769 
				 73  3767 
				 74  3764 
				 75  3761 
				 76  3759 
				 78  3755 
				 79  3752 
				 80  3747 
				 81  3743 
				 82  3740 
				 83  3734 
				 84  3731 
				 86  3725 
				 87  3717 
				 88  3710 
				 89  3703 
				 90  3695 
				 91  3685 
				 92  3679 
				 94  3676 
				 95  3673 
				 96  3670 
				 97  3664 
				 98  3655 
				 99  3630 
				 100  3580 
				 102  3515 
				 103  3429>;

	battery_profile_t3_num = <91>;
	battery_profile_t3 = < 0  4190 
				 1  4170 
				 2  4156 
				 3  4144 
				 5  4132 
				 6  4119 
				 7  4109 
				 8  4098 
				 9  4089 
				 10  4079 
				 11  4068 
				 13  4058 
				 14  4048 
				 15  4039 
				 16  4030 
				 17  4021 
				 18  4012 
				 19  4003 
				 21  3995 
				 22  3987 
				 23  3980 
				 24  3972 
				 25  3964 
				 26  3958 
				 27  3951 
				 29  3943 
				 30  3935 
				 31  3929 
				 32  3923 
				 33  3917 
				 34  3911 
				 35  3905 
				 37  3899 
				 38  3893 
				 39  3886 
				 40  3880 
				 41  3873 
				 42  3865 
				 43  3854 
				 45  3845 
				 46  3836 
				 47  3828 
				 48  3822 
				 49  3817 
				 50  3813 
				 51  3808 
				 53  3804 
				 54  3802 
				 55  3798 
				 56  3795 
				 57  3793 
				 58  3790 
				 59  3788 
				 61  3786 
				 62  3783 
				 63  3781 
				 64  3780 
				 65  3778 
				 66  3777 
				 67  3775 
				 68  3774 
				 70  3771 
				 71  3770 
				 72  3769 
				 73  3767 
				 74  3764 
				 75  3761 
				 76  3759 
				 78  3755 
				 79  3752 
				 80  3747 
				 81  3743 
				 82  3740 
				 83  3734 
				 84  3731 
				 86  3725 
				 87  3717 
				 88  3710 
				 89  3703 
				 90  3695 
				 91  3685 
				 92  3679 
				 94  3676 
				 95  3673 
				 96  3670 
				 97  3664 
				 98  3655 
				 99  3630 
				 100  3580 
				 102  3515 
				 103  3429>;

	r_profile_t0_num = <91>;
	r_profile_t0 = <96  4190 
				 96  4170 
				 96  4156 
				 99  4144 
				 99  4132 
				 97  4119 
				 99  4109 
				 100  4098 
				 102  4089 
				 103  4079 
				 102  4068 
				 101  4058 
				 102  4048 
				 104  4039 
				 106  4030 
				 108  4021 
				 108  4012 
				 108  4003 
				 109  3995 
				 111  3987 
				 112  3980 
				 114  3972 
				 113  3964 
				 116  3958 
				 117  3951 
				 117  3943 
				 118  3935 
				 118  3929 
				 119  3923 
				 120  3917 
				 120  3911 
				 118  3905 
				 119  3899 
				 119  3893 
				 119  3886 
				 119  3880 
				 119  3873 
				 116  3865 
				 110  3854 
				 107  3845 
				 103  3836 
				 100  3828 
				 100  3822 
				 98  3817 
				 99  3813 
				 98  3808 
				 97  3804 
				 100  3802 
				 100  3798 
				 100  3795 
				 101  3793 
				 101  3790 
				 101  3788 
				 102  3786 
				 101  3783 
				 102  3781 
				 104  3780 
				 104  3778 
				 104  3777 
				 106  3775 
				 104  3774 
				 104  3771 
				 103  3770 
				 106  3769 
				 104  3767 
				 103  3764 
				 103  3761 
				 104  3759 
				 103  3755 
				 103  3752 
				 106  3747 
				 108  3743 
				 111  3740 
				 108  3734 
				 108  3731 
				 108  3725 
				 102  3717 
				 104  3710 
				 107  3703 
				 104  3695 
				 101  3685 
				 101  3679 
				 103  3676 
				 108  3673 
				 112  3670 
				 118  3664 
				 124  3655 
				 122  3630 
				 120  3580 
				 126  3515 
				 138  3429>;

	r_profile_t1_num = <91>;
	r_profile_t1 = <96  4190 
				 96  4170 
				 96  4156 
				 99  4144 
				 99  4132 
				 97  4119 
				 99  4109 
				 100  4098 
				 102  4089 
				 103  4079 
				 102  4068 
				 101  4058 
				 102  4048 
				 104  4039 
				 106  4030 
				 108  4021 
				 108  4012 
				 108  4003 
				 109  3995 
				 111  3987 
				 112  3980 
				 114  3972 
				 113  3964 
				 116  3958 
				 117  3951 
				 117  3943 
				 118  3935 
				 118  3929 
				 119  3923 
				 120  3917 
				 120  3911 
				 118  3905 
				 119  3899 
				 119  3893 
				 119  3886 
				 119  3880 
				 119  3873 
				 116  3865 
				 110  3854 
				 107  3845 
				 103  3836 
				 100  3828 
				 100  3822 
				 98  3817 
				 99  3813 
				 98  3808 
				 97  3804 
				 100  3802 
				 100  3798 
				 100  3795 
				 101  3793 
				 101  3790 
				 101  3788 
				 102  3786 
				 101  3783 
				 102  3781 
				 104  3780 
				 104  3778 
				 104  3777 
				 106  3775 
				 104  3774 
				 104  3771 
				 103  3770 
				 106  3769 
				 104  3767 
				 103  3764 
				 103  3761 
				 104  3759 
				 103  3755 
				 103  3752 
				 106  3747 
				 108  3743 
				 111  3740 
				 108  3734 
				 108  3731 
				 108  3725 
				 102  3717 
				 104  3710 
				 107  3703 
				 104  3695 
				 101  3685 
				 101  3679 
				 103  3676 
				 108  3673 
				 112  3670 
				 118  3664 
				 124  3655 
				 122  3630 
				 120  3580 
				 126  3515 
				 138  3429>;

	r_profile_t2_num = <91>;
	r_profile_t2 = <96  4190 
				 96  4170 
				 96  4156 
				 99  4144 
				 99  4132 
				 97  4119 
				 99  4109 
				 100  4098 
				 102  4089 
				 103  4079 
				 102  4068 
				 101  4058 
				 102  4048 
				 104  4039 
				 106  4030 
				 108  4021 
				 108  4012 
				 108  4003 
				 109  3995 
				 111  3987 
				 112  3980 
				 114  3972 
				 113  3964 
				 116  3958 
				 117  3951 
				 117  3943 
				 118  3935 
				 118  3929 
				 119  3923 
				 120  3917 
				 120  3911 
				 118  3905 
				 119  3899 
				 119  3893 
				 119  3886 
				 119  3880 
				 119  3873 
				 116  3865 
				 110  3854 
				 107  3845 
				 103  3836 
				 100  3828 
				 100  3822 
				 98  3817 
				 99  3813 
				 98  3808 
				 97  3804 
				 100  3802 
				 100  3798 
				 100  3795 
				 101  3793 
				 101  3790 
				 101  3788 
				 102  3786 
				 101  3783 
				 102  3781 
				 104  3780 
				 104  3778 
				 104  3777 
				 106  3775 
				 104  3774 
				 104  3771 
				 103  3770 
				 106  3769 
				 104  3767 
				 103  3764 
				 103  3761 
				 104  3759 
				 103  3755 
				 103  3752 
				 106  3747 
				 108  3743 
				 111  3740 
				 108  3734 
				 108  3731 
				 108  3725 
				 102  3717 
				 104  3710 
				 107  3703 
				 104  3695 
				 101  3685 
				 101  3679 
				 103  3676 
				 108  3673 
				 112  3670 
				 118  3664 
				 124  3655 
				 122  3630 
				 120  3580 
				 126  3515 
				 138  3429>;

	r_profile_t3_num = <91>;
	r_profile_t3 = <96  4190 
				 96  4170 
				 96  4156 
				 99  4144 
				 99  4132 
				 97  4119 
				 99  4109 
				 100  4098 
				 102  4089 
				 103  4079 
				 102  4068 
				 101  4058 
				 102  4048 
				 104  4039 
				 106  4030 
				 108  4021 
				 108  4012 
				 108  4003 
				 109  3995 
				 111  3987 
				 112  3980 
				 114  3972 
				 113  3964 
				 116  3958 
				 117  3951 
				 117  3943 
				 118  3935 
				 118  3929 
				 119  3923 
				 120  3917 
				 120  3911 
				 118  3905 
				 119  3899 
				 119  3893 
				 119  3886 
				 119  3880 
				 119  3873 
				 116  3865 
				 110  3854 
				 107  3845 
				 103  3836 
				 100  3828 
				 100  3822 
				 98  3817 
				 99  3813 
				 98  3808 
				 97  3804 
				 100  3802 
				 100  3798 
				 100  3795 
				 101  3793 
				 101  3790 
				 101  3788 
				 102  3786 
				 101  3783 
				 102  3781 
				 104  3780 
				 104  3778 
				 104  3777 
				 106  3775 
				 104  3774 
				 104  3771 
				 103  3770 
				 106  3769 
				 104  3767 
				 103  3764 
				 103  3761 
				 104  3759 
				 103  3755 
				 103  3752 
				 106  3747 
				 108  3743 
				 111  3740 
				 108  3734 
				 108  3731 
				 108  3725 
				 102  3717 
				 104  3710 
				 107  3703 
				 104  3695 
				 101  3685 
				 101  3679 
				 103  3676 
				 108  3673 
				 112  3670 
				 118  3664 
				 124  3655 
				 122  3630 
				 120  3580 
				 126  3515 
				 138  3429>;
};
