/*************************
 * Customized Battery Setting dtsi file
*************************/
&bat_comm {
	gpio22_dc_det = <&pio 22 0>;
	gpio85_set_chr_set = <&pio 85 0>;
	gpio28_spec_cur_select = <&pio 28 0>;
	/* cust_charging.h */
	/* stop charging while in talking mode */
	stop_charging_in_takling = <1>;
	talking_recharge_voltage = <3800>;
	talking_sync_time = <60>;

	/* Battery Temperature Protection */
	mtk_temperature_recharge_support = <1>;
	max_charge_temperature = <50>;
	max_charge_temperature_minus_x_degree = <47>;
	min_charge_temperature = <0>;
	min_charge_temperature_plus_x_degree = <6>;
	err_charge_temperature = <0xff>;

	/* Linear Charging Threshold */
	v_pre2cc_thres = <3400>;	/* unit: mV */
	v_cc2topoff_thres = <4050>;
	recharging_voltage = <4110>;
	charging_full_current = <80>;	/* unit: mA */

	/* Charging Current Setting */
	config_usb_if = <0>;
	usb_charger_current_suspend = <0>;	/* Unit: 0.01 mA */
	usb_charger_current_unconfigured = <7000>;	/* Unit: 0.01 mA */
	usb_charger_current_configured = <50000>;	/* Unit: 0.01 mA */
	usb_charger_current = <120000>;	/* Unit: 0.01 mA */
	ac_charger_current = <120000>;	/* Unit: 0.01 mA */
	non_std_ac_charger_current = <50000>;	/* Unit: 0.01 mA */
	charging_host_charger_current = <65000>;	/* Unit: 0.01 mA */
	apple_0_5a_charger_current = <50000>;	/* Unit: 0.01 mA */
	apple_1_0a_charger_current = <65000>;	/* Unit: 0.01 mA */
	apple_2_1a_charger_current = <80000>;	/* Unit: 0.01 mA */

	/* charger error check */
	bat_low_temp_protect_enable = <0>;
	v_charger_enable = <0>;	/* 1:on , 0:off */
	v_charger_max = <6500>;	/* unit: mV */
	v_charger_min = <4400>;

	/*  Tracking TIME */
	onehundred_percent_tracking_time = <1800>;	/* Unit: second */
	npercent_tracking_time = <200>;	/* Unit: second */
	sync_to_real_tracking_time = <300>;	/* Unit: second */
	v_0percent_tracking = <3470>;	/* Unit: mV */

	/* High battery support */
	high_battery_voltage_support = <0>;
};

&bat_meter {
	/* cust_battery_meter.h */
	/* ADC resistor  */
	r_bat_sense = <4>;
	r_i_sense = <4>;
	r_charger_1 = <330>;
	r_charger_2 = <39>;
	temperature_t0 = <110>;
	temperature_t1 = <0>;
	temperature_t2 = <25>;
	temperature_t3 = <50>;
	temperature_t = <255>;	/* this should be fixed, never change the value */
	fg_meter_resistance = <0>;

	/* Qmax for 0mA */
	q_max_pos_50 = <5467>;
	q_max_pos_25 = <5467>;
	q_max_pos_0 = <5467>;
	q_max_neg_10 = <5467>;
	/* Qmax for 600mA, said high current */
	q_max_pos_50_h_current = <5310>;
	q_max_pos_25_h_current = <5310>;
	q_max_pos_0_h_current = <5310>;
	q_max_neg_10_h_current = <5310>;
	/* Discharge percentage, 1: D5, 0: D2 */
	oam_d5 = <1>;

	change_tracking_point = <1>;
	/* SW OCV tracking setting */
	cust_tracking_point = <14>;
	cust_r_sense = <200>;
	cust_hw_cc = <0>;
	aging_tuning_value = <100>;
	cust_r_fg_offset = <0>;
	ocv_board_compesate = <0>;
	r_fg_board_base = <1000>;
	r_fg_board_slope = <1000>;
	car_tune_value = <89>;

	/* HW Fuel gague  */
	current_detect_r_fg = <10>;	/* Unit: mA */
	minerroroffset = <1000>;
	fg_vbat_average_size = <18>;
	r_fg_value = <20>;	/* Unit: mOhm */

	cust_poweron_delta_capacity_tolrance = <80>;
	cust_poweron_low_capacity_tolrance = <0>;
	cust_poweron_max_vbat_tolrance = <70>;
	cust_poweron_delta_vbat_tolrance = <60>;
	cust_poweron_delta_hw_sw_ocv_capacity_tolrance = <10>;

	/* Fixed battery temperature */
	fixed_tbat_25 = <1>;
	/* Dynamic change wake up period of battery thread when suspend */
	vbat_normal_wakeup = <3600>;	/* Unit: mV */
	vbat_low_power_wakeup = <3500>;	/* Unit: mV */
	normal_wakeup_period = <5400>;	/* Unit: second */
	low_power_wakeup_period = <300>;	/* Unit: second */
	close_poweroff_wakeup_period = <30>;	/* Unit: second */

	rbat_pull_up_r = <16900>;
	rbat_pull_up_volt = <1800>;

	batt_temperature_table_num = <17>;
	batt_temperature_table = <
			    (-20) 75022
			    (-15) 57926
			    (-10) 45168
			    (-5) 35548
			    0 28224
			    5 22595
			    10 18231
			    15 14820
			    20 12133
			    25 10000 30 8295 35 6922 40 5810 45 4903 50 4160 55 3547 60 3039>;

	battery_profile_t0_num = <78>;
	battery_profile_t0 = <
	    0  	4169 
			1  	4152
			3  	4138
			4  	4124
			5  	4112
			7  	4100
			8  	4088
			9  	4079
			11 	4070
			12 	4060
			13 	4048
			14 	4035
			16 	4022
			17 	4011
			18 	4000
			20 	3992
			21 	3984
			22 	3978
			24 	3971
			25 	3963
			26 	3955
			28 	3947
			29 	3939
			30 	3932
			32 	3926
			33 	3918
			34 	3911
			36 	3905
			37 	3899
			38 	3890
			40 	3883
			41 	3875
			42 	3866
			43 	3857
			45 	3847
			46 	3839
			47 	3832
			49 	3825
			50 	3819
			51 	3814
			53 	3810
			54 	3806
			55 	3802
			57 	3799
			58 	3795
			59 	3792
			61 	3789
			62 	3787
			63 	3785
			65 	3783
			66 	3780
			67 	3778
			68 	3777
      70  3774
      71  3774
      72  3771
      74  3768
      75  3765
      76  3761
      78  3758
      79  3752
      80  3747
      82  3743
      83  3739
      84  3734
      86  3728
      87  3721
      88  3713
      90  3705
      91  3695
      92  3688
      94  3687
      95  3685
      96  3682
      97  3676
      99  3650
      100 3596
      101 3519
          >;

	battery_profile_t1_num = <78>;
	battery_profile_t1 = <
			    0  	4169   
					1  	4152  
					3  	4138  
					4  	4124  
					5  	4112  
					7  	4100  
					8  	4088  
					9  	4079  
					11 	4070  
					12 	4060  
					13 	4048  
					14 	4035  
					16 	4022  
					17 	4011  
					18 	4000  
					20 	3992  
					21 	3984  
					22 	3978  
					24 	3971  
					25 	3963  
					26 	3955  
					28 	3947  
					29 	3939  
					30 	3932  
					32 	3926  
					33 	3918  
					34 	3911  
					36 	3905  
					37 	3899  
					38 	3890  
					40 	3883  
					41 	3875  
					42 	3866  
					43 	3857  
					45 	3847  
					46 	3839  
					47 	3832  
					49 	3825  
					50 	3819  
					51 	3814  
					53 	3810  
					54 	3806  
					55 	3802  
					57 	3799  
					58 	3795  
					59 	3792  
					61 	3789  
					62 	3787  
					63 	3785  
					65 	3783  
					66 	3780  
					67 	3778  
					68 	3777  
          70  3774  
          71  3774  
          72  3771  
          74  3768  
          75  3765  
          76  3761  
          78  3758  
          79  3752  
          80  3747  
          82  3743  
          83  3739  
          84  3734  
          86  3728  
          87  3721  
          88  3713  
          90  3705  
          91  3695  
          92  3688  
          94  3687  
          95  3685  
          96  3682  
          97  3676  
          99  3650  
          100 3596  
          101 3519  >;

	battery_profile_t2_num = <78>;
	battery_profile_t2 = <
			    0  	4169  
					1  	4152 
					3  	4138 
					4  	4124 
					5  	4112 
					7  	4100 
					8  	4088 
					9  	4079 
					11 	4070 
					12 	4060 
					13 	4048 
					14 	4035 
					16 	4022 
					17 	4011 
					18 	4000 
					20 	3992 
					21 	3984 
					22 	3978 
					24 	3971 
					25 	3963 
					26 	3955 
					28 	3947 
					29 	3939 
					30 	3932 
					32 	3926 
					33 	3918 
					34 	3911 
					36 	3905 
					37 	3899 
					38 	3890 
					40 	3883 
					41 	3875 
					42 	3866 
					43 	3857 
					45 	3847 
					46 	3839 
					47 	3832 
					49 	3825 
					50 	3819 
					51 	3814 
					53 	3810 
					54 	3806 
					55 	3802 
					57 	3799 
					58 	3795 
					59 	3792 
					61 	3789 
					62 	3787 
					63 	3785 
					65 	3783 
					66 	3780 
					67 	3778 
					68 	3777 
          70  3774 
          71  3774 
          72  3771 
          74  3768 
          75  3765 
          76  3761 
          78  3758 
          79  3752 
          80  3747 
          82  3743 
          83  3739 
          84  3734 
          86  3728 
          87  3721 
          88  3713 
          90  3705 
          91  3695 
          92  3688 
          94  3687 
          95  3685 
          96  3682 
          97  3676 
          99  3650 
          100 3596 
          101 3519 >;
  
   
	battery_profile_t3_num = <78>;
	battery_profile_t3 = <
				    0  	4169  
						1  	4152 
						3  	4138 
						4  	4124 
						5  	4112 
						7  	4100 
						8  	4088 
						9  	4079 
						11 	4070 
						12 	4060 
						13 	4048 
						14 	4035 
						16 	4022 
						17 	4011 
						18 	4000 
						20 	3992 
						21 	3984 
						22 	3978 
						24 	3971 
						25 	3963 
						26 	3955 
						28 	3947 
						29 	3939 
						30 	3932 
						32 	3926 
						33 	3918 
						34 	3911 
						36 	3905 
						37 	3899 
						38 	3890 
						40 	3883 
						41 	3875 
						42 	3866 
						43 	3857 
						45 	3847 
						46 	3839 
						47 	3832 
						49 	3825 
						50 	3819 
						51 	3814 
						53 	3810 
						54 	3806 
						55 	3802 
						57 	3799 
						58 	3795 
						59 	3792 
						61 	3789 
						62 	3787 
						63 	3785 
						65 	3783 
						66 	3780 
						67 	3778 
						68 	3777 
            70  3774 
            71  3774 
            72  3771 
            74  3768 
            75  3765 
            76  3761 
            78  3758 
            79  3752 
            80  3747 
            82  3743 
            83  3739 
            84  3734 
            86  3728 
            87  3721 
            88  3713 
            90  3705 
            91  3695 
            92  3688 
            94  3687 
            95  3685 
            96  3682 
            97  3676 
            99  3650 
            100 3596 
            101 3519 >;



	r_profile_t0_num = <78>;
	r_profile_t0 = <				
				70	  4169
				70	  4152
				70	  4138
				70	  4124
				70	  4112
				70	  4100
				70	  4088
				70	  4079
				70	  4070
				70	  4060
				70	  4048
				70	  4035
				70    4022
				70	  4011
				70	  4000
				70	  3992
				70	  3984
				70	  3978
				70	  3971
				70	  3963
				70	  3955
				70	  3947
				70	  3939
				70	  3932
				70	  3926
				70	  3918
				70	  3911
				70	  3905
				70	  3899
				70	  3890
				70	  3883
				70	  3875
				70	  3866
				70	  3857
				70	  3847
				70	  3839
				70	  3832
				70	  3825
				70	  3819
				70	  3814
				70	  3810
				70	  3806
				70	  3802
				70	  3799
				70	  3795
				70	  3792
				70	  3789
				70	  3787
				70	  3785
				70	  3783
				70	  3780
        70	  3778
        70	  3777
        70	  3774
        70	  3774
        70	  3771
        70	  3768
        70	  3765
        70	  3761
        70	  3758
        70	  3752
        70	  3747
        70	  3743
        70	  3739
        70	  3734
        70	  3728
        70	  3721
        70	  3713
        70	  3705
        70	  3695
        70	  3688
        70	  3687
        70	  3685
        70	  3682
        70	  3676
        70	  3650
        70	  3596
        70	  3519
          >;
        
	r_profile_t1_num = <78>;
	r_profile_t1 = <
				70	  4169   
				70	  4152   
				70	  4138   
				70	  4124   
				70	  4112   
				70	  4100   
				70	  4088   
				70	  4079   
				70	  4070   
				70	  4060   
				70	  4048   
				70	  4035   
				70    4022   
				70	  4011   
				70	  4000   
				70	  3992   
				70	  3984   
				70	  3978   
				70	  3971   
				70	  3963   
				70	  3955   
				70	  3947   
				70	  3939   
				70	  3932   
				70	  3926   
				70	  3918   
				70	  3911   
				70	  3905   
				70	  3899   
				70	  3890   
				70	  3883   
				70	  3875   
				70	  3866   
				70	  3857   
				70	  3847   
				70	  3839   
				70	  3832   
				70	  3825   
				70	  3819   
				70	  3814   
				70	  3810   
				70	  3806   
				70	  3802   
				70	  3799   
				70	  3795   
				70	  3792   
				70	  3789   
				70	  3787   
				70	  3785   
				70	  3783   
				70	  3780   
				70	  3778   
				70	  3777   
        70	  3774   
        70	  3774   
        70	  3771   
        70	  3768   
        70	  3765   
        70	  3761   
        70	  3758   
        70	  3752   
        70	  3747   
        70	  3743   
        70	  3739   
        70	  3734   
        70	  3728   
        70	  3721   
        70	  3713   
        70	  3705   
        70	  3695   
        70	  3688   
        70	  3687   
        70	  3685   
        70	  3682   
        70	  3676   
        70	  3650   
        70	  3596   
        70	  3519   
        
        
        
        
        >;
 
 
 
	r_profile_t2_num = <78>;
	r_profile_t2 = <
				70	  4169   
				70	  4152   
				70	  4138   
				70	  4124   
				70	  4112   
				70	  4100   
				70	  4088   
				70	  4079   
				70	  4070   
				70	  4060   
				70	  4048   
				70	  4035   
				70    4022   
				70	  4011   
				70	  4000   
				70	  3992   
				70	  3984   
				70	  3978   
				70	  3971   
				70	  3963   
				70	  3955   
				70	  3947   
				70	  3939   
				70	  3932   
				70	  3926   
				70	  3918   
				70	  3911   
				70	  3905   
				70	  3899   
				70	  3890   
				70	  3883   
				70	  3875   
				70	  3866   
				70	  3857   
				70	  3847   
				70	  3839   
				70	  3832   
				70	  3825   
				70	  3819   
				70	  3814   
				70	  3810   
				70	  3806   
				70	  3802   
				70	  3799   
				70	  3795   
				70	  3792   
				70	  3789   
				70	  3787   
				70	  3785   
				70	  3783   
				70	  3780   
				70	  3778   
				70	  3777   
        70	  3774   
        70	  3774   
        70	  3771   
        70	  3768   
        70	  3765   
        70	  3761   
        70	  3758   
        70	  3752   
        70	  3747   
        70	  3743   
        70	  3739   
        70	  3734   
        70	  3728   
        70	  3721   
        70	  3713   
        70	  3705   
        70	  3695   
        70	  3688   
        70	  3687   
        70	  3685   
        70	  3682   
        70	  3676   
        70	  3650   
        70	  3596   
        70	  3519   
        >;
  
  
  
  
	r_profile_t3_num = <78>;
	r_profile_t3 = <
				70	  4169   
				70	  4152   
				70	  4138   
				70	  4124   
				70	  4112   
				70	  4100   
				70	  4088   
				70	  4079   
				70	  4070   
				70	  4060   
				70	  4048   
				70	  4035   
				70    4022   
				70	  4011   
				70	  4000   
				70	  3992   
				70	  3984   
				70	  3978   
				70	  3971   
				70	  3963   
				70	  3955   
				70	  3947   
				70	  3939   
				70	  3932   
				70	  3926   
				70	  3918   
				70	  3911   
				70	  3905   
				70	  3899   
				70	  3890   
				70	  3883   
				70	  3875   
				70	  3866   
				70	  3857   
				70	  3847   
				70	  3839   
				70	  3832   
				70	  3825   
				70	  3819   
				70	  3814   
				70	  3810   
				70	  3806   
				70	  3802   
				70	  3799   
				70	  3795   
				70	  3792   
				70	  3789   
				70	  3787   
				70	  3785   
				70	  3783   
				70	  3780   
				70	  3778   
				70	  3777      
				70	  3774   
				70	  3774   
				70	  3771   
				70	  3768   
				70	  3765   
				70	  3761   
				70	  3758   
				70	  3752   
				70	  3747   
				70	  3743   
				70	  3739   
				70	  3734   
				70	  3728   
				70	  3721   
				70	  3713   
				70	  3705   
				70	  3695   
				70	  3688   
				70	  3687   
				70	  3685   
				70	  3682   
				70	  3676   
				70	  3650   
				70	  3596   
				70	  3519   
				>;				
};
