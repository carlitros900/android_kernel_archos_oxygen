/*************************
 * Customized Battery Setting dtsi file
*************************/
&bat_comm {
	gpio22_dc_det = <&pio 22 0>;
	gpio85_set_chr_set = <&pio 85 0>;
	gpio28_spec_cur_select = <&pio 28 0>;
	/* cust_charging.h */
	/* stop charging while in talking mode */
	stop_charging_in_takling = <1>;
	talking_recharge_voltage = <3800>;
	talking_sync_time = <60>;

	/* Battery Temperature Protection */
	mtk_temperature_recharge_support = <1>;
	max_charge_temperature = <50>;
	max_charge_temperature_minus_x_degree = <47>;
	min_charge_temperature = <0>;
	min_charge_temperature_plus_x_degree = <6>;
	err_charge_temperature = <0xff>;

	/* Linear Charging Threshold */
	v_pre2cc_thres = <3400>;	/* unit: mV */
	v_cc2topoff_thres = <4050>;
	recharging_voltage = <4110>;
	charging_full_current = <80>;	/* unit: mA */

	/* Charging Current Setting */
	config_usb_if = <0>;
	usb_charger_current_suspend = <0>;	/* Unit: 0.01 mA */
	usb_charger_current_unconfigured = <7000>;	/* Unit: 0.01 mA */
	usb_charger_current_configured = <50000>;	/* Unit: 0.01 mA */
	usb_charger_current = <120000>;	/* Unit: 0.01 mA */
	ac_charger_current = <120000>;	/* Unit: 0.01 mA */
	non_std_ac_charger_current = <50000>;	/* Unit: 0.01 mA */
	charging_host_charger_current = <65000>;	/* Unit: 0.01 mA */
	apple_0_5a_charger_current = <50000>;	/* Unit: 0.01 mA */
	apple_1_0a_charger_current = <65000>;	/* Unit: 0.01 mA */
	apple_2_1a_charger_current = <80000>;	/* Unit: 0.01 mA */

	/* charger error check */
	bat_low_temp_protect_enable = <0>;
	v_charger_enable = <0>;	/* 1:on , 0:off */
	v_charger_max = <6500>;	/* unit: mV */
	v_charger_min = <4400>;

	/*  Tracking TIME */
	onehundred_percent_tracking_time = <1800>;	/* Unit: second */
	npercent_tracking_time = <200>;	/* Unit: second */
	sync_to_real_tracking_time = <300>;	/* Unit: second */
	v_0percent_tracking = <3470>;	/* Unit: mV */

	/* High battery support */
	high_battery_voltage_support = <0>;
};

&bat_meter {
	/* cust_battery_meter.h */
	/* ADC resistor  */
	r_bat_sense = <4>;
	r_i_sense = <4>;
	r_charger_1 = <330>;
	r_charger_2 = <39>;
	temperature_t0 = <110>;
	temperature_t1 = <0>;
	temperature_t2 = <25>;
	temperature_t3 = <50>;
	temperature_t = <255>;	/* this should be fixed, never change the value */
	fg_meter_resistance = <0>;

	/* Qmax for 0mA */
	q_max_pos_50 = <5572>;
	q_max_pos_25 = <5572>;
	q_max_pos_0 = <5572>;
	q_max_neg_10 = <5572>;
	/* Qmax for 600mA, said high current */
	q_max_pos_50_h_current = <5442>;
	q_max_pos_25_h_current = <5442>;
	q_max_pos_0_h_current = <5442>;
	q_max_neg_10_h_current = <5442>;
	/* Discharge percentage, 1: D5, 0: D2 */
	oam_d5 = <1>;

	change_tracking_point = <1>;
	/* SW OCV tracking setting */
	cust_tracking_point = <14>;
	cust_r_sense = <200>;
	cust_hw_cc = <0>;
	aging_tuning_value = <100>;
	cust_r_fg_offset = <0>;
	ocv_board_compesate = <0>;
	r_fg_board_base = <1000>;
	r_fg_board_slope = <1000>;
	car_tune_value = <89>;

	/* HW Fuel gague  */
	current_detect_r_fg = <10>;	/* Unit: mA */
	minerroroffset = <1000>;
	fg_vbat_average_size = <18>;
	r_fg_value = <20>;	/* Unit: mOhm */

	cust_poweron_delta_capacity_tolrance = <80>;
	cust_poweron_low_capacity_tolrance = <0>;
	cust_poweron_max_vbat_tolrance = <70>;
	cust_poweron_delta_vbat_tolrance = <60>;
	cust_poweron_delta_hw_sw_ocv_capacity_tolrance = <10>;

	/* Fixed battery temperature */
	fixed_tbat_25 = <1>;
	/* Dynamic change wake up period of battery thread when suspend */
	vbat_normal_wakeup = <3600>;	/* Unit: mV */
	vbat_low_power_wakeup = <3500>;	/* Unit: mV */
	normal_wakeup_period = <5400>;	/* Unit: second */
	low_power_wakeup_period = <300>;	/* Unit: second */
	close_poweroff_wakeup_period = <30>;	/* Unit: second */

	rbat_pull_up_r = <16900>;
	rbat_pull_up_volt = <1800>;

	batt_temperature_table_num = <17>;
	batt_temperature_table = <
			    (-20) 75022
			    (-15) 57926
			    (-10) 45168
			    (-5) 35548
			    0 28224
			    5 22595
			    10 18231
			    15 14820
			    20 12133
			    25 10000 30 8295 35 6922 40 5810 45 4903 50 4160 55 3547 60 3039>;

	battery_profile_t0_num = <79>;
	battery_profile_t0 = <
			0		4189
			1		4169
			3		4152
			4		4137
			5		4124
			6		4111
			8		4099
			9		4088
			10		4078
			12		4070
			13		4060
			14		4048
			16		4034
			17		4021
			18		4010
			19		4000
			21		3992
			22		3985
			23		3978
			25		3971
			26		3964
			27		3956
			29		3948
			30		3941
			31		3934
			32		3926
			34		3919
			35		3912
			36		3906
			38		3899
			39		3892
			40		3885
			42		3877
			43		3869
			44		3859
			45		3850
			47		3842
			48		3834
			49		3828
			51		3822
			52		3817
			53		3813
			55		3808
			56		3804
			57		3801
			58		3798
			60		3795
			61		3792
			62		3789
			64		3787
			65		3784
			66		3782
			68		3780
			69		3778
			70		3776
			71		3775
			73		3773
			74		3771
			75		3768
			77		3765
			78		3761
			79		3756
			81		3751
			82		3747
			83		3742
			84		3738
			86		3732
			87		3725
			88		3718
			90		3710
			91		3701
			92		3692
			94		3690
			95		3688
			96		3686
			97		3682
			99		3669
			100		3626
			101		3560
>;

	battery_profile_t1_num = <79>;
	battery_profile_t1 = <
			0		4189
			1		4169
			3		4152
			4		4137
			5		4124
			6		4111
			8		4099
			9		4088
			10		4078
			12		4070
			13		4060
			14		4048
			16		4034
			17		4021
			18		4010
			19		4000
			21		3992
			22		3985
			23		3978
			25		3971
			26		3964
			27		3956
			29		3948
			30		3941
			31		3934
			32		3926
			34		3919
			35		3912
			36		3906
			38		3899
			39		3892
			40		3885
			42		3877
			43		3869
			44		3859
			45		3850
			47		3842
			48		3834
			49		3828
			51		3822
			52		3817
			53		3813
			55		3808
			56		3804
			57		3801
			58		3798
			60		3795
			61		3792
			62		3789
			64		3787
			65		3784
			66		3782
			68		3780
			69		3778
			70		3776
			71		3775
			73		3773
			74		3771
			75		3768
			77		3765
			78		3761
			79		3756
			81		3751
			82		3747
			83		3742
			84		3738
			86		3732
			87		3725
			88		3718
			90		3710
			91		3701
			92		3692
			94		3690
			95		3688
			96		3686
			97		3682
			99		3669
			100		3626
			101		3560>;

	battery_profile_t2_num = <79>;
	battery_profile_t2 = <	
			0		4189
			1		4169
			3		4152
			4		4137
			5		4124
			6		4111
			8		4099
			9		4088
			10		4078
			12		4070
			13		4060
			14		4048
			16		4034
			17		4021
			18		4010
			19		4000
			21		3992
			22		3985
			23		3978
			25		3971
			26		3964
			27		3956
			29		3948
			30		3941
			31		3934
			32		3926
			34		3919
			35		3912
			36		3906
			38		3899
			39		3892
			40		3885
			42		3877
			43		3869
			44		3859
			45		3850
			47		3842
			48		3834
			49		3828
			51		3822
			52		3817
			53		3813
			55		3808
			56		3804
			57		3801
			58		3798
			60		3795
			61		3792
			62		3789
			64		3787
			65		3784
			66		3782
			68		3780
			69		3778
			70		3776
			71		3775
			73		3773
			74		3771
			75		3768
			77		3765
			78		3761
			79		3756
			81		3751
			82		3747
			83		3742
			84		3738
			86		3732
			87		3725
			88		3718
			90		3710
			91		3701
			92		3692
			94		3690
			95		3688
			96		3686
			97		3682
			99		3669
			100		3626
			101		3560>;
  
   
	battery_profile_t3_num = <79>;
	battery_profile_t3 = <			
			0		4189
			1		4169
			3		4152
			4		4137
			5		4124
			6		4111
			8		4099
			9		4088
			10		4078
			12		4070
			13		4060
			14		4048
			16		4034
			17		4021
			18		4010
			19		4000
			21		3992
			22		3985
			23		3978
			25		3971
			26		3964
			27		3956
			29		3948
			30		3941
			31		3934
			32		3926
			34		3919
			35		3912
			36		3906
			38		3899
			39		3892
			40		3885
			42		3877
			43		3869
			44		3859
			45		3850
			47		3842
			48		3834
			49		3828
			51		3822
			52		3817
			53		3813
			55		3808
			56		3804
			57		3801
			58		3798
			60		3795
			61		3792
			62		3789
			64		3787
			65		3784
			66		3782
			68		3780
			69		3778
			70		3776
			71		3775
			73		3773
			74		3771
			75		3768
			77		3765
			78		3761
			79		3756
			81		3751
			82		3747
			83		3742
			84		3738
			86		3732
			87		3725
			88		3718
			90		3710
			91		3701
			92		3692
			94		3690
			95		3688
			96		3686
			97		3682
			99		3669
			100		3626
			101		3560>;



	r_profile_t0_num = <79>;
	r_profile_t0 = <				
			106	4189
			106	4169
			106	4152
			106	4137
			106	4124
			106	4111
			106	4099
			106	4088
			106	4078
			106	4070
			106	4060
			106	4048
			106	4034
			106	4021
			106	4010
			106	4000
			106	3992
			106	3985
			106	3978
			106	3971
			106	3964
			106	3956
			106	3948
			106	3941
			106	3934
			106	3926
			106	3919
			106	3912
			106	3906
			106	3899
			106	3892
			106	3885
			106	3877
			106	3869
			106	3859
			106	3850
			106	3842
			106	3834
			106	3828
			106	3822
			106	3817
			106	3813
			106	3808
			106	3804
			106	3801
			106	3798
			106	3795
			106	3792
			106	3789
			106	3787
			106	3784
			106	3782
			106	3780
			106	3778
			106	3776
			106	3775
			106	3773
			106	3771
			106	3768
			106	3765
			106	3761
			106	3756
			106	3751
			106	3747
			106	3742
			106	3738
			106	3732
			106	3725
			106	3718
			106	3710
			106	3701
			106	3692
			106	3690
			106	3688
			106	3686
			106	3682
			106	3669
			106	3626
			106	3560
			>;
        
	r_profile_t1_num = <79>;
	r_profile_t1 = <
	106	4189
	106	4169
	106	4152
	106	4137
	106	4124
	106	4111
	106	4099
	106	4088
	106	4078
	106	4070
	106	4060
	106	4048
	106	4034
	106	4021
	106	4010
	106	4000
	106	3992
	106	3985
	106	3978
	106	3971
	106	3964
	106	3956
	106	3948
	106	3941
	106	3934
	106	3926
	106	3919
	106	3912
	106	3906
	106	3899
	106	3892
	106	3885
	106	3877
	106	3869
	106	3859
	106	3850
	106	3842
	106	3834
	106	3828
	106	3822
	106	3817
	106	3813
	106	3808
	106	3804
	106	3801
	106	3798
	106	3795
	106	3792
	106	3789
	106	3787
	106	3784
	106	3782
	106	3780
	106	3778
	106	3776
	106	3775
	106	3773
	106	3771
	106	3768
	106	3765
	106	3761
	106	3756
	106	3751
	106	3747
	106	3742
	106	3738
	106	3732
	106	3725
	106	3718
	106	3710
	106	3701
	106	3692
	106	3690
	106	3688
	106	3686
	106	3682
	106	3669
	106	3626
	106	3560
>;
 
 
 
	r_profile_t2_num = <79>;
	r_profile_t2 = <
	106	4189
	106	4169
	106	4152
	106	4137
	106	4124
	106	4111
	106	4099
	106	4088
	106	4078
	106	4070
	106	4060
	106	4048
	106	4034
	106	4021
	106	4010
	106	4000
	106	3992
	106	3985
	106	3978
	106	3971
	106	3964
	106	3956
	106	3948
	106	3941
	106	3934
	106	3926
	106	3919
	106	3912
	106	3906
	106	3899
	106	3892
	106	3885
	106	3877
	106	3869
	106	3859
	106	3850
	106	3842
	106	3834
	106	3828
	106	3822
	106	3817
	106	3813
	106	3808
	106	3804
	106	3801
	106	3798
	106	3795
	106	3792
	106	3789
	106	3787
	106	3784
	106	3782
	106	3780
	106	3778
	106	3776
	106	3775
	106	3773
	106	3771
	106	3768
	106	3765
	106	3761
	106	3756
	106	3751
	106	3747
	106	3742
	106	3738
	106	3732
	106	3725
	106	3718
	106	3710
	106	3701
	106	3692
	106	3690
	106	3688
	106	3686
	106	3682
	106	3669
	106	3626
	106	3560
>;
  
  
  
  
	r_profile_t3_num = <79>;
	r_profile_t3 = <
	106	4189
	106	4169
	106	4152
	106	4137
	106	4124
	106	4111
	106	4099
	106	4088
	106	4078
	106	4070
	106	4060
	106	4048
	106	4034
	106	4021
	106	4010
	106	4000
	106	3992
	106	3985
	106	3978
	106	3971
	106	3964
	106	3956
	106	3948
	106	3941
	106	3934
	106	3926
	106	3919
	106	3912
	106	3906
	106	3899
	106	3892
	106	3885
	106	3877
	106	3869
	106	3859
	106	3850
	106	3842
	106	3834
	106	3828
	106	3822
	106	3817
	106	3813
	106	3808
	106	3804
	106	3801
	106	3798
	106	3795
	106	3792
	106	3789
	106	3787
	106	3784
	106	3782
	106	3780
	106	3778
	106	3776
	106	3775
	106	3773
	106	3771
	106	3768
	106	3765
	106	3761
	106	3756
	106	3751
	106	3747
	106	3742
	106	3738
	106	3732
	106	3725
	106	3718
	106	3710
	106	3701
	106	3692
	106	3690
	106	3688
	106	3686
	106	3682
	106	3669
	106	3626
	106	3560
>;				
};
