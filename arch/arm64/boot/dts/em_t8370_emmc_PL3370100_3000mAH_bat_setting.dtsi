/*************************
 * Customized Battery Setting dtsi file
*************************/
&bat_comm {
	gpio22_dc_det = <&pio 22 0>;
	gpio85_set_chr_set = <&pio 85 0>;
	gpio28_spec_cur_select = <&pio 28 0>;
	/* cust_charging.h */
	/* stop charging while in talking mode */
	stop_charging_in_takling = <1>;
	talking_recharge_voltage = <3800>;
	talking_sync_time = <60>;

	/* Battery Temperature Protection */
	mtk_temperature_recharge_support = <1>;
	max_charge_temperature = <50>;
	max_charge_temperature_minus_x_degree = <47>;
	min_charge_temperature = <0>;
	min_charge_temperature_plus_x_degree = <6>;
	err_charge_temperature = <0xff>;

	/* Linear Charging Threshold */
	v_pre2cc_thres = <3400>;	/* unit: mV */
	v_cc2topoff_thres = <4050>;
	recharging_voltage = <4110>;
	charging_full_current = <80>;	/* unit: mA */

	/* Charging Current Setting */
	config_usb_if = <0>;
	usb_charger_current_suspend = <0>;	/* Unit: 0.01 mA */
	usb_charger_current_unconfigured = <7000>;	/* Unit: 0.01 mA */
	usb_charger_current_configured = <50000>;	/* Unit: 0.01 mA */
	usb_charger_current = <50000>;	/* Unit: 0.01 mA */
	ac_charger_current = <120000>;	/* Unit: 0.01 mA */
	non_std_ac_charger_current = <50000>;	/* Unit: 0.01 mA */
	charging_host_charger_current = <65000>;	/* Unit: 0.01 mA */
	apple_0_5a_charger_current = <50000>;	/* Unit: 0.01 mA */
	apple_1_0a_charger_current = <65000>;	/* Unit: 0.01 mA */
	apple_2_1a_charger_current = <80000>;	/* Unit: 0.01 mA */

	/* charger error check */
	bat_low_temp_protect_enable = <0>;
	v_charger_enable = <0>;	/* 1:on , 0:off */
	v_charger_max = <6500>;	/* unit: mV */
	v_charger_min = <4400>;

	/*  Tracking TIME */
	onehundred_percent_tracking_time = <10>;	/* Unit: second */
	npercent_tracking_time = <20>;	/* Unit: second */
	sync_to_real_tracking_time = <60>;	/* Unit: second */
	v_0percent_tracking = <3450>;	/* Unit: mV */

	/* High battery support */
	high_battery_voltage_support = <0>;
};

&bat_meter {
	/* cust_battery_meter.h */
	/* ADC resistor  */
	r_bat_sense = <4>;
	r_i_sense = <4>;
	r_charger_1 = <330>;
	r_charger_2 = <39>;
	temperature_t0 = <110>;
	temperature_t1 = <0>;
	temperature_t2 = <25>;
	temperature_t3 = <50>;
	temperature_t = <255>;	/* this should be fixed, never change the value */
	fg_meter_resistance = <0>;

	/* Qmax for 0mA */
	q_max_pos_50 = <2918>;
	q_max_pos_25 = <2918>;
	q_max_pos_0 = <2918>;
	q_max_neg_10 = <2918>;
	/* Qmax for 600mA, said high current */
	q_max_pos_50_h_current = <2852>;
	q_max_pos_25_h_current = <2852>;
	q_max_pos_0_h_current = <2852>;
	q_max_neg_10_h_current = <2852>;
	/* Discharge percentage, 1: D5, 0: D2 */
	oam_d5 = <1>;

	change_tracking_point = <1>;
	/* SW OCV tracking setting */
	cust_tracking_point = <14>;
	cust_r_sense = <200>;
	cust_hw_cc = <0>;
	aging_tuning_value = <100>;
	cust_r_fg_offset = <0>;
	ocv_board_compesate = <0>;
	r_fg_board_base = <1000>;
	r_fg_board_slope = <1000>;
	car_tune_value = <89>;

	/* HW Fuel gague  */
	current_detect_r_fg = <10>;	/* Unit: mA */
	minerroroffset = <1000>;
	fg_vbat_average_size = <18>;
	r_fg_value = <10>;	/* Unit: mOhm */

	cust_poweron_delta_capacity_tolrance = <80>;
	cust_poweron_low_capacity_tolrance = <5>;
	cust_poweron_max_vbat_tolrance = <70>;
	cust_poweron_delta_vbat_tolrance = <60>;
	cust_poweron_delta_hw_sw_ocv_capacity_tolrance = <10>;

	/* Fixed battery temperature */
	fixed_tbat_25 = <1>;
	/* Dynamic change wake up period of battery thread when suspend */
	vbat_normal_wakeup = <3600>;	/* Unit: mV */
	vbat_low_power_wakeup = <3500>;	/* Unit: mV */
	normal_wakeup_period = <5400>;	/* Unit: second */
	low_power_wakeup_period = <300>;	/* Unit: second */
	close_poweroff_wakeup_period = <30>;	/* Unit: second */

	rbat_pull_up_r = <16900>;
	rbat_pull_up_volt = <1800>;

	batt_temperature_table_num = <17>;
	batt_temperature_table = <
			    (-20) 75022
			    (-15) 57926
			    (-10) 45168
			    (-5) 35548
			    0 28224
			    5 22595
			    10 18231
			    15 14820
			    20 12133
			    25 10000 30 8295 35 6922 40 5810 45 4903 50 4160 55 3547 60 3039>;

	battery_profile_t0_num = <84>;
	battery_profile_t0 = <
		0	4188
		1	4166	
		2	4148	
		4	4134	
		5	4121	
		6	4109	
		7	4097	
		9	4087	
		10	4079	
		11	4073	
		12	4064	
		14	4052	
		15	4037	
		16	4023	
		17	4011	
		19	4002	
		20	3994	
		21	3987	
		22	3980	
		23	3974	
		25	3968	
		26	3962	
		27	3955	
		28	3948	
		30	3941	
		31	3934	
		32	3927	
		33	3920	
		35	3914	
		36	3907	
		37	3900	
		38	3893	
		39	3886	
		41	3878	
		42	3870	
		43	3861	
		44	3853	
		46	3845	
		47	3838	
		48	3831	
		49	3826	
		51	3821	
		52	3817	
		53	3813	
		54	3809	
		56	3806	
		57	3802	
		58	3799	
		59	3797	
		60	3794	
		62	3791	
		63	3789	
		64	3787	
		65	3784	
		67	3782	
		68	3780	
		69	3779	
		70	3777	
		72	3775	
		73	3773	
		74	3770	
		75	3766	
		76	3762	
		78	3758	
		79	3754	
		80	3749	
		81	3746	
		83	3742	
		84	3738	
		85	3733	
		86	3726	
		88	3720	
		89	3714	
		90	3707	
		91	3697	
		93	3693	
		94	3691	
		95	3689	
		96	3687	
		97	3681	
		99	3655	
		100	3604	
		101	3535	
		102	3435	
				>;

	battery_profile_t1_num = <84>;
	battery_profile_t1 = <
		0	4188
		1	4166	
		2	4148	
		4	4134	
		5	4121	
		6	4109	
		7	4097	
		9	4087	
		10	4079	
		11	4073	
		12	4064	
		14	4052	
		15	4037	
		16	4023	
		17	4011	
		19	4002	
		20	3994	
		21	3987	
		22	3980	
		23	3974	
		25	3968	
		26	3962	
		27	3955	
		28	3948	
		30	3941	
		31	3934	
		32	3927	
		33	3920	
		35	3914	
		36	3907	
		37	3900	
		38	3893	
		39	3886	
		41	3878	
		42	3870	
		43	3861	
		44	3853	
		46	3845	
		47	3838	
		48	3831	
		49	3826	
		51	3821	
		52	3817	
		53	3813	
		54	3809	
		56	3806	
		57	3802	
		58	3799	
		59	3797	
		60	3794	
		62	3791	
		63	3789	
		64	3787	
		65	3784	
		67	3782	
		68	3780	
		69	3779	
		70	3777	
		72	3775	
		73	3773	
		74	3770	
		75	3766	
		76	3762	
		78	3758	
		79	3754	
		80	3749	
		81	3746	
		83	3742	
		84	3738	
		85	3733	
		86	3726	
		88	3720	
		89	3714	
		90	3707	
		91	3697	
		93	3693	
		94	3691	
		95	3689	
		96	3687	
		97	3681	
		99	3655	
		100	3604	
		101	3535	
		102	3435	
			>;

	battery_profile_t2_num = <84>;
	battery_profile_t2 = <
		0	4188
		1	4166	
		2	4148	
		4	4134	
		5	4121	
		6	4109	
		7	4097	
		9	4087	
		10	4079	
		11	4073	
		12	4064	
		14	4052	
		15	4037	
		16	4023	
		17	4011	
		19	4002	
		20	3994	
		21	3987	
		22	3980	
		23	3974	
		25	3968	
		26	3962	
		27	3955	
		28	3948	
		30	3941	
		31	3934	
		32	3927	
		33	3920	
		35	3914	
		36	3907	
		37	3900	
		38	3893	
		39	3886	
		41	3878	
		42	3870	
		43	3861	
		44	3853	
		46	3845	
		47	3838	
		48	3831	
		49	3826	
		51	3821	
		52	3817	
		53	3813	
		54	3809	
		56	3806	
		57	3802	
		58	3799	
		59	3797	
		60	3794	
		62	3791	
		63	3789	
		64	3787	
		65	3784	
		67	3782	
		68	3780	
		69	3779	
		70	3777	
		72	3775	
		73	3773	
		74	3770	
		75	3766	
		76	3762	
		78	3758	
		79	3754	
		80	3749	
		81	3746	
		83	3742	
		84	3738	
		85	3733	
		86	3726	
		88	3720	
		89	3714	
		90	3707	
		91	3697	
		93	3693	
		94	3691	
		95	3689	
		96	3687	
		97	3681	
		99	3655	
		100	3604	
		101	3535	
		102	3435	
				>;


	battery_profile_t3_num = <84>;
	battery_profile_t3 = <
		0	4188
		1	4166	
		2	4148	
		4	4134	
		5	4121	
		6	4109	
		7	4097	
		9	4087	
		10	4079	
		11	4073	
		12	4064	
		14	4052	
		15	4037	
		16	4023	
		17	4011	
		19	4002	
		20	3994	
		21	3987	
		22	3980	
		23	3974	
		25	3968	
		26	3962	
		27	3955	
		28	3948	
		30	3941	
		31	3934	
		32	3927	
		33	3920	
		35	3914	
		36	3907	
		37	3900	
		38	3893	
		39	3886	
		41	3878	
		42	3870	
		43	3861	
		44	3853	
		46	3845	
		47	3838	
		48	3831	
		49	3826	
		51	3821	
		52	3817	
		53	3813	
		54	3809	
		56	3806	
		57	3802	
		58	3799	
		59	3797	
		60	3794	
		62	3791	
		63	3789	
		64	3787	
		65	3784	
		67	3782	
		68	3780	
		69	3779	
		70	3777	
		72	3775	
		73	3773	
		74	3770	
		75	3766	
		76	3762	
		78	3758	
		79	3754	
		80	3749	
		81	3746	
		83	3742	
		84	3738	
		85	3733	
		86	3726	
		88	3720	
		89	3714	
		90	3707	
		91	3697	
		93	3693	
		94	3691	
		95	3689	
		96	3687	
		97	3681	
		99	3655	
		100	3604	
		101	3535	
		102	3435	
	>;

	r_profile_t0_num = <84>;
	r_profile_t0 = <
		113   4188
		113   4166	
		113   4148	
		113   4134	
		113   4121	
		113   4109	
		113   4097	
		113   4087	
		113   4079	
		113   4073	
		113   4064	
		113   4052	
		113   4037	
		113   4023	
		113   4011	
		113   4002	
		113   3994	
		113   3987	
		113   3980	
		113   3974	
		113   3968	
		113   3962	
		113   3955	
		113   3948	
		113   3941	
		113   3934	
		113   3927	
		113   3920	
		113   3914	
		113   3907	
		113   3900	
		113   3893	
		113   3886	
		113   3878	
		113   3870	
		113   3861	
		113   3853	
		113   3845	
		113   3838	
		113   3831	
		113   3826	
		113   3821	
		113   3817	
		113   3813	
		113   3809	
		113   3806	
		113   3802	
		113   3799	
		113   3797	
		113   3794	
		113   3791	
		113   3789	
		113   3787	
		113   3784	
		113   3782	
		113   3780	
		113   3779	
		113   3777	
		113   3775	
		113   3773	
		113   3770	
		113   3766	
		113   3762	
		113   3758	
		113   3754	
		113   3749	
		113   3746	
		113   3742	
		113   3738	
		113   3733	
		113   3726	
		113   3720	
		113   3714	
		113   3707	
		113   3697	
		113   3693	
		113   3691	
		113   3689	
		113   3687	
		113   3681	
		113   3655	
		113   3604	
		113   3535	
		113   3435	
	>;

	r_profile_t1_num = <84>;
	r_profile_t1 = <
		113   4188
		113   4166	
		113   4148	
		113   4134	
		113   4121	
		113   4109	
		113   4097	
		113   4087	
		113   4079	
		113   4073	
		113   4064	
		113   4052	
		113   4037	
		113   4023	
		113   4011	
		113   4002	
		113   3994	
		113   3987	
		113   3980	
		113   3974	
		113   3968	
		113   3962	
		113   3955	
		113   3948	
		113   3941	
		113   3934	
		113   3927	
		113   3920	
		113   3914	
		113   3907	
		113   3900	
		113   3893	
		113   3886	
		113   3878	
		113   3870	
		113   3861	
		113   3853	
		113   3845	
		113   3838	
		113   3831	
		113   3826	
		113   3821	
		113   3817	
		113   3813	
		113   3809	
		113   3806	
		113   3802	
		113   3799	
		113   3797	
		113   3794	
		113   3791	
		113   3789	
		113   3787	
		113   3784	
		113   3782	
		113   3780	
		113   3779	
		113   3777	
		113   3775	
		113   3773	
		113   3770	
		113   3766	
		113   3762	
		113   3758	
		113   3754	
		113   3749	
		113   3746	
		113   3742	
		113   3738	
		113   3733	
		113   3726	
		113   3720	
		113   3714	
		113   3707	
		113   3697	
		113   3693	
		113   3691	
		113   3689	
		113   3687	
		113   3681	
		113   3655	
		113   3604	
		113   3535	
		113   3435	
	>;

	r_profile_t2_num = <84>;
	r_profile_t2 = <	        
		113   4188
		113   4166	
		113   4148	
		113   4134	
		113   4121	
		113   4109	
		113   4097	
		113   4087	
		113   4079	
		113   4073	
		113   4064	
		113   4052	
		113   4037	
		113   4023	
		113   4011	
		113   4002	
		113   3994	
		113   3987	
		113   3980	
		113   3974	
		113   3968	
		113   3962	
		113   3955	
		113   3948	
		113   3941	
		113   3934	
		113   3927	
		113   3920	
		113   3914	
		113   3907	
		113   3900	
		113   3893	
		113   3886	
		113   3878	
		113   3870	
		113   3861	
		113   3853	
		113   3845	
		113   3838	
		113   3831	
		113   3826	
		113   3821	
		113   3817	
		113   3813	
		113   3809	
		113   3806	
		113   3802	
		113   3799	
		113   3797	
		113   3794	
		113   3791	
		113   3789	
		113   3787	
		113   3784	
		113   3782	
		113   3780	
		113   3779	
		113   3777	
		113   3775	
		113   3773	
		113   3770	
		113   3766	
		113   3762	
		113   3758	
		113   3754	
		113   3749	
		113   3746	
		113   3742	
		113   3738	
		113   3733	
		113   3726	
		113   3720	
		113   3714	
		113   3707	
		113   3697	
		113   3693	
		113   3691	
		113   3689	
		113   3687	
		113   3681	
		113   3655	
		113   3604	
		113   3535	
		113   3435	
	>;
	r_profile_t3_num = <84>;
	r_profile_t3 = <	        
		113   4188
		113   4166	
		113   4148	
		113   4134	
		113   4121	
		113   4109	
		113   4097	
		113   4087	
		113   4079	
		113   4073	
		113   4064	
		113   4052	
		113   4037	
		113   4023	
		113   4011	
		113   4002	
		113   3994	
		113   3987	
		113   3980	
		113   3974	
		113   3968	
		113   3962	
		113   3955	
		113   3948	
		113   3941	
		113   3934	
		113   3927	
		113   3920	
		113   3914	
		113   3907	
		113   3900	
		113   3893	
		113   3886	
		113   3878	
		113   3870	
		113   3861	
		113   3853	
		113   3845	
		113   3838	
		113   3831	
		113   3826	
		113   3821	
		113   3817	
		113   3813	
		113   3809	
		113   3806	
		113   3802	
		113   3799	
		113   3797	
		113   3794	
		113   3791	
		113   3789	
		113   3787	
		113   3784	
		113   3782	
		113   3780	
		113   3779	
		113   3777	
		113   3775	
		113   3773	
		113   3770	
		113   3766	
		113   3762	
		113   3758	
		113   3754	
		113   3749	
		113   3746	
		113   3742	
		113   3738	
		113   3733	
		113   3726	
		113   3720	
		113   3714	
		113   3707	
		113   3697	
		113   3693	
		113   3691	
		113   3689	
		113   3687	
		113   3681	
		113   3655	
		113   3604	
		113   3535	
		113   3435	
	>;
};
