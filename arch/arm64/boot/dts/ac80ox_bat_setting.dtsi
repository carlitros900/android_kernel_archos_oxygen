/*************************
 * Customized Battery Setting dtsi file
*************************/
&bat_comm {
	gpio22_dc_det = <&pio 22 0>;
	gpio85_set_chr_set = <&pio 85 0>;
	gpio28_spec_cur_select = <&pio 28 0>;

	/* cust_charging.h */
	/* stop charging while in talking mode */
	stop_charging_in_takling = <1>;
	talking_recharge_voltage = <3800>;
	talking_sync_time = <60>;

	/* Battery Temperature Protection */
	mtk_temperature_recharge_support = <1>;
	max_charge_temperature = <50>;
	max_charge_temperature_minus_x_degree = <47>;
	min_charge_temperature = <0>;
	min_charge_temperature_plus_x_degree = <6>;
	err_charge_temperature = <0xff>;

	/* Linear Charging Threshold */
	v_pre2cc_thres = <3400>;	/* unit: mV */
	v_cc2topoff_thres = <4050>;
	recharging_voltage = <4110>;
	charging_full_current = <80>;	/* unit: mA */

	/* Charging Current Setting */
	config_usb_if = <0>;
	usb_charger_current_suspend = <0>;	/* Unit: 0.01 mA */
	usb_charger_current_unconfigured = <7000>;	/* Unit: 0.01 mA */
	usb_charger_current_configured = <50000>;	/* Unit: 0.01 mA */
	usb_charger_current = <50000>;	/* Unit: 0.01 mA */
	ac_charger_current = <140000>;	/* Unit: 0.01 mA */
	non_std_ac_charger_current = <50000>;	/* Unit: 0.01 mA */
	charging_host_charger_current = <65000>;	/* Unit: 0.01 mA */
	apple_0_5a_charger_current = <50000>;	/* Unit: 0.01 mA */
	apple_1_0a_charger_current = <65000>;	/* Unit: 0.01 mA */
	apple_2_1a_charger_current = <80000>;	/* Unit: 0.01 mA */

	/* charger error check */
	bat_low_temp_protect_enable = <0>;
	v_charger_enable = <0>;	/* 1:on , 0:off */
	v_charger_max = <6500>;	/* unit: mV */
	v_charger_min = <4400>;

	/*  Tracking TIME */
	onehundred_percent_tracking_time = <10>;	/* Unit: second */
	npercent_tracking_time = <20>;	/* Unit: second */
	sync_to_real_tracking_time = <60>;	/* Unit: second */
	v_0percent_tracking = <3450>;	/* Unit: mV */

	/* High battery support */
	high_battery_voltage_support = <0>;
};

&bat_meter {
	/* cust_battery_meter.h */
	/* ADC resistor  */
	r_bat_sense = <4>;
	r_i_sense = <4>;
	r_charger_1 = <330>;
	r_charger_2 = <39>;
	temperature_t0 = <110>;
	temperature_t1 = <0>;
	temperature_t2 = <25>;
	temperature_t3 = <50>;
	temperature_t = <255>;	/* this should be fixed, never change the value */
	fg_meter_resistance = <0>;

	/* Qmax for 0mA */
	q_max_pos_50 = <4075>;
	q_max_pos_25 = <4075>;
	q_max_pos_0 = <4075>;
	q_max_neg_10 = <4075>;
	/* Qmax for 400mA, said high current */
	q_max_pos_50_h_current = <3542>;
	q_max_pos_25_h_current = <3542>;
	q_max_pos_0_h_current = <3542>;
	q_max_neg_10_h_current = <3542>;
	/* Discharge percentage, 1: D5, 0: D2 */
	oam_d5 = <1>;

	change_tracking_point = <1>;
	/* SW OCV tracking setting */
	cust_tracking_point = <14>;
	cust_r_sense = <200>;
	cust_hw_cc = <0>;
	aging_tuning_value = <100>;
	cust_r_fg_offset = <0>;
	ocv_board_compesate = <0>;
	r_fg_board_base = <1000>;
	r_fg_board_slope = <1000>;
	car_tune_value = <89>;

	/* HW Fuel gague  */
	current_detect_r_fg = <10>;	/* Unit: mA */
	minerroroffset = <1000>;
	fg_vbat_average_size = <18>;
	r_fg_value = <10>;	/* Unit: mOhm */

	cust_poweron_delta_capacity_tolrance = <80>;
	cust_poweron_low_capacity_tolrance = <5>;
	cust_poweron_max_vbat_tolrance = <70>;
	cust_poweron_delta_vbat_tolrance = <60>;
	cust_poweron_delta_hw_sw_ocv_capacity_tolrance = <10>;

	/* Fixed battery temperature */
	fixed_tbat_25 = <1>;
	/* Dynamic change wake up period of battery thread when suspend */
	vbat_normal_wakeup = <3600>;	/* Unit: mV */
	vbat_low_power_wakeup = <3500>;	/* Unit: mV */
	normal_wakeup_period = <5400>;	/* Unit: second */
	low_power_wakeup_period = <300>;	/* Unit: second */
	close_poweroff_wakeup_period = <30>;	/* Unit: second */

	rbat_pull_up_r = <16900>;
	rbat_pull_up_volt = <1800>;

	batt_temperature_table_num = <17>;
	batt_temperature_table = <
			    (-20) 75022
			    (-15) 57926
			    (-10) 45168
			    (-5) 35548
			    0 28224
			    5 22595
			    10 18231
			    15 14820
			    20 12133
			    25 10000 30 8295 35 6922 40 5810 45 4903 50 4160 55 3547 60 3039>;

	battery_profile_t0_num = <77>;
	battery_profile_t0 = <0   4187
				1   4159
				3   4139
				4   4124
				5   4110
				7   4097
				8   4085
				9   4073
				11  4062
				12  4051
				13  4040
				15  4029
				16  4019
				17  4008
				19  3999
				20  3989
				21  3980
				23  3971
				24  3962
				25  3954
				27  3946
				28  3938
				29  3930
				30  3923
				32  3916
				33  3908
				34  3902
				36  3894
				37  3888
				38  3881
				40  3873
				41  3865
				42  3856
				44  3846
				45  3836
				46  3827
				48  3819
				49  3813
				50  3807
				52  3803
				53  3799
				54  3795
				56  3792
				57  3789
				58  3786
				60  3783
				61  3781
				62  3779
				64  3777
				65  3776
				66  3774
				68  3773
				69  3772
				70  3770
				72  3769
				73  3767
				74  3764
				76  3761
				77  3758
				78  3754
				80  3749
				81  3743
				82  3738
				83  3733
				85  3728
				86  3720
				87  3711
				89  3703
				90  3693
				91  3681
				93  3672
				94  3665
				95  3660
				97  3654
				98  3647
				99  3626
				101 3569>;

	battery_profile_t1_num = <77>;
	battery_profile_t1 =  <0   4187
				1   4159
				3   4139
				4   4124
				5   4110
				7   4097
				8   4085
				9   4073
				11  4062
				12  4051
				13  4040
				15  4029
				16  4019
				17  4008
				19  3999
				20  3989
				21  3980
				23  3971
				24  3962
				25  3954
				27  3946
				28  3938
				29  3930
				30  3923
				32  3916
				33  3908
				34  3902
				36  3894
				37  3888
				38  3881
				40  3873
				41  3865
				42  3856
				44  3846
				45  3836
				46  3827
				48  3819
				49  3813
				50  3807
				52  3803
				53  3799
				54  3795
				56  3792
				57  3789
				58  3786
				60  3783
				61  3781
				62  3779
				64  3777
				65  3776
				66  3774
				68  3773
				69  3772
				70  3770
				72  3769
				73  3767
				74  3764
				76  3761
				77  3758
				78  3754
				80  3749
				81  3743
				82  3738
				83  3733
				85  3728
				86  3720
				87  3711
				89  3703
				90  3693
				91  3681
				93  3672
				94  3665
				95  3660
				97  3654
				98  3647
				99  3626
				101 3569>;

	battery_profile_t2_num = <77>;
	battery_profile_t2 =  <0   4187
				1   4159
				3   4139
				4   4124
				5   4110
				7   4097
				8   4085
				9   4073
				11  4062
				12  4051
				13  4040
				15  4029
				16  4019
				17  4008
				19  3999
				20  3989
				21  3980
				23  3971
				24  3962
				25  3954
				27  3946
				28  3938
				29  3930
				30  3923
				32  3916
				33  3908
				34  3902
				36  3894
				37  3888
				38  3881
				40  3873
				41  3865
				42  3856
				44  3846
				45  3836
				46  3827
				48  3819
				49  3813
				50  3807
				52  3803
				53  3799
				54  3795
				56  3792
				57  3789
				58  3786
				60  3783
				61  3781
				62  3779
				64  3777
				65  3776
				66  3774
				68  3773
				69  3772
				70  3770
				72  3769
				73  3767
				74  3764
				76  3761
				77  3758
				78  3754
				80  3749
				81  3743
				82  3738
				83  3733
				85  3728
				86  3720
				87  3711
				89  3703
				90  3693
				91  3681
				93  3672
				94  3665
				95  3660
				97  3654
				98  3647
				99  3626
				101 3569>;

	battery_profile_t3_num = <77>;
	battery_profile_t3 = <0   4187
				1   4159
				3   4139
				4   4124
				5   4110
				7   4097
				8   4085
				9   4073
				11  4062
				12  4051
				13  4040
				15  4029
				16  4019
				17  4008
				19  3999
				20  3989
				21  3980
				23  3971
				24  3962
				25  3954
				27  3946
				28  3938
				29  3930
				30  3923
				32  3916
				33  3908
				34  3902
				36  3894
				37  3888
				38  3881
				40  3873
				41  3865
				42  3856
				44  3846
				45  3836
				46  3827
				48  3819
				49  3813
				50  3807
				52  3803
				53  3799
				54  3795
				56  3792
				57  3789
				58  3786
				60  3783
				61  3781
				62  3779
				64  3777
				65  3776
				66  3774
				68  3773
				69  3772
				70  3770
				72  3769
				73  3767
				74  3764
				76  3761
				77  3758
				78  3754
				80  3749
				81  3743
				82  3738
				83  3733
				85  3728
				86  3720
				87  3711
				89  3703
				90  3693
				91  3681
				93  3672
				94  3665
				95  3660
				97  3654
				98  3647
				99  3626
				101 3569>;

	r_profile_t0_num = <77>;
	r_profile_t0 = <111  4187
				103  4159
				101  4139
				101  4124
				102  4110
				103  4097
				104  4085
				104  4073
				106  4062
				107  4051
				109  4040
				110  4029
				111  4019
				112  4008
				113  3999
				114  3989
				115  3980
				116  3971
				117  3962
				119  3954
				120  3946
				122  3938
				123  3930
				125  3923
				127  3916
				126  3908
				128  3902
				127  3894
				128  3888
				128  3881
				126  3873
				124  3865
				122  3856
				118  3846
				113  3836
				110  3827
				108  3819
				107  3813
				105  3807
				106  3803
				106  3799
				105  3795
				107  3792
				107  3789
				108  3786
				108  3783
				108  3781
				110  3779
				110  3777
				111  3776
				112  3774
				112  3773
				112  3772
				112  3770
				113  3769
				115  3767
				113  3764
				112  3761
				114  3758
				113  3754
				114  3749
				112  3743
				111  3738
				111  3733
				113  3728
				114  3720
				115  3711
				116  3703
				116  3693
				114  3681
				117  3672
				120  3665
				128  3660
				138  3654
				149  3647
				160  3626
				169  3569>;

	r_profile_t1_num = <77>;
	r_profile_t1 = <111  4187
				103  4159
				101  4139
				101  4124
				102  4110
				103  4097
				104  4085
				104  4073
				106  4062
				107  4051
				109  4040
				110  4029
				111  4019
				112  4008
				113  3999
				114  3989
				115  3980
				116  3971
				117  3962
				119  3954
				120  3946
				122  3938
				123  3930
				125  3923
				127  3916
				126  3908
				128  3902
				127  3894
				128  3888
				128  3881
				126  3873
				124  3865
				122  3856
				118  3846
				113  3836
				110  3827
				108  3819
				107  3813
				105  3807
				106  3803
				106  3799
				105  3795
				107  3792
				107  3789
				108  3786
				108  3783
				108  3781
				110  3779
				110  3777
				111  3776
				112  3774
				112  3773
				112  3772
				112  3770
				113  3769
				115  3767
				113  3764
				112  3761
				114  3758
				113  3754
				114  3749
				112  3743
				111  3738
				111  3733
				113  3728
				114  3720
				115  3711
				116  3703
				116  3693
				114  3681
				117  3672
				120  3665
				128  3660
				138  3654
				149  3647
				160  3626
				169  3569>;

	r_profile_t2_num = <77>;
	r_profile_t2 = <111  4187
				103  4159
				101  4139
				101  4124
				102  4110
				103  4097
				104  4085
				104  4073
				106  4062
				107  4051
				109  4040
				110  4029
				111  4019
				112  4008
				113  3999
				114  3989
				115  3980
				116  3971
				117  3962
				119  3954
				120  3946
				122  3938
				123  3930
				125  3923
				127  3916
				126  3908
				128  3902
				127  3894
				128  3888
				128  3881
				126  3873
				124  3865
				122  3856
				118  3846
				113  3836
				110  3827
				108  3819
				107  3813
				105  3807
				106  3803
				106  3799
				105  3795
				107  3792
				107  3789
				108  3786
				108  3783
				108  3781
				110  3779
				110  3777
				111  3776
				112  3774
				112  3773
				112  3772
				112  3770
				113  3769
				115  3767
				113  3764
				112  3761
				114  3758
				113  3754
				114  3749
				112  3743
				111  3738
				111  3733
				113  3728
				114  3720
				115  3711
				116  3703
				116  3693
				114  3681
				117  3672
				120  3665
				128  3660
				138  3654
				149  3647
				160  3626
				169  3569>;

	r_profile_t3_num = <77>;
	r_profile_t3 = <111  4187
				103  4159
				101  4139
				101  4124
				102  4110
				103  4097
				104  4085
				104  4073
				106  4062
				107  4051
				109  4040
				110  4029
				111  4019
				112  4008
				113  3999
				114  3989
				115  3980
				116  3971
				117  3962
				119  3954
				120  3946
				122  3938
				123  3930
				125  3923
				127  3916
				126  3908
				128  3902
				127  3894
				128  3888
				128  3881
				126  3873
				124  3865
				122  3856
				118  3846
				113  3836
				110  3827
				108  3819
				107  3813
				105  3807
				106  3803
				106  3799
				105  3795
				107  3792
				107  3789
				108  3786
				108  3783
				108  3781
				110  3779
				110  3777
				111  3776
				112  3774
				112  3773
				112  3772
				112  3770
				113  3769
				115  3767
				113  3764
				112  3761
				114  3758
				113  3754
				114  3749
				112  3743
				111  3738
				111  3733
				113  3728
				114  3720
				115  3711
				116  3703
				116  3693
				114  3681
				117  3672
				120  3665
				128  3660
				138  3654
				149  3647
				160  3626
				169  3569>;
};
