/*************************
 * Customized Battery Setting dtsi file
*************************/
&bat_comm {
	gpio22_dc_det = <&pio 22 0>;
	gpio85_set_chr_set = <&pio 85 0>;
	gpio28_spec_cur_select = <&pio 28 0>;
	/* cust_charging.h */
	/* stop charging while in talking mode */
	stop_charging_in_takling = <1>;
	talking_recharge_voltage = <3800>;
	talking_sync_time = <60>;

	/* Battery Temperature Protection */
	mtk_temperature_recharge_support = <1>;
	max_charge_temperature = <50>;
	max_charge_temperature_minus_x_degree = <47>;
	min_charge_temperature = <0>;
	min_charge_temperature_plus_x_degree = <6>;
	err_charge_temperature = <0xff>;

	/* Linear Charging Threshold */
	v_pre2cc_thres = <3400>;	/* unit: mV */
	v_cc2topoff_thres = <4050>;
	recharging_voltage = <4110>;
	charging_full_current = <80>;	/* unit: mA */

	/* Charging Current Setting */
	config_usb_if = <0>;
	usb_charger_current_suspend = <0>;	/* Unit: 0.01 mA */
	usb_charger_current_unconfigured = <7000>;	/* Unit: 0.01 mA */
	usb_charger_current_configured = <50000>;	/* Unit: 0.01 mA */
	usb_charger_current = <50000>;	/* Unit: 0.01 mA */
	ac_charger_current = <140000>;	/* Unit: 0.01 mA */
	non_std_ac_charger_current = <140000>;	/* Unit: 0.01 mA */
	charging_host_charger_current = <65000>;	/* Unit: 0.01 mA */
	apple_0_5a_charger_current = <50000>;	/* Unit: 0.01 mA */
	apple_1_0a_charger_current = <65000>;	/* Unit: 0.01 mA */
	apple_2_1a_charger_current = <80000>;	/* Unit: 0.01 mA */

	/* charger error check */
	bat_low_temp_protect_enable = <0>;
	v_charger_enable = <0>;	/* 1:on , 0:off */
	v_charger_max = <6500>;	/* unit: mV */
	v_charger_min = <4400>;

	/*  Tracking TIME */
	onehundred_percent_tracking_time = <1800>;	/* Unit: second */
	npercent_tracking_time = <200>;	/* Unit: second */
	sync_to_real_tracking_time = <300>;	/* Unit: second */
	v_0percent_tracking = <3470>;	/* Unit: mV */

	/* High battery support */
	high_battery_voltage_support = <0>;
};

&bat_meter {
	/* cust_battery_meter.h */
	/* ADC resistor  */
	r_bat_sense = <4>;
	r_i_sense = <4>;
	r_charger_1 = <330>;
	r_charger_2 = <39>;
	temperature_t0 = <110>;
	temperature_t1 = <0>;
	temperature_t2 = <25>;
	temperature_t3 = <50>;
	temperature_t = <255>;	/* this should be fixed, never change the value */
	fg_meter_resistance = <0>;

	/* Qmax for 0mA */
	q_max_pos_50 = <7091>;
	q_max_pos_25 = <7091>;
	q_max_pos_0 = <7091>;
	q_max_neg_10 = <7091>;
	/* Qmax for 600mA, said high current */
	q_max_pos_50_h_current = <6227>;
	q_max_pos_25_h_current = <6227>;
	q_max_pos_0_h_current = <6227>;
	q_max_neg_10_h_current = <6227>;
	/* Discharge percentage, 1: D5, 0: D2 */
	oam_d5 = <1>;

	change_tracking_point = <1>;
	/* SW OCV tracking setting */
	cust_tracking_point = <14>;
	cust_r_sense = <56>;
	cust_hw_cc = <0>;
	aging_tuning_value = <100>;
	cust_r_fg_offset = <0>;
	ocv_board_compesate = <0>;
	r_fg_board_base = <1000>;
	r_fg_board_slope = <1000>;
	car_tune_value = <89>;

	/* HW Fuel gague  */
	current_detect_r_fg = <10>;	/* Unit: mA */
	minerroroffset = <1000>;
	fg_vbat_average_size = <18>;
	r_fg_value = <20>;	/* Unit: mOhm */

	cust_poweron_delta_capacity_tolrance = <80>;
	cust_poweron_low_capacity_tolrance = <0>;
	cust_poweron_max_vbat_tolrance = <70>;
	cust_poweron_delta_vbat_tolrance = <60>;
	cust_poweron_delta_hw_sw_ocv_capacity_tolrance = <10>;

	/* Fixed battery temperature */
	fixed_tbat_25 = <1>;
	/* Dynamic change wake up period of battery thread when suspend */
	vbat_normal_wakeup = <3600>;	/* Unit: mV */
	vbat_low_power_wakeup = <3500>;	/* Unit: mV */
	normal_wakeup_period = <5400>;	/* Unit: second */
	low_power_wakeup_period = <300>;	/* Unit: second */
	close_poweroff_wakeup_period = <30>;	/* Unit: second */

	rbat_pull_up_r = <16900>;
	rbat_pull_up_volt = <1800>;

	batt_temperature_table_num = <17>;
	batt_temperature_table = <
			    (-20) 75022
			    (-15) 57926
			    (-10) 45168
			    (-5) 35548
			    0 28224
			    5 22595
			    10 18231
			    15 14820
			    20 12133
			    25 10000 30 8295 35 6922 40 5810 45 4903 50 4160 55 3547 60 3039>;

	battery_profile_t0_num = <88>;
	battery_profile_t0 = <0  	   4191			
				1  	   4175
				2  	   4161
				4  	   4149
				5  	   4137
				6  	   4125
				7  	   4114
				8  	   4103
				9  	   4092
				11 	   4081
				12 	   4071
				13 	   4062
				14 	   4051
				15 	   4041
				17 	   4031
				18 	   4022
				19 	   4012
				20 	   4003
				21 	   3995
				23 	   3986
				24 	   3978
				25 	   3971
				26 	   3963
				27 	   3955
				28 	   3948
				30 	   3941
				31 	   3934
				32 	   3927
				33 	   3920
				34 	   3914
				36 	   3908
				37 	   3901
				38 	   3894
				39 	   3886
				40 	   3877
				41 	   3867
				43 	   3856
				44 	   3846
				45 	   3837
				46 	   3830
				47 	   3825
				49 	   3819
				50 	   3815
				51 	   3811
				52 	   3807
				53 	   3803
				54 	   3800
				56 	   3797
				57 	   3794
				58 	   3791
				59 	   3788
				60 	   3786
				62 	   3784
        63 	   3782
        64 	   3780
        65 	   3778
        66 	   3776
        68 	   3775
        69 	   3773
        70 	   3772
        71 	   3771
        72 	   3769
        73 	   3767
        75 	   3764
        76 	   3761
        77 	   3758
        78 	   3754
        79 	   3749
        81 	   3745
        82 	   3741
        83 	   3737
        84 	   3732
        85 	   3726
        86 	   3718
        88 	   3711
        89 	   3705
        90 	   3695
        91 	   3685
        92 	   3681
        94 	   3677
        95     3674
        96     3669
        97     3663
        98     3653
        100    3622  
        101    3569
        102    3498
        103    3399>;


	battery_profile_t1_num = <88>;
	battery_profile_t1 = <0  	   4191		
	      1  	   4175   
	      2  	   4161   
	      4  	   4149   
	      5  	   4137   
	      6  	   4125   
	      7  	   4114   
	      8  	   4103   
	      9  	   4092   
	      11 	   4081   
	      12 	   4071   
	      13 	   4062   
	      14 	   4051   
	      15 	   4041   
	      17 	   4031   
	      18 	   4022   
	      19 	   4012   
	      20 	   4003   
	      21 	   3995   
	      23 	   3986   
	      24 	   3978   
	      25 	   3971   
	      26 	   3963   
	      27 	   3955   
	      28 	   3948   
	      30 	   3941   
	      31 	   3934   
	      32 	   3927   
	      33 	   3920   
	      34 	   3914   
	      36 	   3908   
	      37 	   3901   
	      38 	   3894   
	      39 	   3886   
	      40 	   3877   
	      41 	   3867   
	      43 	   3856   
	      44 	   3846   
	      45 	   3837   
	      46 	   3830   
	      47 	   3825   
	      49 	   3819   
	      50 	   3815   
	      51 	   3811   
	      52 	   3807   
	      53 	   3803   
	      54 	   3800   
	      56 	   3797   
	      57 	   3794   
	      58 	   3791   
	      59 	   3788   
	      60 	   3786   
	      62 	   3784   
	      63 	   3782   
        64 	   3780   
        65 	   3778   
        66 	   3776   
        68 	   3775   
        69 	   3773   
        70 	   3772   
        71 	   3771   
        72 	   3769   
        73 	   3767   
        75 	   3764   
        76 	   3761   
        77 	   3758   
        78 	   3754   
        79 	   3749   
        81 	   3745   
        82 	   3741   
        83 	   3737   
        84 	   3732   
        85 	   3726   
        86 	   3718   
        88 	   3711   
        89 	   3705   
        90 	   3695   
        91 	   3685   
        92 	   3681   
        94 	   3677   
        95     3674   
        96     3669   
        97     3663   
        98     3653   
        100    3622   
  			101    3569   							
  			102    3498   							
  			103    3399>; 							
  										

	battery_profile_t2_num = <88>;
	battery_profile_t2 = <0  	   4191		
				1  	   4175   
				2  	   4161   
				4  	   4149   
				5  	   4137   
				6  	   4125   
				7  	   4114   
				8  	   4103   
				9  	   4092   
				11 	   4081   
				12 	   4071   
				13 	   4062   
				14 	   4051   
				15 	   4041   
				17 	   4031   
				18 	   4022   
				19 	   4012   
				20 	   4003   
				21 	   3995   
				23 	   3986   
				24 	   3978   
				25 	   3971   
				26 	   3963   
				27 	   3955   
				28 	   3948   
				30 	   3941   
				31 	   3934   
				32 	   3927   
				33 	   3920   
				34 	   3914   
				36 	   3908   
				37 	   3901   
				38 	   3894   
				39 	   3886   
				40 	   3877   
				41 	   3867   
				43 	   3856   
				44 	   3846   
				45 	   3837   
				46 	   3830   
				47 	   3825   
				49 	   3819   
				50 	   3815   
				51 	   3811   
				52 	   3807   
				53 	   3803   
				54 	   3800   
				56 	   3797   
				57 	   3794   
				58 	   3791   
				59 	   3788   
				60 	   3786   
				62 	   3784   
				63 	   3782   
        64 	   3780   
        65 	   3778   
        66 	   3776   
        68 	   3775   
        69 	   3773   
        70 	   3772   
        71 	   3771   
        72 	   3769   
        73 	   3767   
        75 	   3764   
        76 	   3761   
        77 	   3758   
        78 	   3754   
        79 	   3749   
        81 	   3745   
        82 	   3741   
        83 	   3737   
        84 	   3732   
        85 	   3726   
        86 	   3718   
        88 	   3711   
        89 	   3705   
        90 	   3695   
        91 	   3685   
        92 	   3681   
        94 	   3677   
        95     3674   
        96     3669   
        97     3663   
        98     3653   
        100    3622     
        101    3569     
        102    3498     
        103    3399>;   

   
	battery_profile_t3_num = <88>;
	battery_profile_t3 = <0  	   4191	
				1  	   4175
				2  	   4161
				4  	   4149
				5  	   4137
				6  	   4125
				7  	   4114
				8  	   4103
				9  	   4092
				11 	   4081
				12 	   4071
				13 	   4062
				14 	   4051
				15 	   4041
				17 	   4031
				18 	   4022
				19 	   4012
				20 	   4003
				21 	   3995
				23 	   3986
				24 	   3978
				25 	   3971
				26 	   3963
				27 	   3955
				28 	   3948
				30 	   3941
				31 	   3934
				32 	   3927
				33 	   3920
				34 	   3914
				36 	   3908
				37 	   3901
				38 	   3894
				39 	   3886
				40 	   3877
				41 	   3867
				43 	   3856
				44 	   3846
				45 	   3837
				46 	   3830
				47 	   3825
				49 	   3819
				50 	   3815
				51 	   3811
				52 	   3807
				53 	   3803
				54 	   3800
				56 	   3797
				57 	   3794
				58 	   3791
				59 	   3788
				60 	   3786
				62 	   3784
				63 	   3782
       64 	   3780 
       65 	   3778 
       66 	   3776 
       68 	   3775 
       69 	   3773 
       70 	   3772 
       71 	   3771 
       72 	   3769 
       73 	   3767 
       75 	   3764 
       76 	   3761 
       77 	   3758 
       78 	   3754 
       79 	   3749 
       81 	   3745 
       82 	   3741 
       83 	   3737 
       84 	   3732 
       85 	   3726 
       86 	   3718 
       88 	   3711 
       89 	   3705 
       90 	   3695 
       91 	   3685 
       92 	   3681 
       94 	   3677 
       95      3674  
       96      3669  
       97      3663  
       98      3653  
       100     3622  
       101     3569  
       102     3498  
       103     3399>;



	r_profile_t0_num = <88>;
	r_profile_t0 = <118	  4191
				83 	  4175
				83 	  4161
				83 	  4149
				83 	  4137
				83 	  4125
				84 	  4114
				84 	  4103
				85 	  4092
				85 	  4081
				86 	  4071
				88 	  4062
				87 	  4051
				87 	  4041
				88 	  4031
				88 	  4022
				88 	  4012
				88 	  4003
				90 	  3995
				90 	  3986
				90 	  3978
				93 	  3971
				93 	  3963
				93 	  3955
				91 	  3948
				92 	  3941
				92 	  3934
				93 	  3927
				93 	  3920
				96 	  3914
				98 	  3908
				99 	  3901
				100	  3894
				99 	  3886
				98 	  3877
				95 	  3867
				92 	  3856
				89 	  3846
				87 	  3837
				85 	  3830
				86 	  3825
				84 	  3819
				85 	  3815
				84 	  3811
				85 	  3807
				84 	  3803
				85 	  3800
				86 	  3797
				87 	  3794
				86 	  3791
				86 	  3788
        88 	  3786
        88 	  3784
        88 	  3782
        88 	  3780
        88 	  3778
        88 	  3776
        88 	  3775
        88 	  3773
        89 	  3772
        89 	  3771
        89 	  3769
        93 	  3767
        93 	  3764
        92 	  3761
        92 	  3758
        91 	  3754
        90 	  3749
        91 	  3745
        91 	  3741
        92 	  3737
        93 	  3732
        93 	  3726
        92 	  3718
        92 	  3711
        93 	  3705
        92 	  3695
        90 	  3685
        91 	  3681
        93 	  3677
        96 	  3674
        98 	  3669
        103	  3663
        108   3653
        106   3622
        108   3569
        114   3498
        128   3399>;
        
	r_profile_t1_num = <88>;
	r_profile_t1 = <118	  4191
				83 	  4175
				83 	  4161
				83 	  4149
				83 	  4137
				83 	  4125
				84 	  4114
				84 	  4103
				85 	  4092
				85 	  4081
				86 	  4071
				88 	  4062
				87 	  4051
				87 	  4041
				88 	  4031
				88 	  4022
				88 	  4012
				88 	  4003
				90 	  3995
				90 	  3986
				90 	  3978
				93 	  3971
				93 	  3963
				93 	  3955
				91 	  3948
				92 	  3941
				92 	  3934
				93 	  3927
				93 	  3920
				96 	  3914
				98 	  3908
				99 	  3901
				100	  3894
				99 	  3886
				98 	  3877
				95 	  3867
				92 	  3856
				89 	  3846
				87 	  3837
				85 	  3830
				86 	  3825
				84 	  3819
				85 	  3815
				84 	  3811
				85 	  3807
				84 	  3803
				85 	  3800
				86 	  3797
				87 	  3794
				86 	  3791
				86 	  3788
				88 	  3786
				88 	  3784
				88 	  3782
				88 	  3780
				88 	  3778
				88 	  3776
				88 	  3775
				88 	  3773
				89 	  3772
				89 	  3771
				89 	  3769
				93 	  3767
				93 	  3764
				92 	  3761
				92 	  3758
				91 	  3754
				90 	  3749
				91 	  3745
				91 	  3741
				92 	  3737
				93 	  3732
				93 	  3726
				92 	  3718
				92 	  3711
				93 	  3705
				92 	  3695
				90 	  3685
				91 	  3681
				93 	  3677
				96 	  3674
				98 	  3669
				103	  3663
				108   3653
				106   3622
				108   3569
				114   3498
				128   3399>;
 
 
 
	r_profile_t2_num = <88>;
	r_profile_t2 = <118	  4191
				83 	  4175
				83 	  4161
				83 	  4149
				83 	  4137
				83 	  4125
				84 	  4114
				84 	  4103
				85 	  4092
				85 	  4081
				86 	  4071
				88 	  4062
				87 	  4051
				87 	  4041
				88 	  4031
				88 	  4022
				88 	  4012
				88 	  4003
				90 	  3995
				90 	  3986
				90 	  3978
				93 	  3971
				93 	  3963
				93 	  3955
				91 	  3948
				92 	  3941
				92 	  3934
				93 	  3927
				93 	  3920
				96 	  3914
				98 	  3908
				99 	  3901
				100	  3894
				99 	  3886
				98 	  3877
				95 	  3867
				92 	  3856
				89 	  3846
				87 	  3837
				85 	  3830
				86 	  3825
				84 	  3819
				85 	  3815
				84 	  3811
				85 	  3807
				84 	  3803
				85 	  3800
				86 	  3797
				87 	  3794
				86 	  3791
				86 	  3788
				88 	  3786
				88 	  3784
				88 	  3782
        88 	  3780
        88 	  3778
        88 	  3776
        88 	  3775
        88 	  3773
        89 	  3772
        89 	  3771
        89 	  3769
        93 	  3767
        93 	  3764
        92 	  3761
        92 	  3758
        91 	  3754
        90 	  3749
        91 	  3745
        91 	  3741
        92 	  3737
        93 	  3732
        93 	  3726
        92 	  3718
        92 	  3711
        93 	  3705
        92 	  3695
        90 	  3685
        91 	  3681
        93 	  3677
        96 	  3674
        98 	  3669
        103	  3663
        108   3653
        106   3622
        108   3569
        114   3498
        128   3399>;
  
  
  
  
	r_profile_t3_num = <88>;
	r_profile_t3 = <118	  4191
				83 	  4175
				83 	  4161
				83 	  4149
				83 	  4137
				83 	  4125
				84 	  4114
				84 	  4103
				85 	  4092
				85 	  4081
				86 	  4071
				88 	  4062
				87 	  4051
				87 	  4041
				88 	  4031
				88 	  4022
				88 	  4012
				88 	  4003
				90 	  3995
				90 	  3986
				90 	  3978
				93 	  3971
				93 	  3963
				93 	  3955
				91 	  3948
				92 	  3941
				92 	  3934
				93 	  3927
				93 	  3920
				96 	  3914
				98 	  3908
				99 	  3901
				100	  3894
				99 	  3886
				98 	  3877
				95 	  3867
				92 	  3856
				89 	  3846
				87 	  3837
				85 	  3830
				86 	  3825
				84 	  3819
				85 	  3815
				84 	  3811
				85 	  3807
				84 	  3803
				85 	  3800
				86 	  3797
				87 	  3794
				86 	  3791
				86 	  3788
				88 	  3786
				88 	  3784
				88 	  3782   
				88 	  3780
				88 	  3778
				88 	  3776
				88 	  3775
				88 	  3773
				89 	  3772
				89 	  3771
				89 	  3769
				93 	  3767
				93 	  3764
				92 	  3761
				92 	  3758
				91 	  3754
				90 	  3749
				91 	  3745
				91 	  3741
				92 	  3737
				93 	  3732
				93 	  3726
				92 	  3718
				92 	  3711
				93 	  3705
				92 	  3695
				90 	  3685
				91 	  3681
				93 	  3677
				96 	  3674
				98 	  3669
				103	  3663
				108   3653
				106   3622
				108   3569
				114   3498
				128   3399>;				
};
