/*************************
 * Customized Battery Setting dtsi file
*************************/
&bat_comm {
	gpio22_dc_det = <&pio 22 0>;
	gpio85_set_chr_set = <&pio 85 0>;
	gpio28_spec_cur_select = <&pio 28 0>;
	/* cust_charging.h */
	/* stop charging while in talking mode */
	stop_charging_in_takling = <1>;
	talking_recharge_voltage = <3800>;
	talking_sync_time = <60>;

	/* Battery Temperature Protection */
	mtk_temperature_recharge_support = <1>;
	max_charge_temperature = <50>;
	max_charge_temperature_minus_x_degree = <47>;
	min_charge_temperature = <0>;
	min_charge_temperature_plus_x_degree = <6>;
	err_charge_temperature = <0xff>;

	/* Linear Charging Threshold */
	v_pre2cc_thres = <3400>;	/* unit: mV */
	v_cc2topoff_thres = <4050>;
	recharging_voltage = <4110>;
	charging_full_current = <80>;	/* unit: mA */

	/* Charging Current Setting */
	config_usb_if = <0>;
	usb_charger_current_suspend = <0>;	/* Unit: 0.01 mA */
	usb_charger_current_unconfigured = <7000>;	/* Unit: 0.01 mA */
	usb_charger_current_configured = <50000>;	/* Unit: 0.01 mA */
	usb_charger_current = <140000>;	/* Unit: 0.01 mA */
	ac_charger_current = <140000>;	/* Unit: 0.01 mA */
	non_std_ac_charger_current = <140000>;	/* Unit: 0.01 mA */
	charging_host_charger_current = <65000>;	/* Unit: 0.01 mA */
	apple_0_5a_charger_current = <50000>;	/* Unit: 0.01 mA */
	apple_1_0a_charger_current = <65000>;	/* Unit: 0.01 mA */
	apple_2_1a_charger_current = <50000>;	/* Unit: 0.01 mA */

	/* charger error check */
	bat_low_temp_protect_enable = <0>;
	v_charger_enable = <0>;	/* 1:on , 0:off */
	v_charger_max = <6500>;	/* unit: mV */
	v_charger_min = <4400>;

	/*  Tracking TIME */
	onehundred_percent_tracking_time = <1800>;	/* Unit: second */
	npercent_tracking_time = <200>;	/* Unit: second */
	sync_to_real_tracking_time = <300>;	/* Unit: second */
	v_0percent_tracking = <3470>;	/* Unit: mV */

	/* High battery support */
	high_battery_voltage_support = <0>;
};

&bat_meter {
	/* cust_battery_meter.h */
	/* ADC resistor  */
	r_bat_sense = <4>;
	r_i_sense = <4>;
	r_charger_1 = <330>;
	r_charger_2 = <39>;
	temperature_t0 = <110>;
	temperature_t1 = <0>;
	temperature_t2 = <25>;
	temperature_t3 = <50>;
	temperature_t = <255>;	/* this should be fixed, never change the value */
	fg_meter_resistance = <0>;

	/* Qmax for 0mA */
	q_max_pos_50 = <5218>;
	q_max_pos_25 = <5218>;
	q_max_pos_0 = <5218>;
	q_max_neg_10 = <5218>;
	/* Qmax for 600mA, said high current */
	q_max_pos_50_h_current = <4690>;
	q_max_pos_25_h_current = <4690>;
	q_max_pos_0_h_current = <4690>;
	q_max_neg_10_h_current = <4690>;
	/* Discharge percentage, 1: D5, 0: D2 */
	oam_d5 = <1>;

	change_tracking_point = <1>;
	/* SW OCV tracking setting */
	cust_tracking_point = <14>;
	cust_r_sense = <200>;
	cust_hw_cc = <0>;
	aging_tuning_value = <100>;
	cust_r_fg_offset = <0>;
	ocv_board_compesate = <0>;
	r_fg_board_base = <1000>;
	r_fg_board_slope = <1000>;
	car_tune_value = <89>;

	/* HW Fuel gague  */
	current_detect_r_fg = <10>;	/* Unit: mA */
	minerroroffset = <1000>;
	fg_vbat_average_size = <18>;
	r_fg_value = <20>;	/* Unit: mOhm */

	cust_poweron_delta_capacity_tolrance = <80>;
	cust_poweron_low_capacity_tolrance = <0>;
	cust_poweron_max_vbat_tolrance = <70>;
	cust_poweron_delta_vbat_tolrance = <60>;
	cust_poweron_delta_hw_sw_ocv_capacity_tolrance = <10>;

	/* Fixed battery temperature */
	fixed_tbat_25 = <1>;
	/* Dynamic change wake up period of battery thread when suspend */
	vbat_normal_wakeup = <3600>;	/* Unit: mV */
	vbat_low_power_wakeup = <3500>;	/* Unit: mV */
	normal_wakeup_period = <5400>;	/* Unit: second */
	low_power_wakeup_period = <300>;	/* Unit: second */
	close_poweroff_wakeup_period = <30>;	/* Unit: second */

	rbat_pull_up_r = <16900>;
	rbat_pull_up_volt = <1800>;

	batt_temperature_table_num = <17>;
	batt_temperature_table = <
			    (-20) 75022
			    (-15) 57926
			    (-10) 45168
			    (-5) 35548
			    0 28224
			    5 22595
			    10 18231
			    15 14820
			    20 12133
			    25 10000 30 8295 35 6922 40 5810 45 4903 50 4160 55 3547 60 3039>;

	battery_profile_t0_num = <84>;
	battery_profile_t0 = <0  	   4186			
				1  	   4160
				3  	   4144
				4  	   4128
				5  	   4113
				7  	   4101
				8  	   4091
				9  	   4080
				11 	   4072
				12 	   4063
				13 	   4055
				15 	   4049
				16 	   4043
				17 	   4037
				19 	   4032
				20 	   4027
				21 	   4019
				23 	   4012
				24 	   4003
				25 	   3995
				27 	   3987
				28 	   3979
				30 	   3970
				31 	   3961
				32 	   3954
				34 	   3945
				35 	   3936
				36 	   3930
				38 	   3923
				39 	   3917
				40 	   3911
				42 	   3905
				43 	   3898
				44 	   3890
				46 	   3884
				47 	   3875
				48 	   3868
				50 	   3860
				51 	   3850
				52 	   3840
				54 	   3829
				55 	   3821
				56 	   3814
				58 	   3807
				59 	   3801
				60 	   3796
				62 	   3791
				63 	   3787
				64 	   3784
				66 	   3781
				67 	   3778
				68 	   3777
				70 	   3775
        71 	   3775
        72 	   3775
        74 	   3772
        75 	   3771
        76 	   3771
        78 	   3769
        79 	   3767
        80 	   3764
        82 	   3759
        83 	   3753
        85 	   3746
        86 	   3737
        87 	   3729
        89 	   3717
        90 	   3704
        91 	   3689
        93 	   3674
        94 	   3660
        95 	   3645
        97 	   3631
        98 	   3619
        99 	   3607
        101	   3594
        101	   3583
        101	   3570
        101	   3558
        101	   3546
        101    3533
        101    3521
        111    3509
        111    3500
        111    3492>;

	battery_profile_t1_num = <84>;
	battery_profile_t1 = <0  	   4186	
				1  	   4160
				3  	   4144
				4  	   4128
				5  	   4113
				7  	   4101
				8  	   4091
				9  	   4080
				11 	   4072
				12 	   4063
				13 	   4055
				15 	   4049
				16 	   4043
				17 	   4037
				19 	   4032
				20 	   4027
				21 	   4019
				23 	   4012
				24 	   4003
				25 	   3995
				27 	   3987
				28 	   3979
				30 	   3970
				31 	   3961
				32 	   3954
				34 	   3945
				35 	   3936
				36 	   3930
				38 	   3923
				39 	   3917
				40 	   3911
				42 	   3905
				43 	   3898
				44 	   3890
				46 	   3884
				47 	   3875
				48 	   3868
				50 	   3860
				51 	   3850
				52 	   3840
				54 	   3829
				55 	   3821
				56 	   3814
				58 	   3807
				59 	   3801
				60 	   3796
				62 	   3791
				63 	   3787
				64 	   3784
				66 	   3781
				67 	   3778
				68 	   3777
				70 	   3775
				71 	   3775
        72 	   3775
        74 	   3772
        75 	   3771
        76 	   3771
        78 	   3769
        79 	   3767
        80 	   3764
        82 	   3759
        83 	   3753
        85 	   3746
        86 	   3737
        87 	   3729
        89 	   3717
        90 	   3704
        91 	   3689
        93 	   3674
        94 	   3660
        95 	   3645
        97 	   3631
        98 	   3619
        99 	   3607
        101	   3594
        101	   3583
        101	   3570
        101	   3558
        101	   3546
        101    3533
        101    3521
        111    3509
        111    3500
        111    3492>;

	battery_profile_t2_num = <84>;
	battery_profile_t2 = <0  	   4186
				1  	   4160
				3  	   4144
				4  	   4128
				5  	   4113
				7  	   4101
				8  	   4091
				9  	   4080
				11 	   4072
				12 	   4063
				13 	   4055
				15 	   4049
				16 	   4043
				17 	   4037
				19 	   4032
				20 	   4027
				21 	   4019
				23 	   4012
				24 	   4003
				25 	   3995
				27 	   3987
				28 	   3979
				30 	   3970
				31 	   3961
				32 	   3954
				34 	   3945
				35 	   3936
				36 	   3930
				38 	   3923
				39 	   3917
				40 	   3911
				42 	   3905
				43 	   3898
				44 	   3890
				46 	   3884
				47 	   3875
				48 	   3868
				50 	   3860
				51 	   3850
				52 	   3840
				54 	   3829
				55 	   3821
				56 	   3814
				58 	   3807
				59 	   3801
				60 	   3796
				62 	   3791
				63 	   3787
				64 	   3784
				66 	   3781
				67 	   3778
				68 	   3777
				70 	   3775
				71 	   3775
        72 	   3775
        74 	   3772
        75 	   3771
        76 	   3771
        78 	   3769
        79 	   3767
        80 	   3764
        82 	   3759
        83 	   3753
        85 	   3746
        86 	   3737
        87 	   3729
        89 	   3717
        90 	   3704
        91 	   3689
        93 	   3674
        94 	   3660
        95 	   3645
        97 	   3631
        98 	   3619
        99 	   3607
        101	   3594
        101	   3583
        101	   3570
        101	   3558
        101	   3546
        101    3533
        101    3521
        111    3509
        111    3500
        111    3492>;
  
   
	battery_profile_t3_num = <84>;
	battery_profile_t3 = <0 4186
				1  	   4160
				3  	   4144
				4  	   4128
				5  	   4113
				7  	   4101
				8  	   4091
				9  	   4080
				11 	   4072
				12 	   4063
				13 	   4055
				15 	   4049
				16 	   4043
				17 	   4037
				19 	   4032
				20 	   4027
				21 	   4019
				23 	   4012
				24 	   4003
				25 	   3995
				27 	   3987
				28 	   3979
				30 	   3970
				31 	   3961
				32 	   3954
				34 	   3945
				35 	   3936
				36 	   3930
				38 	   3923
				39 	   3917
				40 	   3911
				42 	   3905
				43 	   3898
				44 	   3890
				46 	   3884
				47 	   3875
				48 	   3868
				50 	   3860
				51 	   3850
				52 	   3840
				54 	   3829
				55 	   3821
				56 	   3814
				58 	   3807
				59 	   3801
				60 	   3796
				62 	   3791
				63 	   3787
				64 	   3784
				66 	   3781
				67 	   3778
				68 	   3777
				70 	   3775
				71 	   3775
        72 	   3775
        74 	   3772
        75 	   3771
        76 	   3771
        78 	   3769
        79 	   3767
        80 	   3764
        82 	   3759
        83 	   3753
        85 	   3746
        86 	   3737
        87 	   3729
        89 	   3717
        90 	   3704
        91 	   3689
        93 	   3674
        94 	   3660
        95 	   3645
        97 	   3631
        98 	   3619
        99 	   3607
        101	   3594
        101	   3583
        101	   3570
        101	   3558
        101	   3546
        101    3533
        101    3521
        111    3509
        111    3500
        111    3492>;



	r_profile_t0_num = <84>;
	r_profile_t0 = <				
				141	  4144
				143	  4128
				139	  4113
				141	  4101
				143	  4091
				144	  4080
				146	  4072
				147	  4063
				146	  4055
				153	  4049
				156	  4043
				156	  4037
				163	  4032
				156	  4027
				154	  4019
				151	  4012
				153	  4003
				154	  3995
				156	  3987
				157	  3979
				157	  3970
				157	  3961
				160	  3954
				160	  3945
				159	  3936
				166	  3930
				166	  3923
				164	  3917
				164	  3911
				164	  3905
				163	  3898
				164	  3890
				166	  3884
				163	  3875
				164	  3868
				161	  3860
				156	  3850
				150	  3840
				144	  3829
				141	  3821
				144	  3814
				143	  3807
				140	  3801
				140	  3796
				139	  3791
				140	  3787
				140	  3784
				143	  3781
				143	  3778
				143	  3777
				144	  3775
        144	  3775
        144	  3775
        141	  3772
        139	  3771
        147	  3771
        146	  3769
        146	  3767
        146	  3764
        146	  3759
        146	  3753
        147	  3746
        150	  3737
        153	  3729
        149	  3717
        149	  3704
        149	  3689
        149	  3674
        150	  3660
        146	  3645
        151	  3631
        153	  3619
        151	  3607
        147	  3594
        149	  3583
        149	  3570
        149	  3558
        153	  3546
        151	  3533
        154	  3521
        154	  3509
        157	  3500
        163	  3492>;
        
	r_profile_t1_num = <84>;
	r_profile_t1 = <139	  4186
				141	  4144
				143	  4128
				139	  4113
				141	  4101
				143	  4091
				144	  4080
				146	  4072
				147	  4063
				146	  4055
				153	  4049
				156	  4043
				156	  4037
				163	  4032
				156	  4027
				154	  4019
				151	  4012
				153	  4003
				154	  3995
				156	  3987
				157	  3979
				157	  3970
				157	  3961
				160	  3954
				160	  3945
				159	  3936
				166	  3930
				166	  3923
				164	  3917
				164	  3911
				164	  3905
				163	  3898
				164	  3890
				166	  3884
				163	  3875
				164	  3868
				161	  3860
				156	  3850
				150	  3840
				144	  3829
				141	  3821
				144	  3814
				143	  3807
				140	  3801
				140	  3796
				139	  3791
				140	  3787
				140	  3784
				143	  3781
				143	  3778
				143	  3777
				144	  3775
				144	  3775
				144	  3775
        141	  3772
        139	  3771
        147	  3771
        146	  3769
        146	  3767
        146	  3764
        146	  3759
        146	  3753
        147	  3746
        150	  3737
        153	  3729
        149	  3717
        149	  3704
        149	  3689
        149	  3674
        150	  3660
        146	  3645
        151	  3631
        153	  3619
        151	  3607
        147	  3594
        149	  3583
        149	  3570
        149	  3558
        153	  3546
        151	  3533
        154	  3521
        154	  3509
        157	  3500
        163	  3492>;
 
 
 
	r_profile_t2_num = <84>;
	r_profile_t2 = <139	  4186
				141	  4144
				143	  4128
				139	  4113
				141	  4101
				143	  4091
				144	  4080
				146	  4072
				147	  4063
				146	  4055
				153	  4049
				156	  4043
				156	  4037
				163	  4032
				156	  4027
				154	  4019
				151	  4012
				153	  4003
				154	  3995
				156	  3987
				157	  3979
				157	  3970
				157	  3961
				160	  3954
				160	  3945
				159	  3936
				166	  3930
				166	  3923
				164	  3917
				164	  3911
				164	  3905
				163	  3898
				164	  3890
				166	  3884
				163	  3875
				164	  3868
				161	  3860
				156	  3850
				150	  3840
				144	  3829
				141	  3821
				144	  3814
				143	  3807
				140	  3801
				140	  3796
				139	  3791
				140	  3787
				140	  3784
				143	  3781
				143	  3778
				143	  3777
				144	  3775
				144	  3775
				144	  3775
        141	  3772
        139	  3771
        147	  3771
        146	  3769
        146	  3767
        146	  3764
        146	  3759
        146	  3753
        147	  3746
        150	  3737
        153	  3729
        149	  3717
        149	  3704
        149	  3689
        149	  3674
        150	  3660
        146	  3645
        151	  3631
        153	  3619
        151	  3607
        147	  3594
        149	  3583
        149	  3570
        149	  3558
        153	  3546
        151	  3533
        154	  3521
        154	  3509
        157	  3500
        163	  3492>;
  
  
  
  
	r_profile_t3_num = <84>;
	r_profile_t3 = <139	  4186
				141	  4144
				143	  4128
				139	  4113
				141	  4101
				143	  4091
				144	  4080
				146	  4072
				147	  4063
				146	  4055
				153	  4049
				156	  4043
				156	  4037
				163	  4032
				156	  4027
				154	  4019
				151	  4012
				153	  4003
				154	  3995
				156	  3987
				157	  3979
				157	  3970
				157	  3961
				160	  3954
				160	  3945
				159	  3936
				166	  3930
				166	  3923
				164	  3917
				164	  3911
				164	  3905
				163	  3898
				164	  3890
				166	  3884
				163	  3875
				164	  3868
				161	  3860
				156	  3850
				150	  3840
				144	  3829
				141	  3821
				144	  3814
				143	  3807
				140	  3801
				140	  3796
				139	  3791
				140	  3787
				140	  3784
				143	  3781
				143	  3778
				143	  3777
				144	  3775
				144	  3775
				144	  3775   
				141	  3772
				139	  3771
				147	  3771
				146	  3769
				146	  3767
				146	  3764
				146	  3759
				146	  3753
				147	  3746
				150	  3737
				153	  3729
				149	  3717
				149	  3704
				149	  3689
				149	  3674
				150	  3660
				146	  3645
				151	  3631
				153	  3619
				151	  3607
				147	  3594
				149	  3583
				149	  3570
				149	  3558
				153	  3546
				151	  3533
				154	  3521
				154	  3509
				157	  3500
				163	  3492>;				
};
