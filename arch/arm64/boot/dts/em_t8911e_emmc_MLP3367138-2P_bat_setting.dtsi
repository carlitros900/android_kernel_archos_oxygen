/*************************
 * Customized Battery Setting dtsi file
*************************/
&bat_comm {
	gpio22_dc_det = <&pio 22 0>;
	gpio85_set_chr_set = <&pio 85 0>;
	gpio28_spec_cur_select = <&pio 28 0>;
	/* cust_charging.h */
	/* stop charging while in talking mode */
	stop_charging_in_takling = <1>;
	talking_recharge_voltage = <3800>;
	talking_sync_time = <60>;

	/* Battery Temperature Protection */
	mtk_temperature_recharge_support = <1>;
	max_charge_temperature = <50>;
	max_charge_temperature_minus_x_degree = <47>;
	min_charge_temperature = <0>;
	min_charge_temperature_plus_x_degree = <6>;
	err_charge_temperature = <0xff>;

	/* Linear Charging Threshold */
	v_pre2cc_thres = <3400>;	/* unit: mV */
	v_cc2topoff_thres = <4050>;
	recharging_voltage = <4110>;
	charging_full_current = <80>;	/* unit: mA */

	/* Charging Current Setting */
	config_usb_if = <0>;
	usb_charger_current_suspend = <0>;	/* Unit: 0.01 mA */
	usb_charger_current_unconfigured = <7000>;	/* Unit: 0.01 mA */
	usb_charger_current_configured = <50000>;	/* Unit: 0.01 mA */
	usb_charger_current = <140000>;	/* Unit: 0.01 mA */
	ac_charger_current = <140000>;	/* Unit: 0.01 mA */
	non_std_ac_charger_current = <140000>;	/* Unit: 0.01 mA */
	charging_host_charger_current = <65000>;	/* Unit: 0.01 mA */
	apple_0_5a_charger_current = <50000>;	/* Unit: 0.01 mA */
	apple_1_0a_charger_current = <65000>;	/* Unit: 0.01 mA */
	apple_2_1a_charger_current = <50000>;	/* Unit: 0.01 mA */

	/* charger error check */
	bat_low_temp_protect_enable = <0>;
	v_charger_enable = <0>;	/* 1:on , 0:off */
	v_charger_max = <6500>;	/* unit: mV */
	v_charger_min = <4400>;

	/*  Tracking TIME */
	onehundred_percent_tracking_time = <1800>;	/* Unit: second */
	npercent_tracking_time = <200>;	/* Unit: second */
	sync_to_real_tracking_time = <300>;	/* Unit: second */
	v_0percent_tracking = <3470>;	/* Unit: mV */

	/* High battery support */
	high_battery_voltage_support = <0>;
};

&bat_meter {
	/* cust_battery_meter.h */
	/* ADC resistor  */
	r_bat_sense = <4>;
	r_i_sense = <4>;
	r_charger_1 = <330>;
	r_charger_2 = <39>;
	temperature_t0 = <110>;
	temperature_t1 = <0>;
	temperature_t2 = <25>;
	temperature_t3 = <50>;
	temperature_t = <255>;	/* this should be fixed, never change the value */
	fg_meter_resistance = <0>;

	/* Qmax for 0mA */
	q_max_pos_50 = <8184>;
	q_max_pos_25 = <8184>;
	q_max_pos_0 = <8184>;
	q_max_neg_10 = <8184>;
	/* Qmax for 600mA, said high current */
	q_max_pos_50_h_current = <8033>;
	q_max_pos_25_h_current = <8033>;
	q_max_pos_0_h_current = <8033>;
	q_max_neg_10_h_current = <8033>;
	/* Discharge percentage, 1: D5, 0: D2 */
	oam_d5 = <1>;

	change_tracking_point = <1>;
	/* SW OCV tracking setting */
	cust_tracking_point = <14>;
	cust_r_sense = <200>;
	cust_hw_cc = <0>;
	aging_tuning_value = <100>;
	cust_r_fg_offset = <0>;
	ocv_board_compesate = <0>;
	r_fg_board_base = <1000>;
	r_fg_board_slope = <1000>;
	car_tune_value = <89>;

	/* HW Fuel gague  */
	current_detect_r_fg = <10>;	/* Unit: mA */
	minerroroffset = <1000>;
	fg_vbat_average_size = <18>;
	r_fg_value = <20>;	/* Unit: mOhm */

	cust_poweron_delta_capacity_tolrance = <80>;
	cust_poweron_low_capacity_tolrance = <0>;
	cust_poweron_max_vbat_tolrance = <70>;
	cust_poweron_delta_vbat_tolrance = <60>;
	cust_poweron_delta_hw_sw_ocv_capacity_tolrance = <10>;

	/* Fixed battery temperature */
	fixed_tbat_25 = <1>;
	/* Dynamic change wake up period of battery thread when suspend */
	vbat_normal_wakeup = <3600>;	/* Unit: mV */
	vbat_low_power_wakeup = <3500>;	/* Unit: mV */
	normal_wakeup_period = <5400>;	/* Unit: second */
	low_power_wakeup_period = <300>;	/* Unit: second */
	close_poweroff_wakeup_period = <30>;	/* Unit: second */

	rbat_pull_up_r = <16900>;
	rbat_pull_up_volt = <1800>;

	batt_temperature_table_num = <17>;
	batt_temperature_table = <
			    (-20) 75022
			    (-15) 57926
			    (-10) 45168
			    (-5) 35548
			    0 28224
			    5 22595
			    10 18231
			    15 14820
			    20 12133
			    25 10000 30 8295 35 6922 40 5810 45 4903 50 4160 55 3547 60 3039>;

	battery_profile_t0_num = <89>;
	battery_profile_t0 = <
				0			4192
				1			4173
				2			4158
				4			4143
				5			4131
				6			4119
				7			4108
				8			4097
				9			4086
				11			4076
				12			4067
				13			4057
				14			4047
				15			4036
				16			4026
				18			4016
				19			4007
				20			3999
				21			3992
				22			3984
				24			3977
				25			3969
				26			3962
				27			3955
				28			3948
				29			3941
				31			3934
				32			3928
				33			3921
				34			3915
				35			3908
				36			3902
				38			3895
				39			3888
				40			3880
				41			3871
				42			3862
				44			3853
				45			3846
				46			3838
				47			3832
				48			3826
				49			3821
				51			3817
				52			3813
				53			3809
				54			3806
				55			3802
				56			3799
				58			3796
				59			3794
				60			3791
				61			3788
				62			3786
				64			3784
				65			3782
				66			3780
				67			3779
				68			3777
				69			3776
				71			3774
				72			3772
				73			3770
				74			3767
				75			3764
				76			3760
				78			3756
				79			3752
				80			3748
				81			3744
				82			3741
				84			3737
				85			3733
				86			3727
				87			3721
				88			3715
				89			3710
				91			3702
				92			3693
				93			3688
				94			3685
				95			3683
				96			3679
				98			3672
				99			3654
				100			3614
				101			3559
				102			3485
				104			3382>;

	battery_profile_t1_num = <89>;
	battery_profile_t1 = <				
				0			4192
				1			4173
				2			4158
				4			4143
				5			4131
				6			4119
				7			4108
				8			4097
				9			4086
				11			4076
				12			4067
				13			4057
				14			4047
				15			4036
				16			4026
				18			4016
				19			4007
				20			3999
				21			3992
				22			3984
				24			3977
				25			3969
				26			3962
				27			3955
				28			3948
				29			3941
				31			3934
				32			3928
				33			3921
				34			3915
				35			3908
				36			3902
				38			3895
				39			3888
				40			3880
				41			3871
				42			3862
				44			3853
				45			3846
				46			3838
				47			3832
				48			3826
				49			3821
				51			3817
				52			3813
				53			3809
				54			3806
				55			3802
				56			3799
				58			3796
				59			3794
				60			3791
				61			3788
				62			3786
				64			3784
				65			3782
				66			3780
				67			3779
				68			3777
				69			3776
				71			3774
				72			3772
				73			3770
				74			3767
				75			3764
				76			3760
				78			3756
				79			3752
				80			3748
				81			3744
				82			3741
				84			3737
				85			3733
				86			3727
				87			3721
				88			3715
				89			3710
				91			3702
				92			3693
				93			3688
				94			3685
				95			3683
				96			3679
				98			3672
				99			3654
				100			3614
				101			3559
				102			3485
				104			3382>;

	battery_profile_t2_num = <89>;
	battery_profile_t2 = <
				0			4192
				1			4173
				2			4158
				4			4143
				5			4131
				6			4119
				7			4108
				8			4097
				9			4086
				11			4076
				12			4067
				13			4057
				14			4047
				15			4036
				16			4026
				18			4016
				19			4007
				20			3999
				21			3992
				22			3984
				24			3977
				25			3969
				26			3962
				27			3955
				28			3948
				29			3941
				31			3934
				32			3928
				33			3921
				34			3915
				35			3908
				36			3902
				38			3895
				39			3888
				40			3880
				41			3871
				42			3862
				44			3853
				45			3846
				46			3838
				47			3832
				48			3826
				49			3821
				51			3817
				52			3813
				53			3809
				54			3806
				55			3802
				56			3799
				58			3796
				59			3794
				60			3791
				61			3788
				62			3786
				64			3784
				65			3782
				66			3780
				67			3779
				68			3777
				69			3776
				71			3774
				72			3772
				73			3770
				74			3767
				75			3764
				76			3760
				78			3756
				79			3752
				80			3748
				81			3744
				82			3741
				84			3737
				85			3733
				86			3727
				87			3721
				88			3715
				89			3710
				91			3702
				92			3693
				93			3688
				94			3685
				95			3683
				96			3679
				98			3672
				99			3654
				100			3614
				101			3559
				102			3485
				104			3382>;
  
   
	battery_profile_t3_num = <89>;
	battery_profile_t3 = <
				0			4192
				1			4173
				2			4158
				4			4143
				5			4131
				6			4119
				7			4108
				8			4097
				9			4086
				11			4076
				12			4067
				13			4057
				14			4047
				15			4036
				16			4026
				18			4016
				19			4007
				20			3999
				21			3992
				22			3984
				24			3977
				25			3969
				26			3962
				27			3955
				28			3948
				29			3941
				31			3934
				32			3928
				33			3921
				34			3915
				35			3908
				36			3902
				38			3895
				39			3888
				40			3880
				41			3871
				42			3862
				44			3853
				45			3846
				46			3838
				47			3832
				48			3826
				49			3821
				51			3817
				52			3813
				53			3809
				54			3806
				55			3802
				56			3799
				58			3796
				59			3794
				60			3791
				61			3788
				62			3786
				64			3784
				65			3782
				66			3780
				67			3779
				68			3777
				69			3776
				71			3774
				72			3772
				73			3770
				74			3767
				75			3764
				76			3760
				78			3756
				79			3752
				80			3748
				81			3744
				82			3741
				84			3737
				85			3733
				86			3727
				87			3721
				88			3715
				89			3710
				91			3702
				92			3693
				93			3688
				94			3685
				95			3683
				96			3679
				98			3672
				99			3654
				100			3614
				101			3559
				102			3485
				104			3382>;



	r_profile_t0_num = <89>;
	r_profile_t0 = <
59	4192
59	4173
59	4158
59	4143
59	4131
59	4119
59	4108
59	4097
59	4086
59	4076
59	4067
59	4057
59	4047
59	4036
59	4026
59	4016
59	4007
59	3999
59	3992
59	3984
59	3977
59	3969
59	3962
59	3955
59	3948
59	3941
59	3934
59	3928
59	3921
59	3915
59	3908
59	3902
59	3895
59	3888
59	3880
59	3871
59	3862
59	3853
59	3846
59	3838
59	3832
59	3826
59	3821
59	3817
59	3813
59	3809
59	3806
59	3802
59	3799
59	3796
59	3794
59	3791
59	3788
59	3786
59	3784
59	3782
59	3780
59	3779
59	3777
59	3776
59	3774
59	3772
59	3770
59	3767
59	3764
59	3760
59	3756
59	3752
59	3748
59	3744
59	3741
59	3737
59	3733
59	3727
59	3721
59	3715
59	3710
59	3702
59	3693
59	3688
59	3685
59	3683
59	3679
59	3672
59	3654
59	3614
59	3559
59	3485
59	3382
>;
        
	r_profile_t1_num = <89>;
	r_profile_t1 = <59	4192
59	4173
59	4158
59	4143
59	4131
59	4119
59	4108
59	4097
59	4086
59	4076
59	4067
59	4057
59	4047
59	4036
59	4026
59	4016
59	4007
59	3999
59	3992
59	3984
59	3977
59	3969
59	3962
59	3955
59	3948
59	3941
59	3934
59	3928
59	3921
59	3915
59	3908
59	3902
59	3895
59	3888
59	3880
59	3871
59	3862
59	3853
59	3846
59	3838
59	3832
59	3826
59	3821
59	3817
59	3813
59	3809
59	3806
59	3802
59	3799
59	3796
59	3794
59	3791
59	3788
59	3786
59	3784
59	3782
59	3780
59	3779
59	3777
59	3776
59	3774
59	3772
59	3770
59	3767
59	3764
59	3760
59	3756
59	3752
59	3748
59	3744
59	3741
59	3737
59	3733
59	3727
59	3721
59	3715
59	3710
59	3702
59	3693
59	3688
59	3685
59	3683
59	3679
59	3672
59	3654
59	3614
59	3559
59	3485
59	3382
>;

 
 
	r_profile_t2_num = <89>;
	r_profile_t2 = <59	4192
59	4173
59	4158
59	4143
59	4131
59	4119
59	4108
59	4097
59	4086
59	4076
59	4067
59	4057
59	4047
59	4036
59	4026
59	4016
59	4007
59	3999
59	3992
59	3984
59	3977
59	3969
59	3962
59	3955
59	3948
59	3941
59	3934
59	3928
59	3921
59	3915
59	3908
59	3902
59	3895
59	3888
59	3880
59	3871
59	3862
59	3853
59	3846
59	3838
59	3832
59	3826
59	3821
59	3817
59	3813
59	3809
59	3806
59	3802
59	3799
59	3796
59	3794
59	3791
59	3788
59	3786
59	3784
59	3782
59	3780
59	3779
59	3777
59	3776
59	3774
59	3772
59	3770
59	3767
59	3764
59	3760
59	3756
59	3752
59	3748
59	3744
59	3741
59	3737
59	3733
59	3727
59	3721
59	3715
59	3710
59	3702
59	3693
59	3688
59	3685
59	3683
59	3679
59	3672
59	3654
59	3614
59	3559
59	3485
59	3382
>;

  
  
  
	r_profile_t3_num = <89>;
	r_profile_t3 = <59	4192
59	4173
59	4158
59	4143
59	4131
59	4119
59	4108
59	4097
59	4086
59	4076
59	4067
59	4057
59	4047
59	4036
59	4026
59	4016
59	4007
59	3999
59	3992
59	3984
59	3977
59	3969
59	3962
59	3955
59	3948
59	3941
59	3934
59	3928
59	3921
59	3915
59	3908
59	3902
59	3895
59	3888
59	3880
59	3871
59	3862
59	3853
59	3846
59	3838
59	3832
59	3826
59	3821
59	3817
59	3813
59	3809
59	3806
59	3802
59	3799
59	3796
59	3794
59	3791
59	3788
59	3786
59	3784
59	3782
59	3780
59	3779
59	3777
59	3776
59	3774
59	3772
59	3770
59	3767
59	3764
59	3760
59	3756
59	3752
59	3748
59	3744
59	3741
59	3737
59	3733
59	3727
59	3721
59	3715
59	3710
59	3702
59	3693
59	3688
59	3685
59	3683
59	3679
59	3672
59	3654
59	3614
59	3559
59	3485
59	3382
>;				
};
